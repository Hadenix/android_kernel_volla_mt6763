/*
 * Mediatek's mt6763 SoC device tree source
 *
 * Copyright (c) 2013 MediaTek Co., Ltd.
 *              http://www.mediatek.com
 *
 */
#include <dt-bindings/clock/mt6763-clk.h>
#include <dt-bindings/interrupt-controller/arm-gic.h>
#include <dt-bindings/interrupt-controller/irq.h>
#include <dt-bindings/mmc/mt6763-msdc.h>
/* mt6763-pinfunc.h will be removed after DCT auto gen check-in */
#include <dt-bindings/pinctrl/mt6763-pinfunc.h>
#include <generated/autoconf.h>
#include <dt-bindings/memory/mt6763-larb-port.h>
#ifdef CONFIG_MTK_DTBO_FEATURE
/dts-v1/;
#endif

/ {
	model = "mt6763";
	compatible = "mediatek,mt6763";
	interrupt-parent = <0x01>;
	#address-cells = <0x02>;
	#size-cells = <0x02>;

	chosen {
		bootargs = "console=tty0 console=ttyMT3,921600n1 vmalloc=496M slub_max_order=0 slub_debug=OFZPU androidboot.hardware=mt6763 maxcpus=8 firmware_class.path=/vendor/firmware loop.max_part=7";
		linux,phandle = <0x4c>;
		phandle = <0x4c>;
	};

	chipid@08000000 {
		compatible = "mediatek,chipid";
		reg = <0x00 0x8000000 0x00 0x04 0x00 0x8000004 0x00 0x04 0x00 0x8000008 0x00 0x04 0x00 0x800000c 0x00 0x04>;
	};

	pmu {
		compatible = "arm,armv8-pmuv3";
		interrupts = <0x01 0x07 0x08>;
	};

	msdc@11230000 {
		compatible = "mediatek,msdc";
		reg = <0x00 0x11230000 0x00 0x10000>;
		interrupts = <0x00 0x4f 0x08>;
		index = [00];
		clk_src = [01];
		bus-width = <0x08>;
		max-frequency = <0xbebc200>;
		cap-mmc-highspeed;
		msdc-sys-suspend;
		mmc-ddr-1_8v;
		mmc-hs200-1_8v;
		mmc-hs400-1_8v;
		non-removable;
		pinctl = <0x02>;
		register_setting = <0x03>;
		host_function = [00];
		bootable;
		status = "disable";
		vmmc-supply = <0x04>;
		clocks = <0x05 0x20 0x05 0x1d>;
		clock-names = "msdc0-clock\0msdc0-hclock";
		hw_dvfs = [00];
		linux,phandle = <0x3d>;
		phandle = <0x3d>;
	};

	msdc@11240000 {
		compatible = "mediatek,msdc";
		reg = <0x00 0x11240000 0x00 0x10000>;
		interrupts = <0x00 0x50 0x08>;
		index = [01];
		clk_src = [04];
		bus-width = <0x04>;
		max-frequency = <0xbebc200>;
		msdc-sys-suspend;
		cap-sd-highspeed;
		sd-uhs-sdr12;
		sd-uhs-sdr25;
		sd-uhs-sdr50;
		sd-uhs-sdr104;
		sd-uhs-ddr50;
		pinctl = <0x06>;
		pinctl_sdr104 = <0x07>;
		pinctl_sdr50 = <0x08>;
		pinctl_ddr50 = <0x09>;
		register_setting = <0x0a>;
		host_function = [01];
		cd_level = [01];
		cd-gpios = <0x0b 0x0c 0x00>;
		status = "okay";
		vmmc-supply = <0x0c>;
		vqmmc-supply = <0x0d>;
		clocks = <0x05 0x29 0x05 0x1e>;
		clock-names = "msdc1-clock\0msdc1-hclock";
		hw_dvfs = [00];
		linux,phandle = <0x4d>;
		phandle = <0x4d>;
	};

	msdc@11250000 {
		compatible = "mediatek,msdc";
		reg = <0x00 0x11250000 0x00 0x10000>;
		interrupts = <0x00 0x51 0x08>;
		index = [02];
		clk_src = [04];
		bus-width = <0x04>;
		max-frequency = <0xbebc200>;
		cap-sd-highspeed;
		sd-uhs-sdr12;
		sd-uhs-sdr25;
		sd-uhs-sdr50;
		sd-uhs-sdr104;
		sd-uhs-ddr50;
		keep-power-in-suspend;
		non-removable;
		pinctl = <0x0e>;
		register_setting = <0x0f>;
		host_function = [02];
		status = "disable";
		clocks = <0x05 0x2a 0x05 0x1f>;
		clock-names = "msdc2-clock\0msdc2-hclock";
		hw_dvfs = [00];
		linux,phandle = <0x4e>;
		phandle = <0x4e>;
	};

	msdc1_ins@0 {
		compatible = "mediatek,mt6763-sdcard-ins";
		linux,phandle = <0x4f>;
		phandle = <0x4f>;
	};

	msdc0_top@11f50000 {
		compatible = "mediatek,msdc0_top";
		reg = <0x00 0x11f50000 0x00 0x1000>;
	};

	msdc1_top@11e10000 {
		compatible = "mediatek,msdc1_top";
		reg = <0x00 0x11e10000 0x00 0x1000>;
	};

	mobicore {
		compatible = "trustonic,mobicore";
		interrupts = <0x00 0x124 0x01>;
	};

	psci {
		compatible = "arm,psci-0.2";
		method = "smc";
		cpu_suspend = <0x84000001>;
		cpu_off = <0x84000002>;
		cpu_on = <0x84000003>;
		affinity_info = <0x84000004>;
	};

	atf_logger {
		compatible = "mediatek,atf_logger";
		interrupts = <0x00 0x7b 0x01>;
	};

	utos {
		compatible = "microtrust,utos";
		interrupts = <0x00 0x110 0x01 0x00 0x111 0x01>;
	};

	utos_tester {
		compatible = "microtrust,tester-v1";
	};

	cpus {
		#address-cells = <0x01>;
		#size-cells = <0x00>;

		cpu@000 {
			device_type = "cpu";
			compatible = "arm,cortex-a53";
			reg = <0x00>;
			enable-method = "psci";
			cpu-idle-states = <0x10 0x11 0x12 0x13 0x14 0x15 0x16 0x17 0x18 0x19 0x1a>;
			cpu-release-addr = <0x00 0x40000200>;
			clock-frequency = <0x61a1e580>;
			linux,phandle = <0x1b>;
			phandle = <0x1b>;
		};

		cpu@001 {
			device_type = "cpu";
			compatible = "arm,cortex-a53";
			reg = <0x01>;
			enable-method = "psci";
			cpu-idle-states = <0x10 0x11 0x12 0x13 0x14 0x15 0x16 0x17 0x18 0x19 0x1a>;
			cpu-release-addr = <0x00 0x40000200>;
			clock-frequency = <0x61a1e580>;
			linux,phandle = <0x1c>;
			phandle = <0x1c>;
		};

		cpu@002 {
			device_type = "cpu";
			compatible = "arm,cortex-a53";
			reg = <0x02>;
			enable-method = "psci";
			cpu-idle-states = <0x10 0x11 0x12 0x13 0x14 0x15 0x16 0x17 0x18 0x19 0x1a>;
			cpu-release-addr = <0x00 0x40000200>;
			clock-frequency = <0x61a1e580>;
			linux,phandle = <0x1d>;
			phandle = <0x1d>;
		};

		cpu@003 {
			device_type = "cpu";
			compatible = "arm,cortex-a53";
			reg = <0x03>;
			enable-method = "psci";
			cpu-idle-states = <0x10 0x11 0x12 0x13 0x14 0x15 0x16 0x17 0x18 0x19 0x1a>;
			cpu-release-addr = <0x00 0x40000200>;
			clock-frequency = <0x61a1e580>;
			linux,phandle = <0x1e>;
			phandle = <0x1e>;
		};

		cpu@100 {
			device_type = "cpu";
			compatible = "arm,cortex-a53";
			reg = <0x100>;
			enable-method = "psci";
			cpu-idle-states = <0x10 0x11 0x12 0x13 0x14 0x15 0x16 0x17 0x18 0x19 0x1a>;
			cpu-release-addr = <0x00 0x40000200>;
			clock-frequency = <0x8b799100>;
			linux,phandle = <0x1f>;
			phandle = <0x1f>;
		};

		cpu@101 {
			device_type = "cpu";
			compatible = "arm,cortex-a53";
			reg = <0x101>;
			enable-method = "psci";
			cpu-idle-states = <0x10 0x11 0x12 0x13 0x14 0x15 0x16 0x17 0x18 0x19 0x1a>;
			cpu-release-addr = <0x00 0x40000200>;
			clock-frequency = <0x8b799100>;
			linux,phandle = <0x20>;
			phandle = <0x20>;
		};

		cpu@102 {
			device_type = "cpu";
			compatible = "arm,cortex-a53";
			reg = <0x102>;
			enable-method = "psci";
			cpu-idle-states = <0x10 0x11 0x12 0x13 0x14 0x15 0x16 0x17 0x18 0x19 0x1a>;
			cpu-release-addr = <0x00 0x40000200>;
			clock-frequency = <0x8b799100>;
			linux,phandle = <0x21>;
			phandle = <0x21>;
		};

		cpu@103 {
			device_type = "cpu";
			compatible = "arm,cortex-a53";
			reg = <0x103>;
			enable-method = "psci";
			cpu-idle-states = <0x10 0x11 0x12 0x13 0x14 0x15 0x16 0x17 0x18 0x19 0x1a>;
			cpu-release-addr = <0x00 0x40000200>;
			clock-frequency = <0x8b799100>;
			linux,phandle = <0x22>;
			phandle = <0x22>;
		};

		cpu-map {

			cluster0 {

				core0 {
					cpu = <0x1b>;
				};

				core1 {
					cpu = <0x1c>;
				};

				core2 {
					cpu = <0x1d>;
				};

				core3 {
					cpu = <0x1e>;
				};
			};

			cluster1 {

				core0 {
					cpu = <0x1f>;
				};

				core1 {
					cpu = <0x20>;
				};

				core2 {
					cpu = <0x21>;
				};

				core3 {
					cpu = <0x22>;
				};
			};
		};

		idle-states {
			entry-method = "arm,psci";

			legacy-mcdi {
				compatible = "arm,idle-state";
				arm,psci-suspend-param = <0x01>;
				entry-latency-us = <0x258>;
				exit-latency-us = <0x258>;
				min-residency-us = <0x4b0>;
				linux,phandle = <0x10>;
				phandle = <0x10>;
			};

			legacy-sodi {
				compatible = "arm,idle-state";
				arm,psci-suspend-param = <0x02>;
				entry-latency-us = <0x258>;
				exit-latency-us = <0x258>;
				min-residency-us = <0x4b0>;
				linux,phandle = <0x11>;
				phandle = <0x11>;
			};

			legacy-sodi3 {
				compatible = "arm,idle-state";
				arm,psci-suspend-param = <0x03>;
				entry-latency-us = <0x258>;
				exit-latency-us = <0x258>;
				min-residency-us = <0x4b0>;
				linux,phandle = <0x12>;
				phandle = <0x12>;
			};

			legacy-dpidle {
				compatible = "arm,idle-state";
				arm,psci-suspend-param = <0x04>;
				entry-latency-us = <0x258>;
				exit-latency-us = <0x258>;
				min-residency-us = <0x4b0>;
				linux,phandle = <0x13>;
				phandle = <0x13>;
			};

			legacy-suspend {
				compatible = "arm,idle-state";
				arm,psci-suspend-param = <0x05>;
				entry-latency-us = <0x258>;
				exit-latency-us = <0x258>;
				min-residency-us = <0x4b0>;
				linux,phandle = <0x14>;
				phandle = <0x14>;
			};

			mcdi-cpu {
				compatible = "arm,idle-state";
				arm,psci-suspend-param = <0x10001>;
				entry-latency-us = <0x258>;
				exit-latency-us = <0x258>;
				min-residency-us = <0x4b0>;
				linux,phandle = <0x15>;
				phandle = <0x15>;
			};

			mcdi-cluster {
				compatible = "arm,idle-state";
				arm,psci-suspend-param = <0x1010001>;
				entry-latency-us = <0x258>;
				exit-latency-us = <0x258>;
				min-residency-us = <0x4b0>;
				linux,phandle = <0x16>;
				phandle = <0x16>;
			};

			sodi {
				compatible = "arm,idle-state";
				arm,psci-suspend-param = <0x1010002>;
				entry-latency-us = <0x320>;
				exit-latency-us = <0x3e8>;
				min-residency-us = <0x7d0>;
				linux,phandle = <0x17>;
				phandle = <0x17>;
			};

			sodi3 {
				compatible = "arm,idle-state";
				arm,psci-suspend-param = <0x1010003>;
				entry-latency-us = <0x320>;
				exit-latency-us = <0x3e8>;
				min-residency-us = <0x7d0>;
				linux,phandle = <0x18>;
				phandle = <0x18>;
			};

			dpidle {
				compatible = "arm,idle-state";
				arm,psci-suspend-param = <0x1010004>;
				entry-latency-us = <0x320>;
				exit-latency-us = <0x3e8>;
				min-residency-us = <0x7d0>;
				linux,phandle = <0x19>;
				phandle = <0x19>;
			};

			suspend {
				compatible = "arm,idle-state";
				arm,psci-suspend-param = <0x1010005>;
				entry-latency-us = <0x320>;
				exit-latency-us = <0x3e8>;
				min-residency-us = <0x7d0>;
				linux,phandle = <0x1a>;
				phandle = <0x1a>;
			};
		};
	};

	memory {
		device_type = "memory";
		reg = <0x00 0x40000000 0x00 0x1e605000>;
		linux,phandle = <0x50>;
		phandle = <0x50>;
	};

	cpu_dbgapb {
		compatible = "mediatek,hw_dbg";
		num = <0x08>;
		reg = <0x00 0xd410000 0x00 0x1000 0x00 0xd510000 0x00 0x1000 0x00 0xd610000 0x00 0x1000 0x00 0xd710000 0x00 0x1000 0x00 0xd810000 0x00 0x1000 0x00 0xd910000 0x00 0x1000 0x00 0xda10000 0x00 0x1000 0x00 0xdb10000 0x00 0x1000>;
		linux,phandle = <0x51>;
		phandle = <0x51>;
	};

	reserved-memory {
		#address-cells = <0x02>;
		#size-cells = <0x02>;
		ranges;
		linux,phandle = <0x52>;
		phandle = <0x52>;

		pstore-reserved-memory@54410000 {
			compatible = "mediatek,pstore";
			reg = <0x00 0x54410000 0x00 0xe0000>;
		};

		ram_console-reserved-memory@54400000 {
			compatible = "ram_console-reserve-memory";
			reg = <0x00 0x54400000 0x00 0x10000>;
		};

		minirdump-reserved-memory@544f0000 {
			compatible = "mediatek,minirdump";
			reg = <0x00 0x544f0000 0x00 0x10000>;
		};

		atf-reserved-memory@44610000 {
			compatible = "mediatek,mt6799-atf-reserved-memory";
			no-map;
			reg = <0x00 0x54600000 0x00 0x40000>;
		};

		reserve-memory-sspm_share {
			compatible = "mediatek,reserve-memory-sspm_share";
			no-map;
			status = "disabled";
			size = <0x00 0x80000>;
			alignment = <0x00 0x10000>;
			alloc-ranges = <0x00 0x40000000 0x00 0x60000000>;
		};

		consys-reserve-memory {
			compatible = "mediatek,consys-reserve-memory";
			#address-cells = <0x02>;
			#size-cells = <0x02>;
			no-map;
			size = <0x00 0x200000>;
			alignment = <0x00 0x200000>;
			alloc-ranges = <0x00 0x40000000 0x00 0x80000000>;
		};
	};

	plat_sram_flag@0011db00 {
		compatible = "mediatek,plat_sram_flag";
		reg = <0x00 0x11db00 0x00 0x10>;
	};

	interrupt-controller@40001000 {
		compatible = "arm,gic-v3";
		#interrupt-cells = <0x03>;
		#address-cells = <0x02>;
		#size-cells = <0x02>;
		#redistributor-regions = <0x01>;
		interrupt-controller;
		reg = <0x00 0xc000000 0x00 0x40000 0x00 0xc100000 0x00 0x200000 0x00 0xc530620 0x00 0x1000 0x00 0xc530690 0x00 0x1000>;
		interrupts = <0x01 0x09 0x04>;
		mediatek,reg_len_pol0 = <0x08>;
		linux,phandle = <0x01>;
		phandle = <0x01>;
	};

	dfd@0c530b00 {
		compatible = "mediatek,dfd";
		reg = <0x00 0xc530b00 0x00 0x10000>;
		mediatek,enabled = <0x01>;
		mediatek,chain_length = <0x61a8>;
		mediatek,rg_dfd_timeout = <0x4b0>;
	};

	clocks {

		clk_null {
			compatible = "fixed-clock";
			#clock-cells = <0x00>;
			clock-frequency = <0x00>;
			linux,phandle = <0x53>;
			phandle = <0x53>;
		};

		clk26m {
			compatible = "fixed-clock";
			#clock-cells = <0x00>;
			clock-frequency = <0x18cba80>;
			linux,phandle = <0x41>;
			phandle = <0x41>;
		};

		clk32k {
			compatible = "fixed-clock";
			#clock-cells = <0x00>;
			clock-frequency = <0x7d00>;
			linux,phandle = <0x23>;
			phandle = <0x23>;
		};
	};

	dramc_sram_debug@0011d800 {
		compatible = "mediatek,dramc_sram_debug";
		reg = <0x00 0x11d800 0x00 0x100>;
		linux,phandle = <0x54>;
		phandle = <0x54>;
	};

	topckgen@10000000 {
		compatible = "mediatek,topckgen";
		reg = <0x00 0x10000000 0x00 0x1000>;
		#clock-cells = <0x01>;
		linux,phandle = <0x40>;
		phandle = <0x40>;
	};

	infracfg_ao@10001000 {
		compatible = "mediatek,infracfg_ao\0syscon";
		reg = <0x00 0x10001000 0x00 0x1000>;
		interrupts = <0x00 0x93 0x01>;
		#clock-cells = <0x01>;
		linux,phandle = <0x05>;
		phandle = <0x05>;
	};

	scpsys@10001000 {
		compatible = "mediatek,scpsys";
		reg = <0x00 0x10001000 0x00 0x1000 0x00 0x10006000 0x00 0x1000 0x00 0x1020e000 0x00 0x1000 0x00 0x10000000 0x00 0x1000 0x00 0x1a001000 0x00 0x1000 0x00 0x14019000 0x00 0x1000>;
		#clock-cells = <0x01>;
		linux,phandle = <0x2e>;
		phandle = <0x2e>;
	};

	iocfg_lt@11f20000 {
		compatible = "mediatek,iocfg_lt";
		reg = <0x00 0x11f20000 0x00 0x1000>;
	};

	syscfg_pctl_lt@11f20000 {
		compatible = "mediatek,mt6763-pctl-lt-syscfg\0syscon";
		reg = <0x00 0x11f20000 0x00 0x1000>;
		linux,phandle = <0x25>;
		phandle = <0x25>;
	};

	iocfg_lm@11e80000 {
		compatible = "mediatek,iocfg_lm";
		reg = <0x00 0x11e80000 0x00 0x1000>;
	};

	syscfg_pctl_lm@11e80000 {
		compatible = "mediatek,mt6763-pctl-lm-syscfg\0syscon";
		reg = <0x00 0x11e80000 0x00 0x1000>;
		linux,phandle = <0x26>;
		phandle = <0x26>;
	};

	iocfg_lb@11e70000 {
		compatible = "mediatek,iocfg_lb";
		reg = <0x00 0x11e70000 0x00 0x1000>;
	};

	syscfg_pctl_lb@11e70000 {
		compatible = "mediatek,mt6763-pctl-lb-syscfg\0syscon";
		reg = <0x00 0x11e70000 0x00 0x1000>;
		linux,phandle = <0x27>;
		phandle = <0x27>;
	};

	iocfg_bl@11e90000 {
		compatible = "mediatek,iocfg_bl";
		reg = <0x00 0x11e90000 0x00 0x1000>;
	};

	syscfg_pctl_bl@11e90000 {
		compatible = "mediatek,mt6763-pctl-bl-syscfg\0syscon";
		reg = <0x00 0x11e90000 0x00 0x1000>;
		linux,phandle = <0x28>;
		phandle = <0x28>;
	};

	iocfg_rb@11d30000 {
		compatible = "mediatek,iocfg_rb";
		reg = <0x00 0x11d30000 0x00 0x1000>;
	};

	syscfg_pctl_rb@11d30000 {
		compatible = "mediatek,mt6763-pctl-rb-syscfg\0syscon";
		reg = <0x00 0x11d30000 0x00 0x1000>;
		linux,phandle = <0x29>;
		phandle = <0x29>;
	};

	iocfg_rm@11d20000 {
		compatible = "mediatek,iocfg_rm";
		reg = <0x00 0x11d20000 0x00 0x1000>;
	};

	syscfg_pctl_rm@11d20000 {
		compatible = "mediatek,mt6763-pctl-rm-syscfg\0syscon";
		reg = <0x00 0x11d20000 0x00 0x1000>;
		linux,phandle = <0x2a>;
		phandle = <0x2a>;
	};

	iocfg_rt@11c50000 {
		compatible = "mediatek,iocfg_rt";
		reg = <0x00 0x11c50000 0x00 0x1000>;
	};

	syscfg_pctl_rt@11c50000 {
		compatible = "mediatek,mt6763-pctl-rt-syscfg\0syscon";
		reg = <0x00 0x11c50000 0x00 0x1000>;
		linux,phandle = <0x2b>;
		phandle = <0x2b>;
	};

	iocfg_tl@11f30000 {
		compatible = "mediatek,iocfg_tl";
		reg = <0x00 0x11f30000 0x00 0x1000>;
	};

	syscfg_pctl_tl@11f30000 {
		compatible = "mediatek,mt6763-pctl-tl-syscfg\0syscon";
		reg = <0x00 0x11f30000 0x00 0x1000>;
		linux,phandle = <0x2c>;
		phandle = <0x2c>;
	};

	pericfg@10003000 {
		compatible = "mediatek,pericfg";
		reg = <0x00 0x10003000 0x00 0x1000>;
	};

	cpuxgpt@10200000 {
		compatible = "mediatek,mt6797-cpuxgpt";
		reg = <0x00 0x10200000 0x00 0x1000>;
		interrupts = <0x00 0x40 0x04 0x00 0x41 0x04 0x00 0x42 0x04 0x00 0x43 0x04 0x00 0x44 0x04 0x00 0x45 0x04 0x00 0x46 0x04 0x00 0x47 0x04 0x00 0x142 0x04 0x00 0x143 0x04>;
		linux,phandle = <0x55>;
		phandle = <0x55>;
	};

	timer {
		compatible = "arm,armv8-timer";
		interrupts = <0x01 0x0d 0x08 0x01 0x0e 0x08 0x01 0x0b 0x08 0x01 0x0a 0x08>;
		clock-frequency = <0xc65d40>;
		linux,phandle = <0x56>;
		phandle = <0x56>;
	};

	apxgpt@10008000 {
		compatible = "mediatek,apxgpt";
		reg = <0x00 0x10008000 0x00 0x100>;
		interrupts = <0x00 0xa6 0x08>;
		clocks = <0x23>;
	};

	dramc0@10004000 {
		compatible = "mediatek,dramc0";
		reg = <0x00 0x10004000 0x00 0x1000>;
	};

	gpio {
		compatible = "mediatek,gpio_usage_mapping";
		linux,phandle = <0x57>;
		phandle = <0x57>;
	};

	gpio@10005000 {
		compatible = "mediatek,gpio";
		reg = <0x00 0x10005000 0x00 0x1000>;
		linux,phandle = <0x58>;
		phandle = <0x58>;
	};

	syscfg_pctl_a@10005000 {
		compatible = "mediatek,mt6763-pctl-a-syscfg\0syscon";
		reg = <0x00 0x10005000 0x00 0x1000>;
		linux,phandle = <0x24>;
		phandle = <0x24>;
	};

	pinctrl@10005000 {
		compatible = "mediatek,pinctrl";
		reg = <0x00 0x10005000 0x00 0x1000>;
		mediatek,pctl-regmap = <0x24 0x25 0x26 0x27 0x28 0x29 0x2a 0x2b 0x2c>;
		pins-are-numbered;
		gpio-controller;
		#gpio-cells = <0x02>;
		linux,phandle = <0x0b>;
		phandle = <0x0b>;

		ufshci_va09on {
			linux,phandle = <0x42>;
			phandle = <0x42>;

			pins_cmd_dat {
				pins = <0x8300>;
				slew-rate = <0x01>;
				output-low;
				bias-disable;
			};
		};

		ufshci_va09off {
			linux,phandle = <0x43>;
			phandle = <0x43>;

			pins_cmd_dat {
				pins = <0x8300>;
				slew-rate = <0x01>;
				output-high;
				bias-disable;
			};
		};

		m4u@0 {
			cell-index = <0x00>;
			compatible = "mediatek,iommu-m4u";
			#iommu-cells = <0x01>;
			linux,phandle = <0x2d>;
			phandle = <0x2d>;
		};

		pseudo-m4u {
			compatible = "mediatek,pseudo-m4u";
			iommus = <0x2d 0x03>;
		};

		pseudo-m4u-larb0 {
			compatible = "mediatek,pseudo-port-m4u";
			mediatek,larbid = <0x00>;
			iommus = <0x2d 0x00 0x2d 0x01 0x2d 0x02 0x2d 0x03 0x2d 0x04 0x2d 0x05 0x2d 0x06 0x2d 0x07 0x2d 0x08 0x2d 0x09>;
		};

		pseudo-m4u-larb1 {
			compatible = "mediatek,pseudo-port-m4u";
			mediatek,larbid = <0x01>;
			iommus = <0x2d 0x0a 0x2d 0x0b 0x2d 0x0c 0x2d 0x0d 0x2d 0x0e 0x2d 0x0f 0x2d 0x10 0x2d 0x11 0x2d 0x12 0x2d 0x13>;
		};

		pseudo-m4u-larb2 {
			compatible = "mediatek,pseudo-port-m4u";
			mediatek,larbid = <0x02>;
			iommus = <0x2d 0x14 0x2d 0x15 0x2d 0x16 0x2d 0x17 0x2d 0x18 0x2d 0x19 0x2d 0x1a 0x2d 0x1b 0x2d 0x1c 0x2d 0x1d 0x2d 0x1e 0x2d 0x1f 0x2d 0x20 0x2d 0x21 0x2d 0x22 0x2d 0x23 0x2d 0x24 0x2d 0x25>;
		};

		pseudo-m4u-larb3 {
			compatible = "mediatek,pseudo-port-m4u";
			mediatek,larbid = <0x03>;
			iommus = <0x2d 0x26 0x2d 0x27 0x2d 0x28 0x2d 0x29 0x2d 0x2a 0x2d 0x2b 0x2d 0x2c 0x2d 0x2d 0x2d 0x2e 0x2d 0x2f 0x2d 0x30>;
		};

		msdc0@default {
			linux,phandle = <0x02>;
			phandle = <0x02>;

			pins_cmd {
				drive-strength = [03];
			};

			pins_dat {
				drive-strength = [03];
			};

			pins_clk {
				drive-strength = [03];
			};

			pins_rst {
				drive-strength = [03];
			};

			pins_ds {
				drive-strength = [01];
			};
		};

		msdc0@register_default {
			cmd_edge = [00];
			rdata_edge = [00];
			wdata_edge = [00];
			linux,phandle = <0x03>;
			phandle = <0x03>;
		};

		msdc1@default {
			linux,phandle = <0x06>;
			phandle = <0x06>;

			pins_cmd {
				drive-strength = [03];
			};

			pins_dat {
				drive-strength = [03];
			};

			pins_clk {
				drive-strength = [04];
			};
		};

		msdc1@sdr104 {
			linux,phandle = <0x07>;
			phandle = <0x07>;

			pins_cmd {
				drive-strength = [03];
			};

			pins_dat {
				drive-strength = [03];
			};

			pins_clk {
				drive-strength = [03];
			};
		};

		msdc1@sdr50 {
			linux,phandle = <0x08>;
			phandle = <0x08>;

			pins_cmd {
				drive-strength = [03];
			};

			pins_dat {
				drive-strength = [03];
			};

			pins_clk {
				drive-strength = [03];
			};
		};

		msdc1@ddr50 {
			linux,phandle = <0x09>;
			phandle = <0x09>;

			pins_cmd {
				drive-strength = [03];
			};

			pins_dat {
				drive-strength = [03];
			};

			pins_clk {
				drive-strength = [03];
			};
		};

		msdc1@register_default {
			cmd_edge = [00];
			rdata_edge = [00];
			wdata_edge = [00];
			linux,phandle = <0x0a>;
			phandle = <0x0a>;
		};

		msdc2@default {
			linux,phandle = <0x0e>;
			phandle = <0x0e>;

			pins_cmd {
				drive-strength = [03];
			};

			pins_dat {
				drive-strength = [03];
			};

			pins_clk {
				drive-strength = [03];
			};
		};

		msdc2@register_default {
			cmd_edge = [00];
			rdata_edge = [00];
			wdata_edge = [00];
			linux,phandle = <0x0f>;
			phandle = <0x0f>;
		};
	};

	dvfsp@10940000 {
		compatible = "mediatek,mt6763-dvfsp";
		reg = <0x00 0x10940000 0x00 0x10000 0x00 0x11bc00 0x00 0x1400>;
	};

	mcdi@0011b000 {
		compatible = "mediatek,mt6763-mcdi";
		reg = <0x00 0x11b000 0x00 0x800>;
	};

	sleep@10006000 {
		compatible = "mediatek,sleep";
		reg = <0x00 0x10006000 0x00 0x1000>;
		interrupts = <0x00 0xb1 0x08>;
	};

	toprgu@10007000 {
		compatible = "mediatek,mt6763-toprgu";
		reg = <0x00 0x10007000 0x00 0x1000>;
		interrupts = <0x00 0x8b 0x00 0x00 0xc8 0x04>;
	};

	rsvd@10009000 {
		compatible = "mediatek,rsvd";
		reg = <0x00 0x10009000 0x00 0x1000>;
	};

	hacc@1000a000 {
		compatible = "mediatek,hacc";
		reg = <0x00 0x1000a000 0x00 0x1000>;
		interrupts = <0x00 0xb9 0x08>;
	};

	eintc@1000b000 {
		compatible = "mediatek,mt-eic";
		reg = <0x00 0x1000b000 0x00 0x1000>;
		interrupts = <0x00 0xa7 0x04>;
		mediatek,max_hw_deb_cnt = <0x0d>;
		mediatek,max_deint_cnt = <0x04>;
		mediatek,deint_possible_irq = <0xcb 0xcc 0xcd 0xce>;
		#interrupt-cells = <0x02>;
		interrupt-controller;
		mediatek,max_eint_num = <0x98>;
		mediatek,debtime_setting_entry = <0x0a>;
		mediatek,debtime_setting_array = <0x00 0x80 0x01 0x100 0x02 0x200 0x03 0x400 0x04 0x4000 0x05 0x8000 0x06 0x10000 0x07 0x20000 0x08 0x40000 0x09 0x80000>;
		linux,phandle = <0x59>;
		phandle = <0x59>;
	};

	apmixed@1000c000 {
		compatible = "mediatek,apmixed";
		reg = <0x00 0x1000c000 0x00 0x1000>;
		#clock-cells = <0x01>;
		linux,phandle = <0x5a>;
		phandle = <0x5a>;
	};

	fhctl@1000ce00 {
		compatible = "mediatek,fhctl";
		reg = <0x00 0x1000ce00 0x00 0x1000>;
	};

	pwrap@1000d000 {
		compatible = "mediatek,pwrap";
		reg = <0x00 0x1000d000 0x00 0x1000>;
		interrupts = <0x00 0xaf 0x04>;

		pmic_irq {
			compatible = "mediatek,pmic-eint";
			interrupt-controller;
			linux,phandle = <0x5b>;
			phandle = <0x5b>;
		};
	};

	pwrap_mpu@1000d000 {
		compatible = "mediatek,pwrap_mpu";
		reg = <0x00 0x1000d000 0x00 0x1000>;
	};

	pwrap_p2p@1005e000 {
		compatible = "mediatek,pwrap_p2p";
		reg = <0x00 0x1005e000 0x00 0x1000>;
	};

	pwrap_md32@10448000 {
		compatible = "mediatek,pwrap_md32";
		reg = <0x00 0x10448000 0x00 0x1000>;
	};

	sleep_reg_md@1000f000 {
		compatible = "mediatek,sleep_reg_md";
		reg = <0x00 0x1000f000 0x00 0x1000>;
	};

	kp@10010000 {
		compatible = "mediatek,kp";
		reg = <0x00 0x10010000 0x00 0x1000>;
		interrupts = <0x00 0xb0 0x02>;
		linux,phandle = <0x5c>;
		phandle = <0x5c>;
	};

	topmisc@10011000 {
		compatible = "mediatek,topmisc";
		reg = <0x00 0x10011000 0x00 0x1000>;
	};

	dvfsrc_top@10012000 {
		compatible = "mediatek,dvfsrc_top";
		reg = <0x00 0x10012000 0x00 0x1000>;
	};

	apcldmain_ao@10014000 {
		compatible = "mediatek,apcldmain_ao";
		reg = <0x00 0x10014000 0x00 0x1000>;
	};

	mdcldma@10014000 {
		compatible = "mediatek,mdcldma";
		reg = <0x00 0x10014000 0x00 0x1000 0x00 0x1021b000 0x00 0x1000 0x00 0x10209000 0x00 0x1000 0x00 0x1020a000 0x00 0x1000>;
		interrupts = <0x00 0xa5 0x04 0x00 0x94 0x08 0x00 0x95 0x08 0x00 0x107 0x02>;
		mediatek,md_id = <0x00>;
		mediatek,cldma_capability = <0x06>;
		clocks = <0x2e 0x01 0x05 0x37 0x05 0x2e 0x05 0x31 0x05 0x26 0x05 0x27>;
		clock-names = "scp-sys-md1-main\0infra-cldma-bclk\0infra-ccif-ap\0infra-ccif-md\0infra-ccif1-ap\0infra-ccif1-md";
		linux,phandle = <0x5d>;
		phandle = <0x5d>;
	};

	apcldmaout_ao@10014400 {
		compatible = "mediatek,apcldmaout_ao";
		reg = <0x00 0x10014400 0x00 0x1000>;
	};

	apcldmamisc_ao@10014800 {
		compatible = "mediatek,apcldmamisc_ao";
		reg = <0x00 0x10014800 0x00 0x1000>;
	};

	mdcldmain_ao@10015000 {
		compatible = "mediatek,mdcldmain_ao";
		reg = <0x00 0x10015000 0x00 0x1000>;
	};

	mdcldmaout_ao@10015400 {
		compatible = "mediatek,mdcldmaout_ao";
		reg = <0x00 0x10015400 0x00 0x1000>;
	};

	mdcldmamisc_ao@10015800 {
		compatible = "mediatek,mdcldmamisc_ao";
		reg = <0x00 0x10015800 0x00 0x1000>;
	};

	aes_top0@10016000 {
		compatible = "mediatek,aes_top0";
		reg = <0x00 0x10016000 0x00 0x1000>;
	};

	sys_timer@10017000 {
		compatible = "mediatek,sys_timer";
		reg = <0x00 0x10017000 0x00 0x1000>;
		reg-names = "sys_timer_base";
		interrupts = <0x00 0xbe 0x04>;
	};

	modem_temp_share@10018000 {
		compatible = "mediatek,modem_temp_share";
		reg = <0x00 0x10018000 0x00 0x1000>;
	};

	mbist_ao@10013000 {
		compatible = "mediatek,mbist_ao";
		reg = <0x00 0x10013000 0x00 0x1000>;
	};

	security_ao@1001a000 {
		compatible = "mediatek,security_ao";
		reg = <0x00 0x1001a000 0x00 0x1000>;
	};

	topckgen_ao@1001b000 {
		compatible = "mediatek,topckgen_ao";
		reg = <0x00 0x1001b000 0x00 0x1000>;
	};

	dbgapb@0d000000 {
		compatible = "mediatek,dbgapb";
		reg = <0x00 0xd000000 0x00 0x1000>;
	};

	mcucfg@0c530000 {
		compatible = "mediatek,mcucfg";
		reg = <0x00 0xc530000 0x00 0x1000>;
		interrupts = <0x00 0x00 0x08>;
	};

	mp0_cpucfg@0c530000 {
		compatible = "mediatek,mp0_cpucfg";
		reg = <0x00 0xc530000 0x00 0x1000>;
	};

	mp1_cpucfg@0c530200 {
		compatible = "mediatek,mp1_cpucfg";
		reg = <0x00 0xc530200 0x00 0x1000>;
	};

	mcu_misccfg@0c530400 {
		compatible = "mediatek,mcu_misccfg";
		reg = <0x00 0xc530400 0x00 0x1000>;
	};

	mcu_misc1cfg@0c530800 {
		compatible = "mediatek,mcu_misc1cfg";
		reg = <0x00 0xc530800 0x00 0x1000>;
	};

	infracfg@1020e000 {
		compatible = "mediatek,infracfg";
		reg = <0x00 0x1020e000 0x00 0x1000>;
	};

	sramrom@10214000 {
		compatible = "mediatek,sramrom";
		reg = <0x00 0x10214000 0x00 0x1000>;
	};

	emi@10219000 {
		compatible = "mediatek,emi";
		reg = <0x00 0x10219000 0x00 0x1000 0x00 0x10226000 0x00 0x1000 0x00 0x1022d000 0x00 0x1000 0x00 0x10235000 0x00 0x1000>;
		interrupts = <0x00 0x90 0x08 0x00 0x91 0x04 0x00 0x98 0x04>;
	};

	sys_cirq@10204000 {
		compatible = "mediatek,sys_cirq";
		reg = <0x00 0x10204000 0x00 0x1000>;
		mediatek,cirq_num = <0xd0>;
		mediatek,spi_start_offset = <0x48>;
		interrupts = <0x00 0x118 0x08>;
	};

	m4u@10205000 {
		cell-index = <0x00>;
		compatible = "mediatek,m4u";
		reg = <0x00 0x10205000 0x00 0x1000>;
		interrupts = <0x00 0x9e 0x08>;
	};

	devapc@10207000 {
		compatible = "mediatek,devapc";
		reg = <0x00 0x10207000 0x00 0x1000>;
		interrupts = <0x00 0x8e 0x08>;
		clocks = <0x05 0x2d>;
		clock-names = "devapc-infra-clock";
	};

	bus_dbg@10208000 {
		compatible = "mediatek,bus_dbg-v2";
		reg = <0x00 0x10208000 0x00 0x1000>;
		interrupts = <0x00 0x8d 0x08>;
	};

	ap_ccif0@10209000 {
		compatible = "mediatek,ap_ccif0";
		reg = <0x00 0x10209000 0x00 0x1000>;
		interrupts = <0x00 0x94 0x08>;
	};

	md_ccif0@9020a000 {
		compatible = "mediatek,md_ccif0";
		reg = <0x00 0x9020a000 0x00 0x1000>;
	};

	ap_ccif1@1020b000 {
		compatible = "mediatek,ap_ccif1";
		reg = <0x00 0x1020b000 0x00 0x1000>;
		interrupts = <0x00 0x96 0x08>;
	};

	md_ccif1@9020c000 {
		compatible = "mediatek,md_ccif1";
		reg = <0x00 0x9020c000 0x00 0x1000>;
	};

	infra_mbist@1020d000 {
		compatible = "mediatek,infra_mbist";
		reg = <0x00 0x1020d000 0x00 0x1000>;
	};

	dramc_nao@1020e000 {
		compatible = "mediatek,dramc_nao";
		reg = <0x00 0x1020e000 0x00 0x1000>;
	};

	trng@1020f000 {
		compatible = "mediatek,trng";
		reg = <0x00 0x1020f000 0x00 0x1000>;
		interrupts = <0x00 0xa1 0x08>;
	};

	dxcc_sec@10210000 {
		compatible = "mediatek,dxcc_sec";
		reg = <0x00 0x10210000 0x00 0x1000>;
		interrupts = <0x00 0xa2 0x04>;
	};

	smi_common_ao@10211000 {
		compatible = "mediatek,smi_common_ao";
		reg = <0x00 0x10211000 0x00 0x1000>;
	};

	rccif_ps_c2k@90211000 {
		compatible = "mediatek,rccif_ps_c2k";
		reg = <0x00 0x90211000 0x00 0x1000>;
	};

	rccif_l1_c2k@90211400 {
		compatible = "mediatek,rccif_l1_c2k";
		reg = <0x00 0x90211400 0x00 0x1000>;
	};

	md2md_pccif_md1@90211800 {
		compatible = "mediatek,md2md_pccif_md1";
		reg = <0x00 0x90211800 0x00 0x1000>;
	};

	cq_dma@10212000 {
		compatible = "mediatek,mt-cqdma-v1";
		reg = <0x00 0x10212000 0x00 0x80 0x00 0x10212080 0x00 0x80 0x00 0x10212100 0x00 0x80>;
		interrupts = <0x00 0x71 0x08 0x00 0x72 0x08 0x00 0x73 0x08>;
		nr_channel = <0x03>;
		clocks = <0x05 0x4e>;
		clock-names = "cqdma";
	};

	rccif_c2k_ps@90213000 {
		compatible = "mediatek,rccif_c2k_ps";
		reg = <0x00 0x90213000 0x00 0x1000>;
	};

	rccif_c2k_l1@90213400 {
		compatible = "mediatek,rccif_c2k_l1";
		reg = <0x00 0x90213400 0x00 0x1000>;
	};

	md2md_pccif_md2@90213800 {
		compatible = "mediatek,md2md_pccif_md2";
		reg = <0x00 0x90213800 0x00 0x1000>;
	};

	mipi_tx0@11e50000 {
		compatible = "mediatek,mipi_tx0";
		reg = <0x00 0x11e50000 0x00 0x1000>;
	};

	mipi_tx1@10216000 {
		compatible = "mediatek,mipi_tx1";
		reg = <0x00 0x10216000 0x00 0x1000>;
	};

	mipi_rx_ana_csi0a@11c80000 {
		compatible = "mediatek,mipi_rx_ana_csi0a";
		reg = <0x00 0x11c80000 0x00 0x1000>;
	};

	mipi_rx_ana_csi0b@11c81000 {
		compatible = "mediatek,mipi_rx_ana_csi0b";
		reg = <0x00 0x11c81000 0x00 0x1000>;
	};

	mipi_rx_ana_csi1a@11c90000 {
		compatible = "mediatek,mipi_rx_ana_csi1a";
		reg = <0x00 0x11c90000 0x00 0x1000>;
	};

	mipi_rx_ana_csi1b@11c91000 {
		compatible = "mediatek,mipi_rx_ana_csi1b";
		reg = <0x00 0x11c91000 0x00 0x1000>;
	};

	gcpu_rsa@1021a000 {
		compatible = "mediatek,gcpu_rsa";
		reg = <0x00 0x1021a000 0x00 0x1000>;
	};

	apcldmain@1021b000 {
		compatible = "mediatek,apcldmain";
		reg = <0x00 0x1021b000 0x00 0x1000>;
	};

	apcldmaout@1021b400 {
		compatible = "mediatek,apcldmaout";
		reg = <0x00 0x1021b400 0x00 0x1000>;
	};

	apcldmamisc@1021b800 {
		compatible = "mediatek,apcldmamisc";
		reg = <0x00 0x1021b800 0x00 0x1000>;
		interrupts = <0x00 0xa5 0x04>;
	};

	mdcldmain@1021c000 {
		compatible = "mediatek,mdcldmain";
		reg = <0x00 0x1021c000 0x00 0x1000>;
	};

	mdcldmaout@1021c400 {
		compatible = "mediatek,mdcldmaout";
		reg = <0x00 0x1021c400 0x00 0x1000>;
	};

	mdcldmamisc@1021c800 {
		compatible = "mediatek,mdcldmamisc";
		reg = <0x00 0x1021c800 0x00 0x1000>;
	};

	infra_md@1021d000 {
		compatible = "mediatek,infra_md";
		reg = <0x00 0x1021d000 0x00 0x1000>;
	};

	infra_md_cfg@1021d000 {
		compatible = "mediatek,infra_md_cfg";
		reg = <0x00 0x1021d000 0x00 0x1000>;
	};

	bpi_bsi_slv0@1021e000 {
		compatible = "mediatek,bpi_bsi_slv0";
		reg = <0x00 0x1021e000 0x00 0x1000>;
	};

	bpi_bsi_slv1@1021f000 {
		compatible = "mediatek,bpi_bsi_slv1";
		reg = <0x00 0x1021f000 0x00 0x1000>;
	};

	bpi_bsi_slv2@10225000 {
		compatible = "mediatek,bpi_bsi_slv2";
		reg = <0x00 0x10225000 0x00 0x1000>;
	};

	dvfsp@10227000 {
		compatible = "mediatek,dvfsp";
		reg = <0x00 0x10227000 0x00 0x1000>;
		interrupts = <0x00 0xa3 0x08>;
	};

	dramc@1022a000 {
		compatible = "mediatek,dramc";
		reg = <0x00 0x1022a000 0x00 0x2000 0x00 0x10232000 0x00 0x2000 0x00 0x1022c000 0x00 0x1000 0x00 0x10234000 0x00 0x1000 0x00 0x10228000 0x00 0x2000 0x00 0x10230000 0x00 0x2000 0x00 0x1022e000 0x00 0x2000 0x00 0x10236000 0x00 0x2000>;
	};

	fmem_smi@10238000 {
		compatible = "mediatek,fmem_smi";
		reg = <0x00 0x10238000 0x00 0x1000>;
	};

	gce@10238000 {
		compatible = "mediatek,gce";
		reg = <0x00 0x10238000 0x00 0x1000>;
		interrupts = <0x00 0x9a 0x08 0x00 0x9b 0x08>;
		disp_mutex_reg = <0x14016000 0x1000>;
		g3d_config_base = <0x13000000 0x00 0xffff0000>;
		mmsys_config_base = <0x14000000 0x01 0xffff0000>;
		disp_dither_base = <0x14010000 0x02 0xffff0000>;
		mm_na_base = <0x14020000 0x03 0xffff0000>;
		imgsys_base = <0x15020000 0x04 0xffff0000>;
		vdec_gcon_base = <0x18800000 0x05 0xffff0000>;
		venc_gcon_base = <0x18810000 0x06 0xffff0000>;
		conn_peri_base = <0x18820000 0x07 0xffff0000>;
		topckgen_base = <0x18830000 0x08 0xffff0000>;
		kp_base = <0x18840000 0x09 0xffff0000>;
		scp_sram_base = <0x10000000 0x0a 0xffff0000>;
		infra_na3_base = <0x10010000 0x0b 0xffff0000>;
		infra_na4_base = <0x10020000 0x0c 0xffff0000>;
		scp_base = <0x10030000 0x0d 0xffff0000>;
		mcucfg_base = <0x10040000 0x0e 0xffff0000>;
		gcpu_base = <0x10050000 0x0f 0xffff0000>;
		usb0_base = <0x10200000 0x10 0xffff0000>;
		usb_sif_base = <0x10280000 0x11 0xffff0000>;
		audio_base = <0x17000000 0x12 0xffff0000>;
		vdec_base = <0x17010000 0x13 0xffff0000>;
		msdc2_base = <0x17020000 0x14 0xffff0000>;
		vdec1_base = <0x17030000 0x15 0xffff0000>;
		msdc3_base = <0x18000000 0x16 0xffff0000>;
		ap_dma_base = <0x18010000 0x17 0xffff0000>;
		gce_base = <0x18020000 0x18 0xffff0000>;
		vdec2_base = <0x18040000 0x19 0xffff0000>;
		vdec3_base = <0x18050000 0x1a 0xffff0000>;
		camsys_base = <0x18080000 0x1b 0xffff0000>;
		camsys1_base = <0x180a0000 0x1c 0xffff0000>;
		camsys2_base = <0x180b0000 0x1d 0xffff0000>;
		pwm_sw_base = <0x11000000 0x63 0xffff0000>;
		disp_rdma0_sof = <0x00>;
		disp_rdma1_sof = <0x01>;
		mdp_rdma0_sof = <0x02>;
		mdp_rsz0_sof = <0x04>;
		mdp_rsz1_sof = <0x05>;
		mdp_tdshp_sof = <0x06>;
		mdp_wrot0_sof = <0x07>;
		mdp_wdma_sof = <0x08>;
		disp_ovl0_sof = <0x09>;
		disp_2l_ovl0_sof = <0x0a>;
		disp_2l_ovl1_sof = <0x0b>;
		disp_wdma0_sof = <0x0c>;
		disp_color0_sof = <0x0d>;
		disp_ccorr0_sof = <0x0e>;
		disp_aal0_sof = <0x0f>;
		disp_gamma0_sof = <0x10>;
		disp_dither0_sof = <0x11>;
		disp_pwm0_sof = <0x12>;
		disp_dsi0_sof = <0x13>;
		disp_dpi0_sof = <0x14>;
		disp_rdma0_frame_done = <0x17>;
		disp_rdma1_frame_done = <0x18>;
		mdp_rdma0_frame_done = <0x19>;
		mdp_rsz0_frame_done = <0x1b>;
		mdp_rsz1_frame_done = <0x1c>;
		mdp_tdshp_frame_done = <0x1d>;
		mdp_wrot0_write_frame_done = <0x1e>;
		mdp_wdma_frame_done = <0x1f>;
		disp_ovl0_frame_done = <0x20>;
		disp_2l_ovl0_frame_done = <0x21>;
		disp_2l_ovl1_frame_done = <0x22>;
		disp_wdma0_frame_done = <0x23>;
		disp_color0_frame_done = <0x24>;
		disp_ccorr0_frame_done = <0x25>;
		disp_aal0_frame_done = <0x26>;
		disp_gamma0_frame_done = <0x27>;
		disp_dither0_frame_done = <0x28>;
		disp_dsi0_frame_done = <0x29>;
		disp_dpi0_frame_done = <0x2a>;
		stream_done_0 = <0x82>;
		stream_done_1 = <0x83>;
		stream_done_2 = <0x84>;
		stream_done_3 = <0x85>;
		stream_done_4 = <0x86>;
		stream_done_5 = <0x87>;
		stream_done_6 = <0x88>;
		stream_done_7 = <0x89>;
		stream_done_8 = <0x8a>;
		stream_done_9 = <0x8b>;
		stream_done_10 = <0x8c>;
		stream_done_11 = <0x8d>;
		buf_underrun_event_0 = <0x8e>;
		buf_underrun_event_1 = <0x8f>;
		dsi0_te_event = <0x90>;
		dsi0_irq_event = <0x91>;
		dsi0_done_event = <0x92>;
		disp_wdma0_rst_done = <0x96>;
		mdp_wdma_rst_done = <0x97>;
		mdp_wrot0_rst_done = <0x98>;
		mdp_rdma0_rst_done = <0x9a>;
		disp_ovl0_frame_rst_done_pusle = <0x9b>;
		disp_ovl0_2l_frame_rst_done_pusle = <0x9c>;
		disp_ovl1_2l_frame_rst_done_pusle = <0x9d>;
		dip_cq_thread0_frame_done = <0x101>;
		dip_cq_thread1_frame_done = <0x102>;
		dip_cq_thread2_frame_done = <0x103>;
		dip_cq_thread3_frame_done = <0x104>;
		dip_cq_thread4_frame_done = <0x105>;
		dip_cq_thread5_frame_done = <0x106>;
		dip_cq_thread6_frame_done = <0x107>;
		dip_cq_thread7_frame_done = <0x108>;
		dip_cq_thread8_frame_done = <0x109>;
		dip_cq_thread9_frame_done = <0x10a>;
		dip_cq_thread10_frame_done = <0x10b>;
		dip_cq_thread11_frame_done = <0x10c>;
		dip_cq_thread12_frame_done = <0x10d>;
		dip_cq_thread13_frame_done = <0x10e>;
		dip_cq_thread14_frame_done = <0x10f>;
		dve_frame_done = <0x110>;
		wmf_frame_done = <0x111>;
		gepf_frame_done = <0x112>;
		gepf_temp_frame_done = <0x113>;
		gepf_bypass_frame_done = <0x114>;
		rsc_frame_done = <0x115>;
		venc_done = <0x121>;
		jpgenc_done = <0x122>;
		jpgdec_done = <0x123>;
		venc_mb_done = <0x124>;
		venc_128byte_cnt_done = <0x125>;
		isp_frame_done_a = <0x141>;
		isp_frame_done_b = <0x142>;
		camsv_0_pass1_done = <0x143>;
		camsv_1_pass1_done = <0x144>;
		camsv_2_pass1_done = <0x145>;
		tsf_done = <0x146>;
		seninf_0_fifo_full = <0x147>;
		seninf_1_fifo_full = <0x148>;
		seninf_2_fifo_full = <0x149>;
		seninf_3_fifo_full = <0x14a>;
		seninf_4_fifo_full = <0x14b>;
		seninf_5_fifo_full = <0x14c>;
		seninf_6_fifo_full = <0x14d>;
		seninf_7_fifo_full = <0x14e>;
		dsi0_te_from_infra = <0x382>;
		max_prefetch_cnt = <0x04>;
		prefetch_size = <0x100 0x20 0x20 0x20>;
		sram_size_cpr_64 = <0x110>;
		mmsys_config = <0x2f>;
		mm_mutex = <0x30>;
		mdp_rdma0 = <0x31>;
		mdp_rdma1 = <0x32>;
		mdp_rsz0 = <0x33>;
		mdp_rsz1 = <0x34>;
		mdp_wrot0 = <0x35>;
		mdp_wdma0 = <0x36>;
		mdp_tdshp0 = <0x37>;
		disp_color0 = <0x38>;
		disp_ovl0 = <0x39>;
		disp_ovl0_2l = <0x3a>;
		disp_ovl1_2l = <0x3b>;
		venc = <0x3c>;
		msdc0 = <0x3d>;
		audio = <0x3e>;
		uart = <0x3f>;
		sram_share_cnt = <0x01>;
		sram_share_engine = <0x0b>;
		sram_share_event = <0x2c6>;
		clocks = <0x05 0x09 0x05 0x19>;
		clock-names = "GCE\0GCE_TIMER";
	};

	met_cci_pmu@10390000 {
		compatible = "mediatek,met_cci_pmu";
		reg = <0x00 0x10390000 0x00 0x10000>;
	};

	sspm@10440000 {
		compatible = "mediatek,sspm";
		reg = <0x00 0x10440000 0x00 0x1000 0x00 0x10450000 0x00 0x100 0x00 0x10451000 0x00 0x08 0x00 0x10460000 0x00 0x100 0x00 0x10461000 0x00 0x08 0x00 0x10470000 0x00 0x100 0x00 0x10471000 0x00 0x08 0x00 0x10480000 0x00 0x100 0x00 0x10481000 0x00 0x08 0x00 0x10490000 0x00 0x100 0x00 0x10491000 0x00 0x08>;
		reg-names = "cfgreg\0mbox0_base\0mbox0_ctrl\0mbox1_base\0mbox1_ctrl\0mbox2_base\0mbox2_ctrl\0mbox3_base\0mbox3_ctrl\0mbox4_base\0mbox4_ctrl";
		interrupts = <0x00 0xc6 0x04 0x00 0xc9 0x04 0x00 0xca 0x04 0x00 0xcb 0x04 0x00 0xcc 0x04 0x00 0xcd 0x04>;
		interrupt-names = "ipc\0mbox0\0mbox1\0mbox2\0mbox3\0mbox4";
	};

	ap_dma@11000000 {
		compatible = "mediatek,ap_dma";
		reg = <0x00 0x11000000 0x00 0x1000>;
		interrupts = <0x00 0x52 0x08>;
	};

	apuart0@11002000 {
		cell-index = <0x00>;
		compatible = "mediatek,mt6735-uart";
		reg = <0x00 0x11002000 0x00 0x1000 0x00 0x11000600 0x00 0x80 0x00 0x11000680 0x00 0x80>;
		interrupts = <0x00 0x5b 0x08 0x00 0x6c 0x08 0x00 0x6d 0x08>;
		clock-frequency = <0x18cba80>;
		clock-div = <0x01>;
		clocks = <0x05 0x15 0x05 0x2b>;
		clock-names = "uart0-main\0uart-apdma";
		linux,phandle = <0x3f>;
		phandle = <0x3f>;
	};

	apuart1@11003000 {
		cell-index = <0x01>;
		compatible = "mediatek,mt6735-uart";
		reg = <0x00 0x11003000 0x00 0x1000 0x00 0x11000700 0x00 0x80 0x00 0x11000780 0x00 0x80>;
		interrupts = <0x00 0x5c 0x08 0x00 0x6e 0x08 0x00 0x6f 0x08>;
		clock-frequency = <0x18cba80>;
		clock-div = <0x01>;
		clocks = <0x05 0x16>;
		clock-names = "uart1-main";
		linux,phandle = <0x5e>;
		phandle = <0x5e>;
	};

	auxadc@11001000 {
		compatible = "mediatek,auxadc";
		reg = <0x00 0x11001000 0x00 0x1000>;
		interrupts = <0x00 0x4a 0x00>;
		clocks = <0x05 0x24>;
		clock-names = "auxadc-main";
		linux,phandle = <0x5f>;
		phandle = <0x5f>;
	};

	pwm@11006000 {
		compatible = "mediatek,pwm";
		reg = <0x00 0x11006000 0x00 0x1000>;
		interrupts = <0x00 0x4d 0x08>;
		clocks = <0x05 0x10 0x05 0x11 0x05 0x12 0x05 0x13 0x05 0x0f 0x05 0x14>;
		clock-names = "PWM1-main\0PWM2-main\0PWM3-main\0PWM4-main\0PWM-HCLK-main\0PWM-main";
	};

	i2c@11007000 {
		compatible = "mediatek,mt6763-i2c";
		id = <0x00>;
		reg = <0x00 0x11007000 0x00 0x1000 0x00 0x11000100 0x00 0x80>;
		interrupts = <0x00 0x54 0x08>;
		clocks = <0x05 0x0b 0x05 0x2b>;
		clock-names = "main\0dma";
		clock-div = <0x05>;
		mediatek,have-dcm;
		linux,phandle = <0x60>;
		phandle = <0x60>;
	};

	i2c@11014000 {
		compatible = "mediatek,mt6763-i2c";
		id = <0x01>;
		reg = <0x00 0x11014000 0x00 0x1000 0x00 0x11000380 0x00 0x80>;
		interrupts = <0x00 0x83 0x08>;
		clocks = <0x05 0x49 0x05 0x2b 0x05 0x48>;
		clock-names = "main\0dma\0arb";
		clock-div = <0x05>;
		mediatek,have-dcm;
		linux,phandle = <0x61>;
		phandle = <0x61>;
	};

	i2c@11015000 {
		compatible = "mediatek,mt6763-i2c";
		id = <0x02>;
		reg = <0x00 0x11015000 0x00 0x1000 0x00 0x11000400 0x00 0x80>;
		interrupts = <0x00 0x84 0x08>;
		clocks = <0x05 0x4b 0x05 0x2b 0x05 0x4a>;
		clock-names = "main\0dma\0arb";
		clock-div = <0x05>;
		mediatek,have-dcm;
		linux,phandle = <0x62>;
		phandle = <0x62>;
	};

	i2c@1100f000 {
		compatible = "mediatek,mt6763-i2c";
		id = <0x05>;
		reg = <0x00 0x1100f000 0x00 0x1000 0x00 0x11000280 0x00 0x80>;
		interrupts = <0x00 0x57 0x08>;
		clocks = <0x05 0x0e 0x05 0x2b>;
		clock-names = "main\0dma";
		clock-div = <0x05>;
		mediatek,have-dcm;
		linux,phandle = <0x63>;
		phandle = <0x63>;
	};

	i2c@11011000 {
		compatible = "mediatek,mt6763-i2c";
		id = <0x03>;
		reg = <0x00 0x11011000 0x00 0x1000 0x00 0x11000300 0x00 0x80>;
		interrupts = <0x00 0x58 0x08>;
		clocks = <0x05 0x3a 0x05 0x2b>;
		clock-names = "main\0dma";
		clock-div = <0x05>;
		mediatek,have-dcm;
		linux,phandle = <0x64>;
		phandle = <0x64>;
	};

	i2c@11017000 {
		compatible = "mediatek,mt6763-i2c";
		id = <0x04>;
		reg = <0x00 0x11017000 0x00 0x1000 0x00 0x11000500 0x00 0x80>;
		interrupts = <0x00 0x85 0x08>;
		clocks = <0x05 0x47 0x05 0x2b 0x05 0x46>;
		clock-names = "main\0dma\0arb";
		clock-div = <0x05>;
		mediatek,have-dcm;
		linux,phandle = <0x65>;
		phandle = <0x65>;
	};

	i2c@11005000 {
		compatible = "mediatek,mt6763-i2c";
		id = <0x06>;
		reg = <0x00 0x11005000 0x00 0x1000 0x00 0x11000580 0x00 0x80>;
		interrupts = <0x00 0x59 0x08>;
		clocks = <0x05 0x58 0x05 0x2b>;
		clock-names = "main\0dma";
		clock-div = <0x05>;
		mediatek,have-dcm;
		mediatek,hs_only;
		linux,phandle = <0x66>;
		phandle = <0x66>;
	};

	i2c@11008000 {
		compatible = "mediatek,mt6763-i2c";
		id = <0x07>;
		reg = <0x00 0x11008000 0x00 0x1000 0x00 0x11000180 0x00 0x80>;
		interrupts = <0x00 0x55 0x08>;
		clocks = <0x05 0x0c 0x05 0x2b 0x05 0x48>;
		clock-names = "main\0dma\0arb";
		clock-div = <0x05>;
		mediatek,have-dcm;
		mediatek,buffermode_used;
		linux,phandle = <0x67>;
		phandle = <0x67>;
	};

	i2c@11009000 {
		compatible = "mediatek,mt6763-i2c";
		id = <0x08>;
		reg = <0x00 0x11009000 0x00 0x1000 0x00 0x11000200 0x00 0x80>;
		interrupts = <0x00 0x56 0x08>;
		clocks = <0x05 0x0d 0x05 0x2b 0x05 0x4a>;
		clock-names = "main\0dma\0arb";
		clock-div = <0x05>;
		mediatek,have-dcm;
		mediatek,buffermode_used;
		linux,phandle = <0x68>;
		phandle = <0x68>;
	};

	i2c@11016000 {
		compatible = "mediatek,mt6763-i2c";
		id = <0x09>;
		reg = <0x00 0x11016000 0x00 0x1000 0x00 0x11000480 0x00 0x80>;
		interrupts = <0x00 0x82 0x08>;
		clocks = <0x05 0x45 0x05 0x2b 0x05 0x46>;
		clock-names = "main\0dma\0arb";
		clock-div = <0x05>;
		mediatek,have-dcm;
		mediatek,buffermode_used;
		linux,phandle = <0x69>;
		phandle = <0x69>;
	};

	spi@1100a000 {
		compatible = "mediatek,mt6763-spi";
		cell-index = <0x00>;
		spi-padmacro = <0x00>;
		dma_addrmask = <0x24>;
		reg = <0x00 0x1100a000 0x00 0x1000>;
		interrupts = <0x00 0x76 0x08>;
		clocks = <0x05 0x1c>;
		clock-names = "main";
		clock-frequency = <0x67f3540>;
		clock-div = <0x01>;
		linux,phandle = <0x6a>;
		phandle = <0x6a>;
	};

	spi@11010000 {
		compatible = "mediatek,mt6763-spi";
		cell-index = <0x01>;
		spi-padmacro = <0x00>;
		dma_addrmask = <0x24>;
		reg = <0x00 0x11010000 0x00 0x1000>;
		interrupts = <0x00 0x7a 0x08>;
		clocks = <0x05 0x39>;
		clock-names = "main";
		clock-frequency = <0x67f3540>;
		clock-div = <0x01>;
		linux,phandle = <0x6b>;
		phandle = <0x6b>;
	};

	spi@11012000 {
		compatible = "mediatek,mt6763-spi";
		cell-index = <0x02>;
		spi-padmacro = <0x00>;
		dma_addrmask = <0x24>;
		reg = <0x00 0x11012000 0x00 0x1000>;
		interrupts = <0x00 0x80 0x08>;
		clocks = <0x05 0x3c>;
		clock-names = "main";
		clock-frequency = <0x67f3540>;
		clock-div = <0x01>;
		linux,phandle = <0x6c>;
		phandle = <0x6c>;
	};

	spi@11013000 {
		compatible = "mediatek,mt6763-spi";
		cell-index = <0x03>;
		spi-padmacro = <0x00>;
		dma_addrmask = <0x24>;
		reg = <0x00 0x11013000 0x00 0x1000>;
		interrupts = <0x00 0x81 0x08>;
		clocks = <0x05 0x3d>;
		clock-names = "main";
		clock-frequency = <0x67f3540>;
		clock-div = <0x01>;
		linux,phandle = <0x6d>;
		phandle = <0x6d>;
	};

	spi@11018000 {
		compatible = "mediatek,mt6763-spi";
		cell-index = <0x04>;
		spi-padmacro = <0x00>;
		dma_addrmask = <0x24>;
		reg = <0x00 0x11018000 0x00 0x1000>;
		interrupts = <0x00 0x86 0x08>;
		clocks = <0x05 0x4c>;
		clock-names = "main";
		clock-frequency = <0x67f3540>;
		clock-div = <0x01>;
		linux,phandle = <0x6e>;
		phandle = <0x6e>;
	};

	spi@11019000 {
		compatible = "mediatek,mt6763-spi";
		cell-index = <0x05>;
		spi-padmacro = <0x00>;
		dma_addrmask = <0x24>;
		reg = <0x00 0x11019000 0x00 0x1000>;
		interrupts = <0x00 0x87 0x08>;
		clocks = <0x05 0x4d>;
		clock-names = "main";
		clock-frequency = <0x67f3540>;
		clock-div = <0x01>;
		linux,phandle = <0x6f>;
		phandle = <0x6f>;
	};

	therm_ctrl@1100b000 {
		compatible = "mediatek,therm_ctrl";
		reg = <0x00 0x1100b000 0x00 0x1000>;
		interrupts = <0x00 0x4e 0x08>;
		clocks = <0x05 0x0a>;
		clock-names = "therm-main";
	};

	eem_fsm@1100b000 {
		compatible = "mediatek,eem_fsm";
		reg = <0x00 0x1100b000 0x00 0x1000>;
		interrupts = <0x00 0x7d 0x08>;
		clocks = <0x2e 0x07 0x2e 0x04 0x2e 0x0b 0x2e 0x0a>;
		clock-names = "mfg-async\0mfg\0mfg-core0\0mfg-core1";
	};

	btif@1100c000 {
		compatible = "mediatek,btif";
		#address-cells = <0x02>;
		#size-cells = <0x02>;
		reg = <0x00 0x1100c000 0x00 0x1000 0x00 0x11000900 0x00 0x80 0x00 0x11000980 0x00 0x80>;
		interrupts = <0x00 0x70 0x08 0x00 0x5f 0x08 0x00 0x60 0x08>;
		clocks = <0x05 0x1b 0x05 0x2b>;
		clock-names = "btifc\0apdmac";
	};

	irtx@1100d000 {
		compatible = "mediatek,irtx";
		reg = <0x00 0x1100d000 0x00 0x1000>;
		interrupts = <0x00 0x7f 0x00>;
	};

	disp_pwm0@1100e000 {
		compatible = "mediatek,disp_pwm0";
		reg = <0x00 0x1100e000 0x00 0x1000>;
		interrupts = <0x00 0x7e 0x08>;
	};

	usb0@11200000 {
		compatible = "mediatek,mt6763-usb20";
		reg = <0x00 0x11200000 0x00 0x10000 0x00 0x11f40000 0x00 0x10000>;
		interrupts = <0x00 0x49 0x08>;
		mode = <0x02>;
		multipoint = <0x01>;
		num_eps = <0x10>;
		clocks = <0x05 0x08>;
		clock-names = "usb0";
	};

	usb_sif@11210000 {
		compatible = "mediatek,usb_sif";
		reg = <0x00 0x11210000 0x00 0x1000>;
	};

	audio@11220000 {
		compatible = "mediatek,audio\0syscon";
		reg = <0x00 0x11220000 0x00 0x1000>;
		#clock-cells = <0x01>;
		linux,phandle = <0x3e>;
		phandle = <0x3e>;
	};

	mt_soc_dl1_pcm@11220000 {
		compatible = "mediatek,mt_soc_pcm_dl1";
		reg = <0x00 0x11220000 0x00 0x1000>;
		interrupts = <0x00 0x99 0x08>;
		clocks = <0x3e 0x0a 0x3e 0x03 0x3e 0x02 0x3e 0x04 0x3e 0x08 0x3e 0x07 0x3e 0x05 0x3e 0x06 0x3e 0x01 0x2e 0x08 0x05 0x30 0x05 0x38 0x40 0x10 0x40 0x11 0x40 0x2f 0x40 0x18 0x40 0x4d 0x40 0x19 0x40 0x51 0x40 0x24 0x40 0x50 0x40 0x25 0x40 0x54 0x41>;
		clock-names = "aud_afe_clk\0aud_dac_clk\0aud_dac_predis_clk\0aud_adc_clk\0aud_apll22m_clk\0aud_apll24m_clk\0aud_apll1_tuner_clk\0aud_apll2_tuner_clk\0aud_tml_clk\0scp_sys_audio\0aud_infra_clk\0mtkaif_26m_clk\0top_mux_audio\0top_mux_audio_int\0top_sys_pll1_d4\0top_mux_aud_1\0top_apll1_ck\0top_mux_aud_2\0top_apll2_ck\0top_mux_aud_eng1\0top_apll1_d8\0top_mux_aud_eng2\0top_apll2_d8\0top_clk26m_clk";
		linux,phandle = <0x70>;
		phandle = <0x70>;
	};

	audio_sram@11221000 {
		compatible = "mediatek,audio_sram";
		reg = <0x00 0x11221000 0x00 0xc000>;
	};

	ufshci@11270000 {
		compatible = "mediatek,ufshci";
		reg = <0x00 0x11270000 0x00 0x2300>;
		interrupts = <0x00 0x53 0x08>;
		clocks = <0x05 0x4f 0x05 0x40>;
		clock-names = "ufs0-clock\0ufs0-mp-clk";
		freq-table-hz = <0x00 0x00 0x00 0x00>;
		vcc-supply = <0x04>;
		vcc-fixed-regulator;
		mediatek,auto-hibern8-timer = <0x0a>;
		mediatek,spm-level = <0x03>;
		mediatek,rpm-enable = <0x01>;
		mediatek,rpm-autosuspend-delay = <0x7d0>;
		mediatek,rpm-level = <0x03>;
		pinctrl-names = "state_va09_on\0state_va09_off";
		pinctrl-0 = <0x42>;
		pinctrl-1 = <0x43>;
		status = "okay";
		linux,phandle = <0x71>;
		phandle = <0x71>;
	};

	ufs_mphy@11fa0000 {
		compatible = "mediatek,ufs_mphy";
		reg = <0x00 0x11fa0000 0x00 0xc000>;
	};

	ca9peri@10e00000 {
		compatible = "mediatek,ca9peri";
		reg = <0x00 0x10e00000 0x00 0x1000>;
	};

	l2c@10f00000 {
		compatible = "mediatek,l2c";
		reg = <0x00 0x10f00000 0x00 0x1000>;
	};

	efusec@11f10000 {
		compatible = "mediatek,efusec";
		reg = <0x00 0x11f10000 0x00 0x1000>;
	};

	mfgcfg@13000000 {
		compatible = "mediatek,mfgcfg\0syscon";
		reg = <0x00 0x13000000 0x00 0x1000>;
		#clock-cells = <0x01>;
		linux,phandle = <0x44>;
		phandle = <0x44>;
	};

	mali@13040000 {
		compatible = "arm,malit860\0arm,mali-t86x\0arm,malit8xx\0arm,mali-midgard";
		reg = <0x00 0x13040000 0x00 0x4000>;
		interrupts = <0x00 0x104 0x08 0x00 0x103 0x08 0x00 0x102 0x08>;
		interrupt-names = "JOB\0MMU\0GPU";
		clocks = <0x44 0x01 0x2e 0x07 0x2e 0x04 0x2e 0x0b 0x2e 0x0a>;
		clock-names = "subsys-mfg-cg\0mtcmos-mfg-async\0mtcmos-mfg\0mtcmos-mfg-core0\0mtcmos-mfg-core1";
	};

	mali_tb@1307f000 {
		compatible = "mediatek,mali_tb";
		reg = <0x00 0x1307f000 0x00 0x1000>;
	};

	mfg_dfp_60@13020000 {
		compatible = "mediatek,mfg_dfp_60";
		reg = <0x00 0x13020000 0x00 0x1000>;
		interrupts = <0x00 0x106 0x08>;
	};

	gpufreq {
		compatible = "mediatek,mt6763-gpufreq";
		clocks = <0x40 0x06 0x40 0x67 0x41>;
		clock-names = "clk_mux\0clk_main_parent\0clk_sub_parent";
	};

	mmsys_config@14000000 {
		compatible = "mediatek,mmsys_config\0syscon";
		reg = <0x00 0x14000000 0x00 0x1000>;
		interrupts = <0x00 0xe4 0x08>;
		#clock-cells = <0x01>;
		clocks = <0x2f 0x0b 0x2f 0x26>;
		clock-names = "CAM_MDP_TX\0CAM_MDP_RX";
		linux,phandle = <0x2f>;
		phandle = <0x2f>;
	};

	nfc {
		compatible = "mediatek,nfc-gpio-v2";
		gpio-rst = <0x19>;
		gpio-rst-std = <0x0b 0x19 0x00>;
		gpio-irq = <0x1a>;
		gpio-irq-std = <0x0b 0x1a 0x00>;
		linux,phandle = <0x72>;
		phandle = <0x72>;
	};

	gps {
		compatible = "mediatek,gps";
	};

	flashlight_core {
		compatible = "mediatek,flashlight_core";
		linux,phandle = <0x73>;
		phandle = <0x73>;
	};

	flashlights_mt6370 {
		compatible = "mediatek,flashlights_mt6370";
		linux,phandle = <0x74>;
		phandle = <0x74>;
	};

	irq_nfc {
		compatible = "mediatek,irq_nfc-eint";
		linux,phandle = <0x75>;
		phandle = <0x75>;
	};

	mtkfb@0 {
		compatible = "mediatek,mtkfb";
		linux,phandle = <0x76>;
		phandle = <0x76>;
	};

	als_ps@0 {
		compatible = "mediatek,als_ps";
		linux,phandle = <0x77>;
		phandle = <0x77>;
	};

	mse {
		compatible = "mediatek,fix_build_error";
		linux,phandle = <0x78>;
		phandle = <0x78>;
	};

	gyro {
		compatible = "mediatek,fix_build_error";
		linux,phandle = <0x79>;
		phandle = <0x79>;
	};

	touch {
		compatible = "mediatek,mt6763-touch";
		linux,phandle = <0x7a>;
		phandle = <0x7a>;
	};

	accdet {
		compatible = "mediatek,pmic-accdet";
		linux,phandle = <0x7b>;
		phandle = <0x7b>;
	};

	mt6356_gauge {
		compatible = "mediatek,mt6356_gauge";
		gauge_name = "gauge";
		alias_name = "MT6356";
	};

	gauge_timer {
		compatible = "mediatek,gauge_timer_service";
	};

	dispsys@14000000 {
		compatible = "mediatek,dispsys";
		clocks = <0x2e 0x03 0x2f 0x01 0x2f 0x02 0x2f 0x03 0x2f 0x04 0x2f 0x05 0x2f 0x06 0x2f 0x07 0x2f 0x08 0x2f 0x09 0x2f 0x0a 0x2f 0x15 0x2f 0x16 0x2f 0x17 0x2f 0x18 0x2f 0x19 0x2f 0x1a 0x2f 0x1b 0x2f 0x1c 0x2f 0x1d 0x2f 0x1e 0x2f 0x1f 0x2f 0x20 0x2f 0x21 0x2f 0x22 0x2f 0x23 0x2f 0x24 0x2f 0x28 0x2f 0x2a 0x40 0x02 0x40 0x1a 0x05 0x36 0x41 0x40 0x46 0x40 0x61 0x40 0x63 0x40 0x16 0x40 0x56 0x40 0x57 0x40 0x58 0x40 0x59 0x40 0x55>;
		clock-names = "MMSYS_MTCMOS\0MMSYS_SMI_COMMON\0MMSYS_SMI_LARB0\0MMSYS_SMI_LARB1\0MMSYS_GALS_COMM0\0MMSYS_GALS_COMM1\0MMSYS_GALS_VENC2MM\0MMSYS_GALS_VDEC2MM\0MMSYS_GALS_IMG2MM\0MMSYS_GALS_CAM2MM\0MMSYS_GALS_IPU2MM\0MMSYS_DISP_OVL0\0MMSYS_DISP_OVL0_2L\0MMSYS_DISP_OVL1_2L\0MMSYS_DISP_RDMA0\0MMSYS_DISP_RDMA1\0MMSYS_DISP_WDMA0\0MMSYS_DISP_COLOR0\0MMSYS_DISP_CCORR0\0MMSYS_DISP_AAL0\0MMSYS_DISP_GAMMA0\0MMSYS_DISP_DITHER0\0MMSYS_DISP_SPLIT\0MMSYS_DSI0_MM_CK\0MMSYS_DSI0_IF_CK\0MMSYS_DPI_MM_CK\0MMSYS_DPI_IF_CK\0MMSYS_26M\0MMSYS_DISP_RSZ\0TOP_MUX_MM\0TOP_MUX_DISP_PWM\0DISP_PWM\0TOP_26M\0TOP_UNIVPLL2_D4\0TOP_OSC_D4\0TOP_OSC_D16\0MUX_DPI0\0TVDPLL_D2\0TVDPLL_D4\0TVDPLL_D8\0TVDPLL_D16\0DPI_CK";
		linux,phandle = <0x7c>;
		phandle = <0x7c>;
	};

	dsi_te {
		compatible = "mediatek, dsi_te-eint";
		status = "disabled";
		linux,phandle = <0x7d>;
		phandle = <0x7d>;
	};

	dsi_te_1 {
		compatible = "mediatek, dsi_te_1-eint";
		status = "disabled";
		linux,phandle = <0x7e>;
		phandle = <0x7e>;
	};

	mhl@0 {
		compatible = "mediatek,extd_dev";
		linux,phandle = <0x7f>;
		phandle = <0x7f>;
	};

	eint_hdmi_hpd@0 {
		compatible = "mediatek,hdmi_dev";
		linux,phandle = <0x80>;
		phandle = <0x80>;
	};

	mdp_rdma0@14001000 {
		compatible = "mediatek,mdp_rdma0";
		reg = <0x00 0x14001000 0x00 0x1000>;
		interrupts = <0x00 0xcf 0x08>;
		clocks = <0x2f 0x0d>;
		clock-names = "MDP_RDMA0";
		linux,phandle = <0x31>;
		phandle = <0x31>;
	};

	mdp_rdma1@14002000 {
		compatible = "mediatek,mdp_rdma1";
		reg = <0x00 0x14002000 0x00 0x1000>;
		interrupts = <0x00 0xd0 0x08>;
		clocks = <0x2f 0x0e>;
		clock-names = "MDP_RDMA1";
		linux,phandle = <0x32>;
		phandle = <0x32>;
	};

	mdp_rsz0@14003000 {
		compatible = "mediatek,mdp_rsz0";
		reg = <0x00 0x14003000 0x00 0x1000>;
		interrupts = <0x00 0xd1 0x08>;
		clocks = <0x2f 0x0f>;
		clock-names = "MDP_RSZ0";
		linux,phandle = <0x33>;
		phandle = <0x33>;
	};

	mdp_rsz1@14004000 {
		compatible = "mediatek,mdp_rsz1";
		reg = <0x00 0x14004000 0x00 0x1000>;
		interrupts = <0x00 0xd2 0x08>;
		clocks = <0x2f 0x10>;
		clock-names = "MDP_RSZ1";
		linux,phandle = <0x34>;
		phandle = <0x34>;
	};

	mdp_wrot0@14005000 {
		compatible = "mediatek,mdp_wrot0";
		reg = <0x00 0x14005000 0x00 0x1000>;
		interrupts = <0x00 0xd4 0x08>;
		clocks = <0x2f 0x12>;
		clock-names = "MDP_WROT0";
		linux,phandle = <0x35>;
		phandle = <0x35>;
	};

	mdp_wdma@14006000 {
		compatible = "mediatek,mdp_wdma";
		reg = <0x00 0x14006000 0x00 0x1000>;
		interrupts = <0x00 0xd5 0x08>;
		clocks = <0x2f 0x13>;
		clock-names = "MDP_WDMA";
		linux,phandle = <0x36>;
		phandle = <0x36>;
	};

	mdp_tdshp@14007000 {
		compatible = "mediatek,mdp_tdshp";
		reg = <0x00 0x14007000 0x00 0x1000>;
		interrupts = <0x00 0xd3 0x08>;
		clocks = <0x2f 0x11>;
		clock-names = "MDP_TDSHP";
		linux,phandle = <0x37>;
		phandle = <0x37>;
	};

	disp_ovl0@14008000 {
		compatible = "mediatek,disp_ovl0";
		reg = <0x00 0x14008000 0x00 0x1000>;
		interrupts = <0x00 0xd6 0x08>;
		clocks = <0x2f 0x15>;
		clock-names = "DISP_OVL0";
		linux,phandle = <0x39>;
		phandle = <0x39>;
	};

	disp_ovl0_2l@14009000 {
		compatible = "mediatek,disp_ovl0_2l";
		reg = <0x00 0x14009000 0x00 0x1000>;
		interrupts = <0x00 0xd7 0x08>;
		clocks = <0x2f 0x16>;
		clock-names = "DISP_OVL0_2L";
		linux,phandle = <0x3a>;
		phandle = <0x3a>;
	};

	disp_ovl1_2l@1400a000 {
		compatible = "mediatek,disp_ovl1_2l";
		reg = <0x00 0x1400a000 0x00 0x1000>;
		interrupts = <0x00 0xd8 0x08>;
		clocks = <0x2f 0x17>;
		clock-names = "DISP_OVL1_2L";
		linux,phandle = <0x3b>;
		phandle = <0x3b>;
	};

	disp_rdma0@1400b000 {
		compatible = "mediatek,disp_rdma0";
		reg = <0x00 0x1400b000 0x00 0x1000>;
		interrupts = <0x00 0xd9 0x08>;
	};

	disp_rdma1@1400c000 {
		compatible = "mediatek,disp_rdma1";
		reg = <0x00 0x1400c000 0x00 0x1000>;
		interrupts = <0x00 0xda 0x08>;
	};

	disp_wdma0@1400d000 {
		compatible = "mediatek,disp_wdma0";
		reg = <0x00 0x1400d000 0x00 0x1000>;
		interrupts = <0x00 0xdb 0x08>;
	};

	disp_color0@1400e000 {
		compatible = "mediatek,disp_color0";
		reg = <0x00 0x1400e000 0x00 0x1000>;
		interrupts = <0x00 0xdc 0x08>;
		clocks = <0x2f 0x1b>;
		clock-names = "MDP_COLOR";
		linux,phandle = <0x38>;
		phandle = <0x38>;
	};

	disp_ccorr0@1400f000 {
		compatible = "mediatek,disp_ccorr0";
		reg = <0x00 0x1400f000 0x00 0x1000>;
		interrupts = <0x00 0xdd 0x08>;
	};

	disp_aal0@14010000 {
		compatible = "mediatek,disp_aal0";
		reg = <0x00 0x14010000 0x00 0x1000>;
		interrupts = <0x00 0xde 0x08>;
		aal_support = <0x01>;
		linux,phandle = <0x81>;
		phandle = <0x81>;
	};

	disp_gamma0@14011000 {
		compatible = "mediatek,disp_gamma0";
		reg = <0x00 0x14011000 0x00 0x1000>;
		interrupts = <0x00 0xdf 0x08>;
	};

	disp_dither0@14012000 {
		compatible = "mediatek,disp_dither0";
		reg = <0x00 0x14012000 0x00 0x1000>;
		interrupts = <0x00 0xe0 0x08>;
	};

	disp_split@14013000 {
		compatible = "mediatek,disp_split";
		reg = <0x00 0x14013000 0x00 0x1000>;
	};

	dsi0@14014000 {
		compatible = "mediatek,dsi0";
		reg = <0x00 0x14014000 0x00 0x1000>;
		interrupts = <0x00 0xe1 0x08>;
	};

	dpi0@14015000 {
		compatible = "mediatek,dpi0";
		reg = <0x00 0x14015000 0x00 0x1000>;
		interrupts = <0x00 0xe2 0x08>;
	};

	disp_mutex@14016000 {
		compatible = "mediatek,disp_mutex";
		reg = <0x00 0x14016000 0x00 0x1000>;
		interrupts = <0x00 0xce 0x08>;
		linux,phandle = <0x30>;
		phandle = <0x30>;
	};

	smi_larb0@14017000 {
		compatible = "mediatek,smi_larb0";
		reg = <0x00 0x14017000 0x00 0x1000>;
		interrupts = <0x00 0xe5 0x08>;
		clocks = <0x2e 0x03 0x2f 0x02>;
		clock-names = "mtcmos-mm\0mm-larb0";
		linux,phandle = <0x45>;
		phandle = <0x45>;
	};

	smi_common@14019000 {
		compatible = "mediatek,smi_common";
		reg = <0x00 0x14019000 0x00 0x1000>;
		larbs = <0x45 0x46 0x47 0x48>;
		clocks = <0x2e 0x03 0x2f 0x04 0x2f 0x05 0x2f 0x01 0x40 0x66 0x40 0x04 0x40 0x66 0x40 0x55>;
		clock-names = "mtcmos-mm\0smi-common-gals0\0smi-common-gals1\0smi-common\0MMDVFS_CLK_TOP_MMPLL_CK\0MMDVFS_CLK_MUX_TOP_CAM_SEL\0mmdvfs_clk_top_mmpll_ck\0mmdvfs_clk_top_tvdpll_ck";
	};

	disp_rsz@1401a000 {
		compatible = "mediatek,disp_rsz";
		reg = <0x00 0x1401a000 0x00 0x1000>;
	};

	disp_dbi@1401b000 {
		compatible = "mediatek,disp_dbi";
		reg = <0x00 0x1401b000 0x00 0x1000>;
	};

	i2c@1401c000 {
		compatible = "mediatek,i2c";
		reg = <0x00 0x1401c000 0x00 0x1000>;
	};

	dsi1@1401d000 {
		compatible = "mediatek,dsi1";
		reg = <0x00 0x1401d000 0x00 0x1000>;
	};

	mdp_wrot1@1401e000 {
		compatible = "mediatek,mdp_wrot1";
		reg = <0x00 0x1401e000 0x00 0x1000>;
	};

	vdec_gcon@17000000 {
		compatible = "mediatek,vdec_gcon";
		reg = <0x00 0x17000000 0x00 0x1000>;
		clocks = <0x49 0x04 0x49 0x02 0x2e 0x06 0x2e 0x06>;
		clock-names = "MT_CG_VDEC\0MT_CG_VENC\0MT_SCP_SYS_VDE\0MT_SCP_SYS_VEN";
		#clock-cells = <0x01>;
	};

	vdec@17040000 {
		compatible = "mediatek,vdec";
		reg = <0x00 0x17040000 0x00 0x10000>;
		interrupts = <0x00 0xe9 0x08>;
	};

	vld@17040000 {
		compatible = "mediatek,vld";
		reg = <0x00 0x17040000 0x00 0x1000>;
	};

	vld_top@17040800 {
		compatible = "mediatek,vld_top";
		reg = <0x00 0x17040800 0x00 0x1000>;
	};

	mc@17041000 {
		compatible = "mediatek,mc";
		reg = <0x00 0x17041000 0x00 0x1000>;
	};

	avc_vld@17042000 {
		compatible = "mediatek,avc_vld";
		reg = <0x00 0x17042000 0x00 0x1000>;
	};

	avc_mv@17043000 {
		compatible = "mediatek,avc_mv";
		reg = <0x00 0x17043000 0x00 0x1000>;
	};

	vdec_pp@17044000 {
		compatible = "mediatek,vdec_pp";
		reg = <0x00 0x17044000 0x00 0x1000>;
	};

	vdtop@17045000 {
		compatible = "mediatek,vdtop";
		reg = <0x00 0x17045000 0x00 0x1000>;
	};

	vp6@17046000 {
		compatible = "mediatek,vp6";
		reg = <0x00 0x17046000 0x00 0x1000>;
	};

	hevc_vld@17048000 {
		compatible = "mediatek,hevc_vld";
		reg = <0x00 0x17048000 0x00 0x1000>;
	};

	vp8_vld@17046800 {
		compatible = "mediatek,vp8_vld";
		reg = <0x00 0x17046800 0x00 0x1000>;
	};

	vld2@17047800 {
		compatible = "mediatek,vld2";
		reg = <0x00 0x17047800 0x00 0x1000>;
	};

	mc_vmmu@17048000 {
		compatible = "mediatek,mc_vmmu";
		reg = <0x00 0x17048000 0x00 0x1000>;
	};

	pp_vmmu@17049000 {
		compatible = "mediatek,pp_vmmu";
		reg = <0x00 0x17049000 0x00 0x1000>;
	};

	venc_gcon@17000000 {
		compatible = "mediatek,venc_gcon\0syscon";
		reg = <0x00 0x17000000 0x00 0x1000>;
		#clock-cells = <0x01>;
		linux,phandle = <0x49>;
		phandle = <0x49>;
	};

	smi_larb3@17010000 {
		compatible = "mediatek,smi_larb3";
		reg = <0x00 0x17010000 0x00 0x1000>;
		interrupts = <0x00 0xe7 0x08>;
		clocks = <0x2e 0x06 0x49 0x01 0x49 0x02>;
		clock-names = "mtcmos-ven\0venc-larb\0venc-venc";
		linux,phandle = <0x48>;
		phandle = <0x48>;
	};

	venc@17020000 {
		compatible = "mediatek,venc";
		reg = <0x00 0x17020000 0x00 0x1000>;
		interrupts = <0x00 0xe6 0x08>;
		linux,phandle = <0x3c>;
		phandle = <0x3c>;
	};

	venc_jpg@17030000 {
		compatible = "mediatek,venc_jpg";
		reg = <0x00 0x17030000 0x00 0x1000>;
		interrupts = <0x00 0xe8 0x08>;
		clocks = <0x2f 0x01 0x2e 0x03 0x2e 0x06 0x49 0x01 0x49 0x03>;
		clock-names = "MT_CG_SMI_COMMON\0MT_CG_SCP_SYS_MM0\0MT_CG_SCP_SYS_VEN\0MT_CG_VENC_LARB\0MT_CG_VENC_JPGENC";
	};

	mbist@17050000 {
		compatible = "mediatek,mbist";
		reg = <0x00 0x17050000 0x00 0x1000>;
	};

	mjc_config@12000000 {
		compatible = "mediatek,mjc_config";
		reg = <0x00 0x12000000 0x00 0x1000>;
	};

	mjc_top@12001000 {
		compatible = "mediatek,mjc_top";
		reg = <0x00 0x12001000 0x00 0x1000>;
	};

	imgsys1_dfp@1502e000 {
		compatible = "mediatek,imgsys1_dfp";
		reg = <0x00 0x1502e000 0x00 0x1000>;
	};

	imgsys@15020000 {
		compatible = "mediatek,imgsys\0syscon";
		reg = <0x00 0x15020000 0x00 0x1000>;
		#clock-cells = <0x01>;
		clocks = <0x2e 0x03 0x2e 0x05 0x2e 0x09 0x4a 0x05 0x4b 0x03 0x4b 0x04 0x4b 0x05 0x4b 0x06 0x4b 0x07 0x4b 0x08>;
		clock-names = "ISP_SCP_SYS_DIS\0ISP_SCP_SYS_ISP\0ISP_SCP_SYS_CAM\0IMG_DIP\0CAMSYS_CAM_CGPDN\0CAMSYS_CAMTG_CGPDN\0CAMSYS_SENINF_CGPDN\0CAMSYS_CAMSV0_CGPDN\0CAMSYS_CAMSV1_CGPDN\0CAMSYS_CAMSV2_CGPDN";
		linux,phandle = <0x4a>;
		phandle = <0x4a>;
	};

	smi_larb1@15021000 {
		compatible = "mediatek,smi_larb1";
		reg = <0x00 0x15021000 0x00 0x1000>;
		interrupts = <0x00 0xfa 0x08>;
		clocks = <0x2e 0x05 0x4a 0x07>;
		clock-names = "mtcmos-isp\0img-larb1";
		linux,phandle = <0x46>;
		phandle = <0x46>;
	};

	dip1@15022000 {
		compatible = "mediatek,dip1";
		reg = <0x00 0x15022000 0x00 0x3000>;
		interrupts = <0x00 0xfb 0x08>;
	};

	dpe@15028000 {
		compatible = "mediatek,dpe";
		reg = <0x00 0x15028000 0x00 0x1000>;
	};

	dpe_dma@15028000 {
		compatible = "mediatek,dpe_dma";
		reg = <0x00 0x15028000 0x00 0x1000>;
	};

	rsc@15029000 {
		compatible = "mediatek,rsc";
		reg = <0x00 0x15029000 0x00 0x1000>;
	};

	wpe@1502a000 {
		compatible = "mediatek,wpe";
		reg = <0x00 0x1502a000 0x00 0x1000>;
	};

	fdvt@1502b000 {
		compatible = "mediatek,fdvt";
		reg = <0x00 0x1502b000 0x00 0x1000>;
		interrupts = <0x00 0xfc 0x08>;
		clocks = <0x4a 0x03>;
		clock-names = "IMG_FDVT";
	};

	fdvt_dma@1502b000 {
		compatible = "mediatek,fdvt_dma";
		reg = <0x00 0x1502b000 0x00 0x1000>;
	};

	gepf@1502c000 {
		compatible = "mediatek,gepf";
		reg = <0x00 0x1502c000 0x00 0x1000>;
	};

	gepf_dma@1502c000 {
		compatible = "mediatek,gepf_dma";
		reg = <0x00 0x1502c000 0x00 0x1000>;
	};

	eaf@1502d000 {
		compatible = "mediatek,eaf";
		reg = <0x00 0x1502d000 0x00 0x1000>;
	};

	eaf_dma@1502d000 {
		compatible = "mediatek,eaf_dma";
		reg = <0x00 0x1502d000 0x00 0x1000>;
	};

	imgsys1_vad@1502e000 {
		compatible = "mediatek,imgsys1_vad";
		reg = <0x00 0x1502e000 0x00 0x1000>;
	};

	camsys@1a000000 {
		compatible = "mediatek,camsys\0syscon";
		reg = <0x00 0x1a000000 0x00 0x1000>;
		#clock-cells = <0x01>;
		linux,phandle = <0x4b>;
		phandle = <0x4b>;
	};

	smi_larb2@1a001000 {
		compatible = "mediatek,smi_larb2";
		reg = <0x00 0x1a001000 0x00 0x1000>;
		interrupts = <0x00 0xf6 0x08>;
		clocks = <0x2e 0x09 0x2f 0x09 0x4b 0x01>;
		clock-names = "mtcmos-cam\0gals-cam2mm\0cam-larb2";
		linux,phandle = <0x47>;
		phandle = <0x47>;
	};

	cam1@1a003000 {
		compatible = "mediatek,cam1";
		reg = <0x00 0x1a003000 0x00 0x1000>;
		interrupts = <0x00 0xeb 0x08>;
	};

	cam2@1a004000 {
		compatible = "mediatek,cam2";
		reg = <0x00 0x1a004000 0x00 0x1000>;
		interrupts = <0x00 0xec 0x08>;
	};

	cam3@1a005000 {
		compatible = "mediatek,cam3";
		reg = <0x00 0x1a005000 0x00 0x1000>;
		interrupts = <0x00 0xed 0x08>;
	};

	cam4@1a006000 {
		compatible = "mediatek,cam4";
		reg = <0x00 0x1a006000 0x00 0x1000>;
		interrupts = <0x00 0xee 0x08>;
	};

	cam5@1a024000 {
		compatible = "mediatek,cam5";
		reg = <0x00 0x1a024000 0x00 0x1000>;
		interrupts = <0x00 0xef 0x08>;
	};

	cam6@1a025000 {
		compatible = "mediatek,cam6";
		reg = <0x00 0x1a025000 0x00 0x1000>;
	};

	camsv_top@1a050000 {
		compatible = "mediatek,camsv_top";
		reg = <0x00 0x1a050000 0x00 0x1000>;
	};

	camsv1@1a050000 {
		compatible = "mediatek,camsv1";
		reg = <0x00 0x1a050000 0x00 0x1000>;
		interrupts = <0x00 0xf1 0x08>;
	};

	camsv2@1a051000 {
		compatible = "mediatek,camsv2";
		reg = <0x00 0x1a051000 0x00 0x1000>;
		interrupts = <0x00 0xf0 0x08>;
	};

	camsv3@1a052000 {
		compatible = "mediatek,camsv3";
		reg = <0x00 0x1a052000 0x00 0x1000>;
		interrupts = <0x00 0xf3 0x08>;
	};

	camsv4@1a053000 {
		compatible = "mediatek,camsv4";
		reg = <0x00 0x1a053000 0x00 0x1000>;
		interrupts = <0x00 0xf2 0x08>;
	};

	camsv5@1a054000 {
		compatible = "mediatek,camsv5";
		reg = <0x00 0x1a054000 0x00 0x1000>;
	};

	camsv6@1a055000 {
		compatible = "mediatek,camsv6";
		reg = <0x00 0x1a055000 0x00 0x1000>;
	};

	tsf@1a0b1000 {
		compatible = "mediatek,tsf";
		reg = <0x00 0x1a0b1000 0x00 0x1000>;
		clocks = <0x4b 0x09>;
		clock-names = "TSF_CLK_CAM_CCU";
		interrupts = <0x00 0xf7 0x08>;
	};

	camsys_dfp@1a008000 {
		compatible = "mediatek,camsys_dfp";
		reg = <0x00 0x1a008000 0x00 0x1000>;
	};

	kd_camera_hw1@1a040000 {
		compatible = "mediatek,camera_hw";
		reg = <0x00 0x1a040000 0x00 0x1000>;
		clocks = <0x40 0x07 0x40 0x23 0x40 0x47 0x40 0x3f 0x40 0x48 0x40 0x49 0x40 0x40 0x40 0x41 0x40 0x3e 0x41 0x6a>;
		clock-names = "TOP_CAMTG_SEL\0TOP_CAMTG2_SEL\0TOP_UNIVPLL2_D8\0TOP_UNIVPLL_D52\0TOP_UNIVPLL2_D16\0TOP_UNIVPLL2_D32\0TOP_UNIVPLL_D104\0TOP_UNIVPLL_D208\0TOP_UNIVPLL_D26\0TOP_CLK26M";
		linux,phandle = <0x82>;
		phandle = <0x82>;
	};

	kd_camera_hw2@1a040000 {
		compatible = "mediatek,camera_hw2";
		reg = <0x00 0x1a040000 0x00 0x1000>;
		linux,phandle = <0x83>;
		phandle = <0x83>;
	};

	seninf1_csi2@1a040000 {
		compatible = "mediatek,seninf1_csi2";
		reg = <0x00 0x1a040000 0x00 0x1000>;
	};

	seninf2_csi2@1a041000 {
		compatible = "mediatek,seninf2_csi2";
		reg = <0x00 0x1a041000 0x00 0x1000>;
	};

	seninf3_csi2@1a042000 {
		compatible = "mediatek,seninf3_csi2";
		reg = <0x00 0x1a042000 0x00 0x1000>;
	};

	seninf4_csi2@1a043000 {
		compatible = "mediatek,seninf4_csi2";
		reg = <0x00 0x1a043000 0x00 0x1000>;
	};

	seninf5_csi2@1a044000 {
		compatible = "mediatek,seninf5_csi2";
		reg = <0x00 0x1a044000 0x00 0x1000>;
	};

	seninf1@1a040000 {
		compatible = "mediatek,seninf1";
		reg = <0x00 0x1a040000 0x00 0x1000>;
	};

	seninf2@1a041000 {
		compatible = "mediatek,seninf2";
		reg = <0x00 0x1a041000 0x00 0x1000>;
	};

	seninf3@1a042000 {
		compatible = "mediatek,seninf3";
		reg = <0x00 0x1a042000 0x00 0x1000>;
	};

	seninf4@1a043000 {
		compatible = "mediatek,seninf4";
		reg = <0x00 0x1a043000 0x00 0x1000>;
	};

	seninf5@1a044000 {
		compatible = "mediatek,seninf5";
		reg = <0x00 0x1a044000 0x00 0x1000>;
	};

	seninf1_tg@1a040000 {
		compatible = "mediatek,seninf1_tg";
		reg = <0x00 0x1a040000 0x00 0x1000>;
	};

	seninf2_tg@1a041000 {
		compatible = "mediatek,seninf2_tg";
		reg = <0x00 0x1a041000 0x00 0x1000>;
	};

	seninf3_tg@1a042000 {
		compatible = "mediatek,seninf3_tg";
		reg = <0x00 0x1a042000 0x00 0x1000>;
	};

	seninf4_tg@1a043000 {
		compatible = "mediatek,seninf4_tg";
		reg = <0x00 0x1a043000 0x00 0x1000>;
	};

	seninf5_tg@1a044000 {
		compatible = "mediatek,seninf5_tg";
		reg = <0x00 0x1a044000 0x00 0x1000>;
	};

	seninf_top@1a040000 {
		compatible = "mediatek,seninf_top";
		reg = <0x00 0x1a040000 0x00 0x1000>;
		interrupts = <0x00 0xea 0x08>;
	};

	seninf1_mux@1a040000 {
		compatible = "mediatek,seninf1_mux";
		reg = <0x00 0x1a040000 0x00 0x1000>;
	};

	seninf2_mux@1a041000 {
		compatible = "mediatek,seninf2_mux";
		reg = <0x00 0x1a041000 0x00 0x1000>;
	};

	seninf3_mux@1a042000 {
		compatible = "mediatek,seninf3_mux";
		reg = <0x00 0x1a042000 0x00 0x1000>;
	};

	seninf4_mux@1a043000 {
		compatible = "mediatek,seninf4_mux";
		reg = <0x00 0x1a043000 0x00 0x1000>;
	};

	seninf5_mux@1a044000 {
		compatible = "mediatek,seninf5_mux";
		reg = <0x00 0x1a044000 0x00 0x1000>;
	};

	seninf6_mux@1a045000 {
		compatible = "mediatek,seninf6_mux";
		reg = <0x00 0x1a045000 0x00 0x1000>;
	};

	seninf7_mux@1a046000 {
		compatible = "mediatek,seninf7_mux";
		reg = <0x00 0x1a046000 0x00 0x1000>;
	};

	seninf8_mux@1a047000 {
		compatible = "mediatek,seninf8_mux";
		reg = <0x00 0x1a047000 0x00 0x1000>;
	};

	mipi_rx_config_csi0@1a040000 {
		compatible = "mediatek,mipi_rx_config_csi0";
		reg = <0x00 0x1a040000 0x00 0x1000>;
	};

	mipi_rx_config_csi1@1a041000 {
		compatible = "mediatek,mipi_rx_config_csi1";
		reg = <0x00 0x1a041000 0x00 0x1000>;
	};

	mipi_rx_config_csi2@1a042000 {
		compatible = "mediatek,mipi_rx_config_csi2";
		reg = <0x00 0x1a042000 0x00 0x1000>;
	};

	mipi_rx_config_csi3@1a043000 {
		compatible = "mediatek,mipi_rx_config_csi3";
		reg = <0x00 0x1a043000 0x00 0x1000>;
	};

	mipi_rx_config_csi4@1a044000 {
		compatible = "mediatek,mipi_rx_config_csi4";
		reg = <0x00 0x1a044000 0x00 0x1000>;
	};

	cphy_tx_config@1a040000 {
		compatible = "mediatek,cphy_tx_config";
		reg = <0x00 0x1a040000 0x00 0x1000>;
	};

	scam@1a044000 {
		compatible = "mediatek,scam";
		reg = <0x00 0x1a044000 0x00 0x1000>;
	};

	ccir656@1a044000 {
		compatible = "mediatek,ccir656";
		reg = <0x00 0x1a044000 0x00 0x1000>;
	};

	n3d_ctl_a@1a040000 {
		compatible = "mediatek,n3d_ctl_a";
		reg = <0x00 0x1a040000 0x00 0x1000>;
	};

	n3d_ctl_b@1a041000 {
		compatible = "mediatek,n3d_ctl_b";
		reg = <0x00 0x1a041000 0x00 0x1000>;
	};

	n3d_ctl_c@1a042000 {
		compatible = "mediatek,n3d_ctl_c";
		reg = <0x00 0x1a042000 0x00 0x1000>;
	};

	n3d_ctl_d@1a043000 {
		compatible = "mediatek,n3d_ctl_d";
		reg = <0x00 0x1a043000 0x00 0x1000>;
	};

	ccu@1a0b1000 {
		compatible = "mediatek,ccu";
		reg = <0x00 0x1a0b1000 0x00 0x1000>;
		interrupts = <0x00 0xf8 0x08>;
		clocks = <0x4b 0x09>;
		clock-names = "CCU_CLK_CAM_CCU";
	};

	alc@60000000 {
		compatible = "mediatek,alc";
		reg = <0x00 0x60000000 0x00 0x1000>;
	};

	md_config@80000000 {
		compatible = "mediatek,md_config";
		reg = <0x00 0x80000000 0x00 0x1000>;
	};

	md_uart0@80010000 {
		compatible = "mediatek,md_uart0";
		reg = <0x00 0x80010000 0x00 0x1000>;
	};

	md_p_dma@80020000 {
		compatible = "mediatek,md_p_dma";
		reg = <0x00 0x80020000 0x00 0x1000>;
	};

	md_gpt@80030000 {
		compatible = "mediatek,md_gpt";
		reg = <0x00 0x80030000 0x00 0x1000>;
	};

	simif1@80040000 {
		compatible = "mediatek,simif1";
		reg = <0x00 0x80040000 0x00 0x1000>;
		interrupts = <0x00 0x108 0x08>;
	};

	simif2@80050000 {
		compatible = "mediatek,simif2";
		reg = <0x00 0x80050000 0x00 0x1000>;
		interrupts = <0x00 0x109 0x08>;
	};

	md_peri_misc@80060000 {
		compatible = "mediatek,md_peri_misc";
		reg = <0x00 0x80060000 0x00 0x1000>;
		interrupts = <0x00 0x10b 0x04>;
	};

	md_cirq@f0070000 {
		compatible = "mediatek,md_cirq";
		reg = <0x00 0xf0070000 0x00 0x1000>;
	};

	md_debug1@80080000 {
		compatible = "mediatek,md_debug1";
		reg = <0x00 0x80080000 0x00 0x1000>;
	};

	md_debug2@80090000 {
		compatible = "mediatek,md_debug2";
		reg = <0x00 0x80090000 0x00 0x1000>;
	};

	md_debug3@800a0000 {
		compatible = "mediatek,md_debug3";
		reg = <0x00 0x800a0000 0x00 0x1000>;
	};

	mdpar_dbgmon@800b0000 {
		compatible = "mediatek,mdpar_dbgmon";
		reg = <0x00 0x800b0000 0x00 0x1000>;
	};

	md_peri_clk_ctl@800c0000 {
		compatible = "mediatek,md_peri_clk_ctl";
		reg = <0x00 0x800c0000 0x00 0x1000>;
	};

	md_topsm@f00d0000 {
		compatible = "mediatek,md_topsm";
		reg = <0x00 0xf00d0000 0x00 0x1000>;
	};

	md_ost@f00e0000 {
		compatible = "mediatek,md_ost";
		reg = <0x00 0xf00e0000 0x00 0x1000>;
	};

	md_rgu@f00f0000 {
		compatible = "mediatek,md_rgu";
		reg = <0x00 0xf00f0000 0x00 0x1000>;
	};

	md_i2c@80100000 {
		compatible = "mediatek,md_i2c";
		reg = <0x00 0x80100000 0x00 0x1000>;
	};

	md_eint@80110000 {
		compatible = "mediatek,md_eint";
		reg = <0x00 0x80110000 0x00 0x1000>;
	};

	md_clkctl@80120000 {
		compatible = "mediatek,md_clkctl";
		reg = <0x00 0x80120000 0x00 0x1000>;
	};

	md_global_con_dcm@80130000 {
		compatible = "mediatek,md_global_con_dcm";
		reg = <0x00 0x80130000 0x00 0x1000>;
	};

	md_pll_mixedsys@80140000 {
		compatible = "mediatek,md_pll_mixedsys";
		reg = <0x00 0x80140000 0x00 0x1000>;
	};

	md_clksw@80150000 {
		compatible = "mediatek,md_clksw";
		reg = <0x00 0x80150000 0x00 0x1000>;
	};

	a7_ost@f0160000 {
		compatible = "mediatek,a7_ost";
		reg = <0x00 0xf0160000 0x00 0x1000>;
	};

	md_lite_gpt@80170000 {
		compatible = "mediatek,md_lite_gpt";
		reg = <0x00 0x80170000 0x00 0x1000>;
	};

	md_ps2a7_pccif@80180000 {
		compatible = "mediatek,md_ps2a7_pccif";
		reg = <0x00 0x80180000 0x00 0x1000>;
	};

	md_a72ps_pccif@80190000 {
		compatible = "mediatek,md_a72ps_pccif";
		reg = <0x00 0x80190000 0x00 0x1000>;
	};

	mdperi_mbist_config@801a0000 {
		compatible = "mediatek,mdperi_mbist_config";
		reg = <0x00 0x801a0000 0x00 0x1000>;
	};

	md_sdf_top@801b0000 {
		compatible = "mediatek,md_sdf_top";
		reg = <0x00 0x801b0000 0x00 0x1000>;
	};

	psmcu_misc@80200000 {
		compatible = "mediatek,psmcu_misc";
		reg = <0x00 0x80200000 0x00 0x1000>;
	};

	psmcu_busmon@80210000 {
		compatible = "mediatek,psmcu_busmon";
		reg = <0x00 0x80210000 0x00 0x1000>;
	};

	md_pcm@80220000 {
		compatible = "mediatek,md_pcm";
		reg = <0x00 0x80220000 0x00 0x1000>;
	};

	psmcu_mbist_config@80240000 {
		compatible = "mediatek,psmcu_mbist_config";
		reg = <0x00 0x80240000 0x00 0x1000>;
	};

	md_elm@80250000 {
		compatible = "mediatek,md_elm";
		reg = <0x00 0x80250000 0x00 0x1000>;
	};

	md_abm@80260000 {
		compatible = "mediatek,md_abm";
		reg = <0x00 0x80260000 0x00 0x1000>;
	};

	md_soe@80310000 {
		compatible = "mediatek,md_soe";
		reg = <0x00 0x80310000 0x00 0x1000>;
		interrupts = <0x00 0x10a 0x08>;
	};

	md_infra_busmon@80320000 {
		compatible = "mediatek,md_infra_busmon";
		reg = <0x00 0x80320000 0x00 0x1000>;
	};

	md_uart1@80330000 {
		compatible = "mediatek,md_uart1";
		reg = <0x00 0x80330000 0x00 0x1000>;
	};

	md_uart2@80340000 {
		compatible = "mediatek,md_uart2";
		reg = <0x00 0x80340000 0x00 0x1000>;
	};

	mdinfra_mbist_config@80350000 {
		compatible = "mediatek,mdinfra_mbist_config";
		reg = <0x00 0x80350000 0x00 0x1000>;
	};

	mdsys_mbist_config@80360000 {
		compatible = "mediatek,mdsys_mbist_config";
		reg = <0x00 0x80360000 0x00 0x1000>;
	};

	mdsmicfg@803a0000 {
		compatible = "mediatek,mdsmicfg";
		reg = <0x00 0x803a0000 0x00 0x1000>;
	};

	mdinfra_misc@803b0000 {
		compatible = "mediatek,mdinfra_misc";
		reg = <0x00 0x803b0000 0x00 0x1000>;
	};

	md_bus_recoder@803c0000 {
		compatible = "mediatek,md_bus_recoder";
		reg = <0x00 0x803c0000 0x00 0x1000>;
	};

	md_ppc_top@803d0000 {
		compatible = "mediatek,md_ppc_top";
		reg = <0x00 0x803d0000 0x00 0x1000>;
	};

	a7_wdt@f0400000 {
		compatible = "mediatek,a7_wdt";
		reg = <0x00 0xf0400000 0x00 0x1000>;
	};

	a7_mbist_config@f0410000 {
		compatible = "mediatek,a7_mbist_config";
		reg = <0x00 0xf0410000 0x00 0x1000>;
	};

	a7_cirq@f0420000 {
		compatible = "mediatek,a7_cirq";
		reg = <0x00 0xf0420000 0x00 0x1000>;
	};

	pf_bsi_apb1@80200000 {
		compatible = "mediatek,pf_bsi_apb1";
		reg = <0x00 0x80200000 0x00 0x1000>;
	};

	pf_bsi_apb2@80201000 {
		compatible = "mediatek,pf_bsi_apb2";
		reg = <0x00 0x80201000 0x00 0x1000>;
	};

	rfic1_bsispi@80202000 {
		compatible = "mediatek,rfic1_bsispi";
		reg = <0x00 0x80202000 0x00 0x1000>;
	};

	rfic2_bsispi@80203000 {
		compatible = "mediatek,rfic2_bsispi";
		reg = <0x00 0x80203000 0x00 0x1000>;
	};

	mipi0_bsispi@80205000 {
		compatible = "mediatek,mipi0_bsispi";
		reg = <0x00 0x80205000 0x00 0x1000>;
	};

	mipi1_bsispi@80206000 {
		compatible = "mediatek,mipi1_bsispi";
		reg = <0x00 0x80206000 0x00 0x1000>;
	};

	idc_suart@80207000 {
		compatible = "mediatek,idc_suart";
		reg = <0x00 0x80207000 0x00 0x1000>;
	};

	mdm_psys_misc@8020d000 {
		compatible = "mediatek,mdm_psys_misc";
		reg = <0x00 0x8020d000 0x00 0x1000>;
	};

	mdm_psys_mbistcon@8020e000 {
		compatible = "mediatek,mdm_psys_mbistcon";
		reg = <0x00 0x8020e000 0x00 0x1000>;
	};

	md1_abb_mixedsys@8020c000 {
		compatible = "mediatek,md1_abb_mixedsys";
		reg = <0x00 0x8020c000 0x00 0x1000>;
	};

	md2_abb_mixedsys@8020c000 {
		compatible = "mediatek,md2_abb_mixedsys";
		reg = <0x00 0x8020c000 0x00 0x1000>;
	};

	idma@82000000 {
		compatible = "mediatek,idma";
		reg = <0x00 0x82000000 0x00 0x1000>;
	};

	ahb2dspio@82800000 {
		compatible = "mediatek,ahb2dspio";
		reg = <0x00 0x82800000 0x00 0x1000>;
	};

	md2g_confg@82c00000 {
		compatible = "mediatek,md2g_confg";
		reg = <0x00 0x82c00000 0x00 0x1000>;
	};

	apc@82c30000 {
		compatible = "mediatek,apc";
		reg = <0x00 0x82c30000 0x00 0x1000>;
	};

	csd_acc@82c70000 {
		compatible = "mediatek,csd_acc";
		reg = <0x00 0x82c70000 0x00 0x1000>;
	};

	share_d1@82ca0000 {
		compatible = "mediatek,share_d1";
		reg = <0x00 0x82ca0000 0x00 0x1000>;
	};

	irdma@82cb0000 {
		compatible = "mediatek,irdma";
		reg = <0x00 0x82cb0000 0x00 0x1000>;
	};

	patch@82cc0000 {
		compatible = "mediatek,patch";
		reg = <0x00 0x82cc0000 0x00 0x1000>;
	};

	mdafe@82cd0000 {
		compatible = "mediatek,mdafe";
		reg = <0x00 0x82cd0000 0x00 0x1000>;
	};

	bfe@82ce0000 {
		compatible = "mediatek,bfe";
		reg = <0x00 0x82ce0000 0x00 0x1000>;
	};

	modem_lite_confg@83000000 {
		compatible = "mediatek,modem_lite_confg";
		reg = <0x00 0x83000000 0x00 0x1000>;
	};

	modem_lite_topsm@83010000 {
		compatible = "mediatek,modem_lite_topsm";
		reg = <0x00 0x83010000 0x00 0x1000>;
	};

	tdma@83020000 {
		compatible = "mediatek,tdma";
		reg = <0x00 0x83020000 0x00 0x1000>;
	};

	shreg2@83030000 {
		compatible = "mediatek,shreg2";
		reg = <0x00 0x83030000 0x00 0x1000>;
	};

	divider@83040000 {
		compatible = "mediatek,divider";
		reg = <0x00 0x83040000 0x00 0x1000>;
	};

	fcs@83050000 {
		compatible = "mediatek,fcs";
		reg = <0x00 0x83050000 0x00 0x1000>;
	};

	gcu@83060000 {
		compatible = "mediatek,gcu";
		reg = <0x00 0x83060000 0x00 0x1000>;
	};

	bsi_2g@83070000 {
		compatible = "mediatek,bsi_2g";
		reg = <0x00 0x83070000 0x00 0x1000>;
	};

	bpi_2g@83080000 {
		compatible = "mediatek,bpi_2g";
		reg = <0x00 0x83080000 0x00 0x1000>;
	};

	afc_2g@83090000 {
		compatible = "mediatek,afc_2g";
		reg = <0x00 0x83090000 0x00 0x1000>;
	};

	tdd@84000000 {
		compatible = "mediatek,tdd";
		reg = <0x00 0x84000000 0x00 0x1000>;
	};

	l2ulsbdma@85000000 {
		compatible = "mediatek,l2ulsbdma";
		reg = <0x00 0x85000000 0x00 0x1000>;
	};

	l2ulhbdma@85010000 {
		compatible = "mediatek,l2ulhbdma";
		reg = <0x00 0x85010000 0x00 0x1000>;
	};

	l2dlsbdma@85020000 {
		compatible = "mediatek,l2dlsbdma";
		reg = <0x00 0x85020000 0x00 0x1000>;
	};

	l2dlhbdma@85030000 {
		compatible = "mediatek,l2dlhbdma";
		reg = <0x00 0x85030000 0x00 0x1000>;
	};

	l2mbist@85040000 {
		compatible = "mediatek,l2mbist";
		reg = <0x00 0x85040000 0x00 0x1000>;
	};

	l2pseuphy@85050000 {
		compatible = "mediatek,l2pseuphy";
		reg = <0x00 0x85050000 0x00 0x1000>;
	};

	l2hwlog@85058000 {
		compatible = "mediatek,l2hwlog";
		reg = <0x00 0x85058000 0x00 0x1000>;
	};

	l2soindma@85060000 {
		compatible = "mediatek,l2soindma";
		reg = <0x00 0x85060000 0x00 0x1000>;
	};

	l2sooutdma@85070000 {
		compatible = "mediatek,l2sooutdma";
		reg = <0x00 0x85070000 0x00 0x1000>;
	};

	l2ullmac@85080000 {
		compatible = "mediatek,l2ullmac";
		reg = <0x00 0x85080000 0x00 0x1000>;
	};

	l2dllmac@85090000 {
		compatible = "mediatek,l2dllmac";
		reg = <0x00 0x85090000 0x00 0x1000>;
	};

	l2calmac@85098000 {
		compatible = "mediatek,l2calmac";
		reg = <0x00 0x85098000 0x00 0x1000>;
	};

	l2ulfifomng@850a0000 {
		compatible = "mediatek,l2ulfifomng";
		reg = <0x00 0x850a0000 0x00 0x1000>;
	};

	l2dlfifomng@850a4000 {
		compatible = "mediatek,l2dlfifomng";
		reg = <0x00 0x850a4000 0x00 0x1000>;
	};

	l2sofifomng@850a8000 {
		compatible = "mediatek,l2sofifomng";
		reg = <0x00 0x850a8000 0x00 0x1000>;
	};

	l2sec@850b0000 {
		compatible = "mediatek,l2sec";
		reg = <0x00 0x850b0000 0x00 0x1000>;
	};

	l2ulsecctl@850b4000 {
		compatible = "mediatek,l2ulsecctl";
		reg = <0x00 0x850b4000 0x00 0x1000>;
	};

	l2dlsecctl@850b8000 {
		compatible = "mediatek,l2dlsecctl";
		reg = <0x00 0x850b8000 0x00 0x1000>;
	};

	l2sosecctl@850bc000 {
		compatible = "mediatek,l2sosecctl";
		reg = <0x00 0x850bc000 0x00 0x1000>;
	};

	l2misc@850c0000 {
		compatible = "mediatek,l2misc";
		reg = <0x00 0x850c0000 0x00 0x1000>;
	};

	l2ulbuf@850e0000 {
		compatible = "mediatek,l2ulbuf";
		reg = <0x00 0x850e0000 0x00 0x1000>;
	};

	l2dlbuf@850f0000 {
		compatible = "mediatek,l2dlbuf";
		reg = <0x00 0x850f0000 0x00 0x1000>;
	};

	mdl1ao@f60f0000 {
		compatible = "mediatek,mdl1ao";
		reg = <0x00 0xf60f0000 0x00 0x1000>;
	};

	modem_confg@87000000 {
		compatible = "mediatek,modem_confg";
		reg = <0x00 0x87000000 0x00 0x1000>;
	};

	modem_topsm@87010000 {
		compatible = "mediatek,modem_topsm";
		reg = <0x00 0x87010000 0x00 0x1000>;
	};

	bsi_3g@87070000 {
		compatible = "mediatek,bsi_3g";
		reg = <0x00 0x87070000 0x00 0x1000>;
	};

	bpi_3g@87080000 {
		compatible = "mediatek,bpi_3g";
		reg = <0x00 0x87080000 0x00 0x1000>;
	};

	afc_3g@87090000 {
		compatible = "mediatek,afc_3g";
		reg = <0x00 0x87090000 0x00 0x1000>;
	};

	wcdma_timer@870a0000 {
		compatible = "mediatek,wcdma_timer";
		reg = <0x00 0x870a0000 0x00 0x1000>;
	};

	dpa_bc@870b0000 {
		compatible = "mediatek,dpa_bc";
		reg = <0x00 0x870b0000 0x00 0x1000>;
	};

	pfc_encode@870c0000 {
		compatible = "mediatek,pfc_encode";
		reg = <0x00 0x870c0000 0x00 0x1000>;
	};

	pfc_decode@870d0000 {
		compatible = "mediatek,pfc_decode";
		reg = <0x00 0x870d0000 0x00 0x1000>;
	};

	hspasys_1_confg@87200000 {
		compatible = "mediatek,hspasys_1_confg";
		reg = <0x00 0x87200000 0x00 0x1000>;
	};

	hseq@87210000 {
		compatible = "mediatek,hseq";
		reg = <0x00 0x87210000 0x00 0x1000>;
	};

	hsce@87220000 {
		compatible = "mediatek,hsce";
		reg = <0x00 0x87220000 0x00 0x1000>;
	};

	hspasys_1_mbist@87230000 {
		compatible = "mediatek,hspasys_1_mbist";
		reg = <0x00 0x87230000 0x00 0x1000>;
	};

	hspasys_2_confg@87400000 {
		compatible = "mediatek,hspasys_2_confg";
		reg = <0x00 0x87400000 0x00 0x1000>;
	};

	hseq_dc@87410000 {
		compatible = "mediatek,hseq_dc";
		reg = <0x00 0x87410000 0x00 0x1000>;
	};

	hsce_dc@87420000 {
		compatible = "mediatek,hsce_dc";
		reg = <0x00 0x87420000 0x00 0x1000>;
	};

	rake_dc@87430000 {
		compatible = "mediatek,rake_dc";
		reg = <0x00 0x87430000 0x00 0x1000>;
	};

	hspasys_2_mbist@87440000 {
		compatible = "mediatek,hspasys_2_mbist";
		reg = <0x00 0x87440000 0x00 0x1000>;
	};

	uea_uia_u0@87600000 {
		compatible = "mediatek,uea_uia_u0";
		reg = <0x00 0x87600000 0x00 0x1000>;
	};

	uea_uia_u1@87610000 {
		compatible = "mediatek,uea_uia_u1";
		reg = <0x00 0x87610000 0x00 0x1000>;
	};

	dpa_rlc@87620000 {
		compatible = "mediatek,dpa_rlc";
		reg = <0x00 0x87620000 0x00 0x1000>;
	};

	dpa_mac@87630000 {
		compatible = "mediatek,dpa_mac";
		reg = <0x00 0x87630000 0x00 0x1000>;
	};

	upa@f0920000 {
		compatible = "mediatek,upa";
		reg = <0x00 0xf0920000 0x00 0x1000>;
	};

	h_rxbrp@87650000 {
		compatible = "mediatek,h_rxbrp";
		reg = <0x00 0x87650000 0x00 0x1000>;
	};

	rxbrp@87660000 {
		compatible = "mediatek,rxbrp";
		reg = <0x00 0x87660000 0x00 0x1000>;
	};

	hspasys_3_confg@f0910000 {
		compatible = "mediatek,hspasys_3_confg";
		reg = <0x00 0xf0910000 0x00 0x1000>;
	};

	txbrp@87680000 {
		compatible = "mediatek,txbrp";
		reg = <0x00 0x87680000 0x00 0x1000>;
	};

	txcrp@87690000 {
		compatible = "mediatek,txcrp";
		reg = <0x00 0x87690000 0x00 0x1000>;
	};

	h_txbrp@876a0000 {
		compatible = "mediatek,h_txbrp";
		reg = <0x00 0x876a0000 0x00 0x1000>;
	};

	txupc@876b0000 {
		compatible = "mediatek,txupc";
		reg = <0x00 0x876b0000 0x00 0x1000>;
	};

	bc@876c0000 {
		compatible = "mediatek,bc";
		reg = <0x00 0x876c0000 0x00 0x1000>;
	};

	dbg_tx@876d0000 {
		compatible = "mediatek,dbg_tx";
		reg = <0x00 0x876d0000 0x00 0x1000>;
	};

	hspasys_3_mbist@876e0000 {
		compatible = "mediatek,hspasys_3_mbist";
		reg = <0x00 0x876e0000 0x00 0x1000>;
	};

	rxsrp@87800000 {
		compatible = "mediatek,rxsrp";
		reg = <0x00 0x87800000 0x00 0x1000>;
	};

	indec@87810000 {
		compatible = "mediatek,indec";
		reg = <0x00 0x87810000 0x00 0x1000>;
	};

	rake_0@87820000 {
		compatible = "mediatek,rake_0";
		reg = <0x00 0x87820000 0x00 0x1000>;
	};

	rake_1@87830000 {
		compatible = "mediatek,rake_1";
		reg = <0x00 0x87830000 0x00 0x1000>;
	};

	rake_2@87840000 {
		compatible = "mediatek,rake_2";
		reg = <0x00 0x87840000 0x00 0x1000>;
	};

	searcher@87850000 {
		compatible = "mediatek,searcher";
		reg = <0x00 0x87850000 0x00 0x1000>;
	};

	rxdfe@87860000 {
		compatible = "mediatek,rxdfe";
		reg = <0x00 0x87860000 0x00 0x1000>;
	};

	hspasys_4_confg@87870000 {
		compatible = "mediatek,hspasys_4_confg";
		reg = <0x00 0x87870000 0x00 0x1000>;
	};

	dbg@87880000 {
		compatible = "mediatek,dbg";
		reg = <0x00 0x87880000 0x00 0x1000>;
	};

	dwrap0@87890000 {
		compatible = "mediatek,dwrap0";
		reg = <0x00 0x87890000 0x00 0x1000>;
	};

	log3g@878a0000 {
		compatible = "mediatek,log3g";
		reg = <0x00 0x878a0000 0x00 0x1000>;
	};

	hspasys_4_mbist@878b0000 {
		compatible = "mediatek,hspasys_4_mbist";
		reg = <0x00 0x878b0000 0x00 0x1000>;
	};

	dwrap1@878c0000 {
		compatible = "mediatek,dwrap1";
		reg = <0x00 0x878c0000 0x00 0x1000>;
	};

	c2ksys@38000000 {
		compatible = "mediatek,c2ksys";
		reg = <0x00 0x38000000 0x00 0x1000>;
	};

	c2k_rccif_ps_c2k@a0211000 {
		compatible = "mediatek,c2k_rccif_ps_c2k";
		reg = <0x00 0xa0211000 0x00 0x1000>;
	};

	c2k_rccif_l1_c2k@a0211400 {
		compatible = "mediatek,c2k_rccif_l1_c2k";
		reg = <0x00 0xa0211400 0x00 0x1000>;
	};

	c2k_md2md_pccif_md1@a0211800 {
		compatible = "mediatek,c2k_md2md_pccif_md1";
		reg = <0x00 0xa0211800 0x00 0x1000>;
	};

	c2k_rccif_c2k_ps@a0213000 {
		compatible = "mediatek,c2k_rccif_c2k_ps";
		reg = <0x00 0xa0213000 0x00 0x1000>;
	};

	c2k_rccif_c2k_l1@a0213400 {
		compatible = "mediatek,c2k_rccif_c2k_l1";
		reg = <0x00 0xa0213400 0x00 0x1000>;
	};

	c2k_md2md_pccif_md2@a0213800 {
		compatible = "mediatek,c2k_md2md_pccif_md2";
		reg = <0x00 0xa0213800 0x00 0x1000>;
	};

	c2k_ccif1@a020c000 {
		compatible = "mediatek,c2k_ccif1";
		reg = <0x00 0xa020c000 0x00 0x1000>;
	};

	mt_soc_btcvsd_rx_pcm {
		compatible = "mediatek,mt_soc_btcvsd_rx_pcm";
	};

	mt_soc_btcvsd_tx_pcm {
		compatible = "mediatek,mt_soc_btcvsd_tx_pcm";
	};

	mt_soc_deep_buffer_dl_pcm {
		compatible = "mediatek,mt_soc_pcm_deep_buffer_dl";
	};

	mt_soc_ul1_pcm {
		compatible = "mediatek,mt_soc_pcm_capture";
	};

	mt_soc_voice_md1 {
		compatible = "mediatek,mt_soc_pcm_voice_md1";
	};

	mt_soc_hdmi_pcm {
		compatible = "mediatek,mt_soc_pcm_hdmi";
	};

	mt_soc_uldlloopback_pcm {
		compatible = "mediatek,mt_soc_pcm_uldlloopback";
	};

	mt_soc_i2s0_pcm {
		compatible = "mediatek,mt_soc_pcm_dl1_i2s0";
	};

	mt_soc_mrgrx_pcm {
		compatible = "mediatek,mt_soc_pcm_mrgrx";
	};

	mt_soc_mrgrx_awb_pcm {
		compatible = "mediatek,mt_soc_pcm_mrgrx_awb";
	};

	mt_soc_fm_i2s_pcm {
		compatible = "mediatek,mt_soc_pcm_fm_i2s";
	};

	mt_soc_fm_i2s_awb_pcm {
		compatible = "mediatek,mt_soc_pcm_fm_i2s_awb";
	};

	mt_soc_i2s0dl1_pcm {
		compatible = "mediatek,mt_soc_pcm_dl1_i2s0dl1";
	};

	mt_soc_dl1_awb_pcm {
		compatible = "mediatek,mt_soc_pcm_dl1_awb";
	};

	mt_soc_voice_md1_bt {
		compatible = "mediatek,mt_soc_pcm_voice_md1_bt";
	};

	mt_soc_voip_bt_out {
		compatible = "mediatek,mt_soc_pcm_dl1_bt";
	};

	mt_soc_voip_bt_in {
		compatible = "mediatek,mt_soc_pcm_bt_dai";
	};

	mt_soc_tdmrx_pcm {
		compatible = "mediatek,mt_soc_tdm_capture";
	};

	mt_soc_fm_mrgtx_pcm {
		compatible = "mediatek,mt_soc_pcm_fmtx";
	};

	mt_soc_ul2_pcm {
		compatible = "mediatek,mt_soc_pcm_capture2";
	};

	mt_soc_i2s0_awb_pcm {
		compatible = "mediatek,mt_soc_pcm_i2s0_awb";
	};

	mt_soc_voice_md2 {
		compatible = "mediatek,mt_soc_pcm_voice_md2";
	};

	mt_soc_routing_pcm {
		compatible = "mediatek,mt_soc_pcm_routing";
	};

	mt_soc_voice_md2_bt {
		compatible = "mediatek,mt_soc_pcm_voice_md2_bt";
	};

	mt_soc_hp_impedance_pcm {
		compatible = "mediatek,mt_soc_pcm_hp_impedance";
	};

	mt_soc_codec_name {
		compatible = "mediatek,mt_soc_codec_63xx";
		use_hp_depop_flow = <0x00>;
		use_ul_260k = <0x00>;
	};

	mt_soc_dummy_pcm {
		compatible = "mediatek,mt_soc_pcm_dummy";
	};

	mt_soc_codec_dummy_name {
		compatible = "mediatek,mt_soc_codec_dummy";
	};

	mt_soc_routing_dai_name {
		compatible = "mediatek,mt_soc_dai_routing";
	};

	mt_soc_dai_name {
		compatible = "mediatek,mt_soc_dai_stub";
	};

	mt_soc_dl2_pcm {
		compatible = "mediatek,mt_soc_pcm_dl2";
	};

	mt_soc_anc_pcm {
		compatible = "mediatek,mt_soc_pcm_anc";
	};

	mt_soc_pcm_voice_ultra {
		compatible = "mediatek,mt_soc_pcm_voice_ultra";
	};

	mt_soc_pcm_voice_usb {
		compatible = "mediatek,mt_soc_pcm_voice_usb";
	};

	mt_soc_pcm_voice_usb_echoref {
		compatible = "mediatek,mt_soc_pcm_voice_usb_echoref";
	};

	consys@18070000 {
		compatible = "mediatek,mt6763-consys";
		#address-cells = <0x02>;
		#size-cells = <0x02>;
		reg = <0x00 0x18070000 0x00 0x200 0x00 0x10007000 0x00 0x100 0x00 0x10000000 0x00 0x2000 0x00 0x10006000 0x00 0x1000>;
		interrupts = <0x00 0x10d 0x08 0x00 0x10f 0x02>;
		clocks = <0x2e 0x02>;
		clock-names = "conn";
		linux,phandle = <0x84>;
		phandle = <0x84>;
	};

	wifi@180f0000 {
		compatible = "mediatek,wifi";
		reg = <0x00 0x180f0000 0x00 0x5c>;
		interrupts = <0x00 0x10e 0x08>;
		clocks = <0x05 0x2b>;
		clock-names = "wifi-dma";
	};

	btcvsd@10001000 {
		compatible = "mediatek,audio_bt_cvsd";
		offset = <0xf00 0x800 0xfd0 0xfd4 0xfd8>;
		reg = <0x00 0x10001000 0x00 0x1000 0x00 0x18000000 0x00 0x10000 0x00 0x18080000 0x00 0x8000>;
		interrupts = <0x00 0x10c 0x08>;
	};

	irtx_pwm {
		compatible = "mediatek,irtx-pwm";
		pwm_ch = <0x01>;
		pwm_data_invert = <0x00>;
		linux,phandle = <0x85>;
		phandle = <0x85>;
	};

	sim2_hot_plug {
		linux,phandle = <0x86>;
		phandle = <0x86>;
	};

	sim1_hot_plug {
		linux,phandle = <0x87>;
		phandle = <0x87>;
	};

	fingerprint {
		compatible = "mediatek,goodix-fp";
		linux,phandle = <0x88>;
		phandle = <0x88>;
	};

	otg_iddig {
		compatible = "mediatek,usb_iddig_bi_eint";
		linux,phandle = <0x89>;
		phandle = <0x89>;
	};

	mt6370_pmu_eint {
		linux,phandle = <0x8a>;
		phandle = <0x8a>;
	};

	mt6370_pd_eint {
		linux,phandle = <0x8b>;
		phandle = <0x8b>;
	};

	rt9465_slave_chr {
		compatible = "richtek,rt9465";
		linux,phandle = <0x8c>;
		phandle = <0x8c>;
	};

	mrdump_ext_rst {
		compatible = "mediatek, mrdump-disable";
		source = "EINT";
		mode = "IRQ";
		status = "okay";
		linux,phandle = <0x8d>;
		phandle = <0x8d>;
	};

	rt-pd-manager {
		compatible = "mediatek,rt-pd-manager";
	};

	pmic_clock_buffer_ctrl {
		compatible = "mediatek,pmic_clock_buffer";
		mediatek,clkbuf-quantity = <0x07>;
		mediatek,clkbuf-config = <0x02 0x01 0x01 0x02 0x00 0x00 0x01>;
		mediatek,clkbuf-driving-current = <0xffffffff 0xffffffff 0xffffffff 0xffffffff 0xffffffff 0xffffffff 0xffffffff>;
		linux,phandle = <0x8e>;
		phandle = <0x8e>;
	};

	smart_pa {
		linux,phandle = <0x8f>;
		phandle = <0x8f>;
	};

	mt6311_pmic {
		linux,phandle = <0x90>;
		phandle = <0x90>;
	};

	firmware {

		android {
			compatible = "android,firmware";

			fstab {
				compatible = "android,fstab";

				vendor {
					compatible = "android,vendor";
					dev = "/dev/block/platform/bootdevice/by-name/vendor";
					type = "ext4";
					mnt_flags = "ro";
					fsmgr_flags = "wait,verify";
				};
			};
		};
	};

	odm {
		compatible = "simple-bus";
		linux,phandle = <0x91>;
		phandle = <0x91>;
	};

	mt_pmic_regulator {
		compatible = "mediatek,mt_pmic";

		buck_regulators {
			compatible = "mediatek,mt_pmic_buck_regulators";

			buck_vs1 {
				regulator-name = "vs1";
				regulator-min-microvolt = <0x124f80>;
				regulator-max-microvolt = <0x2a88ac>;
				regulator-ramp-delay = <0x30d4>;
				regulator-enable-ramp-delay = <0x3e8>;
				linux,phandle = <0x92>;
				phandle = <0x92>;
			};

			buck_vmodem {
				regulator-name = "vmodem";
				regulator-min-microvolt = <0x7a120>;
				regulator-max-microvolt = <0x13bdb6>;
				regulator-ramp-delay = <0x186a>;
				regulator-enable-ramp-delay = <0x3e8>;
				linux,phandle = <0x93>;
				phandle = <0x93>;
			};

			buck_vcore {
				regulator-name = "vcore";
				regulator-min-microvolt = <0x7a120>;
				regulator-max-microvolt = <0x13bdb6>;
				regulator-ramp-delay = <0x186a>;
				regulator-enable-ramp-delay = <0x3e8>;
				linux,phandle = <0x94>;
				phandle = <0x94>;
			};

			buck_vproc {
				regulator-name = "vproc";
				regulator-min-microvolt = <0x7a120>;
				regulator-max-microvolt = <0x13bdb6>;
				regulator-ramp-delay = <0x186a>;
				regulator-enable-ramp-delay = <0x3e8>;
				linux,phandle = <0x95>;
				phandle = <0x95>;
			};

			buck_vs2 {
				regulator-name = "vs2";
				regulator-min-microvolt = <0x124f80>;
				regulator-max-microvolt = <0x2a88ac>;
				regulator-ramp-delay = <0x30d4>;
				regulator-enable-ramp-delay = <0x3e8>;
				linux,phandle = <0x96>;
				phandle = <0x96>;
			};

			buck_vpa {
				regulator-name = "vpa";
				regulator-min-microvolt = <0x7a120>;
				regulator-max-microvolt = <0x37b1d0>;
				regulator-ramp-delay = <0xc350>;
				regulator-enable-ramp-delay = <0x3e8>;
				linux,phandle = <0x97>;
				phandle = <0x97>;
			};
		};

		ldo_regulators {
			compatible = "mediatek,mt_pmic_ldo_regulators";

			ldo_vsim1 {
				regulator-name = "vsim1";
				regulator-min-microvolt = <0x19f0a0>;
				regulator-max-microvolt = <0x2f4d60>;
				regulator-enable-ramp-delay = <0x108>;
				linux,phandle = <0x98>;
				phandle = <0x98>;
			};

			ldo_vibr {
				regulator-name = "vibr";
				regulator-min-microvolt = <0x124f80>;
				regulator-max-microvolt = <0x325aa0>;
				regulator-enable-ramp-delay = <0x6e>;
				linux,phandle = <0x99>;
				phandle = <0x99>;
			};

			ldo_vrf12 {
				compatible = "regulator-fixed";
				regulator-name = "vrf12";
				regulator-min-microvolt = <0x124f80>;
				regulator-max-microvolt = <0x124f80>;
				regulator-enable-ramp-delay = <0xdc>;
				linux,phandle = <0x9a>;
				phandle = <0x9a>;
			};

			ldo_vusb {
				compatible = "regulator-fixed";
				regulator-name = "vusb";
				regulator-min-microvolt = <0x2dc6c0>;
				regulator-max-microvolt = <0x2dc6c0>;
				regulator-enable-ramp-delay = <0x108>;
				linux,phandle = <0x9b>;
				phandle = <0x9b>;
			};

			ldo_vcamio {
				compatible = "regulator-fixed";
				regulator-name = "vcamio";
				regulator-min-microvolt = <0x1b7740>;
				regulator-max-microvolt = <0x1b7740>;
				regulator-enable-ramp-delay = <0x108>;
				linux,phandle = <0x9c>;
				phandle = <0x9c>;
			};

			ldo_vcama {
				regulator-name = "vcama";
				regulator-min-microvolt = <0x2625a0>;
				regulator-max-microvolt = <0x2ab980>;
				regulator-enable-ramp-delay = <0x108>;
				linux,phandle = <0x9d>;
				phandle = <0x9d>;
			};

			ldo_vcamd {
				regulator-name = "vcamd";
				regulator-min-microvolt = <0xf4240>;
				regulator-max-microvolt = <0x1b7740>;
				regulator-enable-ramp-delay = <0x108>;
				linux,phandle = <0x9e>;
				phandle = <0x9e>;
			};

			ldo_vcn18 {
				compatible = "regulator-fixed";
				regulator-name = "vcn18";
				regulator-min-microvolt = <0x1b7740>;
				regulator-max-microvolt = <0x1b7740>;
				regulator-enable-ramp-delay = <0x108>;
				linux,phandle = <0x9f>;
				phandle = <0x9f>;
			};

			ldo_vfe28 {
				compatible = "regulator-fixed";
				regulator-name = "vfe28";
				regulator-min-microvolt = <0x2ab980>;
				regulator-max-microvolt = <0x2ab980>;
				regulator-enable-ramp-delay = <0x6e>;
				linux,phandle = <0xa0>;
				phandle = <0xa0>;
			};

			ldo_vaux18 {
				compatible = "regulator-fixed";
				regulator-name = "vaux18";
				regulator-min-microvolt = <0x1b7740>;
				regulator-max-microvolt = <0x1b7740>;
				regulator-enable-ramp-delay = <0x108>;
				linux,phandle = <0xa1>;
				phandle = <0xa1>;
			};

			ldo_vmipi {
				regulator-name = "vmipi";
				regulator-min-microvolt = <0x19f0a0>;
				regulator-max-microvolt = <0x1b7740>;
				regulator-enable-ramp-delay = <0x108>;
				linux,phandle = <0xa2>;
				phandle = <0xa2>;
			};

			ldo_vcn28 {
				compatible = "regulator-fixed";
				regulator-name = "vcn28";
				regulator-min-microvolt = <0x2ab980>;
				regulator-max-microvolt = <0x2ab980>;
				regulator-enable-ramp-delay = <0x108>;
				linux,phandle = <0xa3>;
				phandle = <0xa3>;
			};

			ldo_vsram_others {
				regulator-name = "vsram_others";
				regulator-min-microvolt = <0x7a120>;
				regulator-max-microvolt = <0x13bdb6>;
				regulator-ramp-delay = <0x186a>;
				regulator-enable-ramp-delay = <0x6e>;
				linux,phandle = <0xa4>;
				phandle = <0xa4>;
			};

			ldo_vsram_gpu {
				regulator-name = "vsram_gpu";
				regulator-min-microvolt = <0x7a120>;
				regulator-max-microvolt = <0x13bdb6>;
				regulator-ramp-delay = <0x186a>;
				regulator-enable-ramp-delay = <0x6e>;
				linux,phandle = <0xa5>;
				phandle = <0xa5>;
			};

			ldo_vsram_proc {
				regulator-name = "vsram_proc";
				regulator-min-microvolt = <0x7a120>;
				regulator-max-microvolt = <0x13bdb6>;
				regulator-ramp-delay = <0x186a>;
				regulator-enable-ramp-delay = <0x6e>;
				linux,phandle = <0xa6>;
				phandle = <0xa6>;
			};

			ldo_vxo22 {
				regulator-name = "vxo22";
				regulator-min-microvolt = <0x2191c0>;
				regulator-max-microvolt = <0x249f00>;
				regulator-enable-ramp-delay = <0x6e>;
				linux,phandle = <0xa7>;
				phandle = <0xa7>;
			};

			ldo_vmch {
				regulator-name = "vmch";
				regulator-min-microvolt = <0x2c4020>;
				regulator-max-microvolt = <0x325aa0>;
				regulator-enable-ramp-delay = <0x24>;
				linux,phandle = <0x0c>;
				phandle = <0x0c>;
			};

			ldo_vemc {
				regulator-name = "vemc";
				regulator-min-microvolt = <0x2c4020>;
				regulator-max-microvolt = <0x325aa0>;
				regulator-enable-ramp-delay = <0x108>;
				linux,phandle = <0x04>;
				phandle = <0x04>;
			};

			ldo_vio28 {
				compatible = "regulator-fixed";
				regulator-name = "vio28";
				regulator-min-microvolt = <0x2ab980>;
				regulator-max-microvolt = <0x2ab980>;
				regulator-enable-ramp-delay = <0x108>;
				linux,phandle = <0xa8>;
				phandle = <0xa8>;
			};

			ldo_va12 {
				compatible = "regulator-fixed";
				regulator-name = "va12";
				regulator-min-microvolt = <0x124f80>;
				regulator-max-microvolt = <0x124f80>;
				regulator-enable-ramp-delay = <0x108>;
				linux,phandle = <0xa9>;
				phandle = <0xa9>;
			};

			ldo_vio18 {
				compatible = "regulator-fixed";
				regulator-name = "vio18";
				regulator-min-microvolt = <0x1b7740>;
				regulator-max-microvolt = <0x1b7740>;
				regulator-enable-ramp-delay = <0x108>;
				linux,phandle = <0xaa>;
				phandle = <0xaa>;
			};

			ldo_vrf18 {
				compatible = "regulator-fixed";
				regulator-name = "vrf18";
				regulator-min-microvolt = <0x1b9e50>;
				regulator-max-microvolt = <0x1b9e50>;
				regulator-enable-ramp-delay = <0xdc>;
				linux,phandle = <0xab>;
				phandle = <0xab>;
			};

			ldo_vcn33_bt {
				regulator-name = "vcn33_bt";
				regulator-min-microvolt = <0x325aa0>;
				regulator-max-microvolt = <0x3567e0>;
				regulator-enable-ramp-delay = <0x108>;
				linux,phandle = <0xac>;
				phandle = <0xac>;
			};

			ldo_vcn33_wifi {
				regulator-name = "vcn33_wifi";
				regulator-min-microvolt = <0x325aa0>;
				regulator-max-microvolt = <0x3567e0>;
				regulator-enable-ramp-delay = <0x108>;
				linux,phandle = <0xad>;
				phandle = <0xad>;
			};

			ldo_vbif28 {
				compatible = "regulator-fixed";
				regulator-name = "vbif28";
				regulator-min-microvolt = <0x2ab980>;
				regulator-max-microvolt = <0x2ab980>;
				regulator-enable-ramp-delay = <0x108>;
				linux,phandle = <0xae>;
				phandle = <0xae>;
			};

			ldo_vmc {
				regulator-name = "vmc";
				regulator-min-microvolt = <0x1c61a0>;
				regulator-max-microvolt = <0x325aa0>;
				regulator-enable-ramp-delay = <0x24>;
				linux,phandle = <0x0d>;
				phandle = <0x0d>;
			};

			ldo_vdram {
				regulator-name = "vdram";
				regulator-min-microvolt = <0x10c8e0>;
				regulator-max-microvolt = <0x124f80>;
				regulator-enable-ramp-delay = <0x108>;
				linux,phandle = <0xaf>;
				phandle = <0xaf>;
			};

			ldo_vldo28 {
				regulator-name = "vldo28";
				regulator-min-microvolt = <0x2ab980>;
				regulator-max-microvolt = <0x2dc6c0>;
				regulator-enable-ramp-delay = <0x108>;
				linux,phandle = <0xb0>;
				phandle = <0xb0>;
			};

			ldo_vaud28 {
				compatible = "regulator-fixed";
				regulator-name = "vaud28";
				regulator-min-microvolt = <0x2ab980>;
				regulator-max-microvolt = <0x2ab980>;
				regulator-enable-ramp-delay = <0x108>;
				linux,phandle = <0xb1>;
				phandle = <0xb1>;
			};

			ldo_vsim2 {
				regulator-name = "vsim2";
				regulator-min-microvolt = <0x19f0a0>;
				regulator-max-microvolt = <0x2f4d60>;
				regulator-enable-ramp-delay = <0x108>;
				linux,phandle = <0xb2>;
				phandle = <0xb2>;
			};
		};
	};

	trusty {
		compatible = "android,trusty-smc-v1";
		ranges;
		#address-cells = <0x02>;
		#size-cells = <0x02>;

		irq {
			compatible = "android,trusty-irq-v1";
			ppi-interrupt-parent = <0x01>;
		};

		log {
			compatible = "android,trusty-log-v1";
		};

		virtio {
			compatible = "android,trusty-virtio-v1";
		};

		mtee {
			compatible = "mediatek,trusty-mtee-v1";
		};
	};

	mt6370_pmu_dts {
		interrupt-controller;
		#interrupt-cells = <0x01>;
		mt6370,intr_gpio_num = <0x5b>;
		mt6370,intr_gpio = <0x0b 0x5b 0x00>;
		linux,phandle = <0xb3>;
		phandle = <0xb3>;

		core {
			compatible = "mediatek,mt6370_pmu_core";
			interrupt-names = "otp\0vdda_ovp\0vdda_uv";
			i2cstmr_rst_tmr = <0x00>;
			mrstb_en;
			mrstb_tmr = <0x03>;
			int_wdt = <0x00>;
			int_deg = <0x00>;
		};

		charger {
			compatible = "mediatek,mt6370_pmu_charger";
			interrupt-names = "chg_mivr\0chg_aiclmeasi\0attachi\0ovpctrl_uvp_d_evt\0chg_wdtmri\0chg_vbusov\0chg_tmri\0chg_treg";
			charger_name = "primary_chg";
			load_switch_name = "primary_load_switch";
			ichg = <0x1e8480>;
			aicr = <0x7a120>;
			mivr = <0x432380>;
			cv = <0x426030>;
			ieoc = <0x249f0>;
			safety_timer = <0x0c>;
			dc_wdt = <0x3d0900>;
			ircmp_resistor = <0x61a8>;
			ircmp_vclamp = <0x7d00>;
			enable_te;
			enable_wdt;
		};

		mt6370_pmu_fled1 {
			compatible = "mediatek,mt6370_pmu_fled1";
			interrupt-names = "fled_lvf\0fled2_short\0fled1_short";
			fled_enable = <0x01>;
			torch_cur = <0x493e0>;
			strobe_cur = <0x124f80>;
			strobe_timeout = <0x960>;
		};

		mt6370_pmu_fled2 {
			compatible = "mediatek,mt6370_pmu_fled2";
			fled_enable = <0x01>;
			torch_cur = <0x30d40>;
			strobe_cur = <0xf4240>;
			strobe_timeout = <0x4b0>;
		};

		ldo {
			compatible = "mediatek,mt6370_pmu_ldo";
			interrupt-names = "ldo_oc";
			ldo_oms = <0x01>;
			ldo_vrc_lt = <0x01>;

			mt6370_ldo {
				regulator-name = "irtx_ldo";
				regulator-min-microvolt = <0x186a00>;
				regulator-max-microvolt = <0x3d0900>;
			};
		};

		rgbled {
			compatible = "mediatek,mt6370_pmu_rgbled";
			interrupt-names = "isink4_short\0isink3_short\0isink2_short\0isink1_short\0isink4_open\0isink3_open\0isink2_open\0isink1_open";
			mt,led_name = "mt6370_pmu_led1\0mt6370_pmu_led2\0mt6370_pmu_led3\0mt6370_pmu_led4";
			mt,led_default_trigger = "cc_mode\0cc_mode\0cc_mode\0none";
		};

		bled {
			compatible = "mediatek,mt6370_pmu_bled";
			interrupt-names = "bled_ocp";
			mt,bled_name = "mt6370_pmu_bled";
			mt,chan_en = <0x0f>;
			mt,map_linear;
			mt,bl_ovp_level = <0x03>;
			mt,bl_ocp_level = <0x03>;
			mt,use_pwm;
			mt,pwm_fsample = <0x02>;
			mt,pwm_deglitch = <0x01>;
			mt,pwm_avg_cycle = <0x00>;
			mt,bled_ramptime = <0x03>;
			mt,bled_flash_ramp = <0x01>;
			mt,max_bled_brightness = <0x2ee>;
		};

		dsv {
			compatible = "mediatek,mt6370_pmu_dsv";
			interrupt-names = "dsv_vneg_ocp\0dsv_vpos_ocp\0dsv_bst_ocp\0dsv_vneg_scp\0dsv_vpos_scp";
			db_ext_en = <0x00>;
			db_periodic_fix = <0x00>;
			db_single_pin = <0x00>;
			db_freq_pm = <0x00>;
			db_periodic_mode = <0x00>;
			db_startup = <0x00>;
			db_vneg_20ms = <0x01>;
			db_vneg_disc = <0x00>;
			db_vpos_20ms = <0x01>;
			db_vpos_disc = <0x01>;
			db_delay = <0x03>;
			db_vbst = <0x1770>;
			db_vpos_slew = <0x01>;
			db_vneg_slew = <0x01>;

			mt6370_dsvp {
				regulator-name = "dsv_pos";
				regulator-min-microvolt = <0x3d0900>;
				regulator-max-microvolt = <0x5b8d80>;
			};

			mt6370_dsvn {
				regulator-name = "dsv_neg";
				regulator-min-microvolt = <0x3d0900>;
				regulator-max-microvolt = <0x5b8d80>;
			};
		};
	};

	battery {
		compatible = "mediatek,bat_gm30";
		DIFFERENCE_FULLOCV_ITH = <0xc8>;
		SHUTDOWN_1_TIME = <0x1e>;
		KEEP_100_PERCENT = <0x01>;
		R_FG_VALUE = <0x0a>;
		EMBEDDED_SEL = <0x00>;
		PMIC_SHUTDOWN_CURRENT = <0x14>;
		FG_METER_RESISTANCE = <0x4b>;
		CAR_TUNE_VALUE = <0x64>;
		PMIC_MIN_VOL = <0x82dc>;
		POWERON_SYSTEM_IBOOT = <0x1f4>;
		SHUTDOWN_GAUGE0_VOLTAGE = <0x84d0>;
		TEMPERATURE_T0 = <0x32>;
		TEMPERATURE_T1 = <0x19>;
		TEMPERATURE_T2 = <0x0a>;
		TEMPERATURE_T3 = <0x00>;
		TEMPERATURE_T4 = <0xfffffff6>;
		g_FG_PSEUDO100_T0 = <0x60>;
		g_FG_PSEUDO100_T1 = <0x60>;
		g_FG_PSEUDO100_T2 = <0x60>;
		g_FG_PSEUDO100_T3 = <0x60>;
		g_FG_PSEUDO100_T4 = <0x60>;
		Q_MAX_SYS_VOLTAGE_BAT0 = <0xd16>;
		Q_MAX_SYS_VOLTAGE_BAT1 = <0xd16>;
		Q_MAX_SYS_VOLTAGE_BAT2 = <0xd16>;
		Q_MAX_SYS_VOLTAGE_BAT3 = <0xd16>;
		battery0_profile_t0_num = <0x64>;
		battery0_profile_t0 = <0x00 0xab2a 0x47e 0x18a 0xaa42 0x847 0x314 0xa98e 0x963 0x49e 0xa8f6 0x975 0x628 0xa86b 0x97c 0x7b2 0xa7ec 0x990 0x93c 0xa771 0x996 0xac6 0xa6f9 0x99b 0xc50 0xa683 0x9a3 0xdd9 0xa60f 0x9b0 0xf63 0xa59a 0x9b0 0x10ed 0xa527 0x9b4 0x1277 0xa4b5 0x9bc 0x1401 0xa445 0x9c4 0x158b 0xa3d5 0x9c2 0x1715 0xa365 0x9c9 0x189f 0xa2f8 0x9d1 0x1a29 0xa28b 0x9d8 0x1bb3 0xa21e 0x9dd 0x1d3d 0xa1b2 0x9e2 0x1ec7 0xa149 0x9f4 0x2051 0xa0e0 0x9fe 0x21db 0xa076 0xa01 0x2365 0xa00b 0xa02 0x24ef 0x9fa5 0xa0d 0x2678 0x9f43 0xa12 0x2802 0x9ee2 0xa20 0x298c 0x9e83 0xa34 0x2b16 0x9e23 0xa4a 0x2ca0 0x9dbd 0xa4c 0x2e2a 0x9d52 0xa44 0x2fb4 0x9ce9 0xa42 0x313e 0x9c85 0xa47 0x32c8 0x9c29 0xa52 0x3452 0x9bd3 0xa65 0x35dc 0x9b7e 0xa6f 0x3766 0x9b26 0xa71 0x38f0 0x9acc 0xa6e 0x3a7a 0x9a71 0xa65 0x3c04 0x9a10 0xa51 0x3d8e 0x99ad 0xa34 0x3f18 0x994a 0xa14 0x40a1 0x98eb 0x9f7 0x422b 0x988c 0x9e0 0x43b5 0x9830 0x9c7 0x453f 0x97dc 0x9b4 0x46c9 0x978d 0x9a7 0x4853 0x9741 0x99e 0x49dd 0x96fd 0x99e 0x4b67 0x96bd 0x99a 0x4cf1 0x9681 0x99f 0x4e7b 0x9649 0x9ab 0x5005 0x9613 0x9b0 0x518f 0x95e2 0x9b9 0x5319 0x95b1 0x9c3 0x54a3 0x9581 0x9cc 0x562d 0x9554 0x9d6 0x57b7 0x952b 0x9e1 0x5940 0x9501 0x9ea 0x5aca 0x94d7 0x9f1 0x5c54 0x94af 0x9f8 0x5dde 0x948b 0xa03 0x5f68 0x9469 0xa10 0x60f2 0x9447 0xa23 0x627c 0x9424 0xa34 0x6406 0x9402 0xa3f 0x6590 0x93e0 0xa44 0x671a 0x93c5 0xa58 0x68a4 0x93aa 0xa65 0x6a2e 0x938f 0xa71 0x6bb8 0x9372 0xa81 0x6d42 0x935a 0xa8f 0x6ecc 0x933f 0xaac 0x7056 0x9324 0xac8 0x71e0 0x9306 0xade 0x7369 0x92e5 0xaf1 0x74f3 0x92c7 0xb18 0x767d 0x92a4 0xb36 0x7807 0x9282 0xb5b 0x7991 0x9260 0xb89 0x7b1b 0x9239 0xbbb 0x7ca5 0x9217 0xc00 0x7e2f 0x91eb 0xc40 0x7fb9 0x91b8 0xc7e 0x8143 0x917f 0xcbd 0x82cd 0x9141 0xd05 0x8457 0x9105 0xd66 0x85e1 0x90c1 0xdcb 0x876b 0x9077 0xe2f 0x88f5 0x902d 0xe95 0x8a7f 0x8ff6 0xf0e 0x8c08 0x8fd4 0xfac 0x8d92 0x8fb8 0x105f 0x8f1c 0x8f9a 0x112d 0x90a6 0x8f75 0x121a 0x9230 0x8f2c 0x1317 0x93ba 0x8e72 0x13f5 0x9544 0x8d2b 0x14d6 0x96ce 0x8b4c 0x15e3 0x9858 0x88de 0x1754>;
		battery0_profile_t1_num = <0x64>;
		battery0_profile_t1 = <0x00 0xab24 0x47e 0x18a 0xaa6a 0x701 0x314 0xa9d6 0x7c3 0x49e 0xa955 0x7d4 0x628 0xa8db 0x7d9 0x7b2 0xa863 0x7de 0x93c 0xa7ee 0x7e4 0xac6 0xa77c 0x7e6 0xc50 0xa70a 0x7e5 0xdd9 0xa695 0x7e5 0xf63 0xa625 0x7f0 0x10ed 0xa5b3 0x7f2 0x1277 0xa540 0x7f2 0x1401 0xa4ce 0x7f3 0x158b 0xa45e 0x7f8 0x1715 0xa3ed 0x7fd 0x189f 0xa381 0x7fe 0x1a29 0xa314 0x800 0x1bb3 0xa2a6 0x805 0x1d3d 0xa238 0x80c 0x1ec7 0xa1ca 0x80f 0x2051 0xa15f 0x814 0x21db 0xa0f6 0x817 0x2365 0xa08d 0x818 0x24ef 0xa021 0x823 0x2678 0x9fb8 0x828 0x2802 0x9f52 0x830 0x298c 0x9eef 0x838 0x2b16 0x9e8e 0x83e 0x2ca0 0x9e2e 0x852 0x2e2a 0x9dc7 0x85c 0x2fb4 0x9d5c 0x85e 0x313e 0x9cf2 0x85b 0x32c8 0x9c8c 0x856 0x3452 0x9c28 0x85b 0x35dc 0x9bc7 0x85f 0x3766 0x9b67 0x85e 0x38f0 0x9b04 0x851 0x3a7a 0x9a9e 0x838 0x3c04 0x9a35 0x823 0x3d8e 0x99cb 0x809 0x3f18 0x9965 0x7ef 0x40a1 0x9902 0x7d8 0x422b 0x98a7 0x7c3 0x43b5 0x9851 0x7b4 0x453f 0x9803 0x7b3 0x46c9 0x97bb 0x7b9 0x4853 0x9777 0x7b4 0x49dd 0x9737 0x7af 0x4b67 0x96f9 0x7b5 0x4cf1 0x96bd 0x7ba 0x4e7b 0x9683 0x7ba 0x5005 0x964b 0x7ba 0x518f 0x961a 0x7bf 0x5319 0x95e9 0x7c7 0x54a3 0x95b9 0x7d0 0x562d 0x958b 0x7d8 0x57b7 0x955c 0x7d8 0x5940 0x9530 0x7e0 0x5aca 0x9504 0x7ee 0x5c54 0x94da 0x7fb 0x5dde 0x94b0 0x805 0x5f68 0x9486 0x80e 0x60f2 0x945f 0x815 0x627c 0x9439 0x81d 0x6406 0x9414 0x824 0x6590 0x93f0 0x824 0x671a 0x93c9 0x82d 0x68a4 0x93a3 0x82b 0x6a2e 0x937d 0x829 0x6bb8 0x9357 0x82c 0x6d42 0x9335 0x835 0x6ecc 0x9311 0x832 0x7056 0x92ee 0x83a 0x71e0 0x92ca 0x843 0x7369 0x92a2 0x842 0x74f3 0x927b 0x842 0x767d 0x9258 0x84a 0x7807 0x9236 0x859 0x7991 0x9214 0x86b 0x7b1b 0x91f1 0x87a 0x7ca5 0x91c0 0x884 0x7e2f 0x918f 0x899 0x7fb9 0x915a 0x8ab 0x8143 0x9120 0x8b9 0x82cd 0x90ea 0x8d5 0x8457 0x90ae 0x90b 0x85e1 0x9067 0x92c 0x876b 0x9025 0x94f 0x88f5 0x8ff6 0x983 0x8a7f 0x8fde 0x9cd 0x8c08 0x8fbe 0xa16 0x8d92 0x8f9d 0xa7b 0x8f1c 0x8f67 0xaed 0x90a6 0x8efd 0xb55 0x9230 0x8df5 0xb94 0x93ba 0x8c53 0xbe7 0x9544 0x8a25 0xc6e 0x96ce 0x8735 0xd37 0x9858 0x8327 0xe44>;
		battery0_profile_t2_num = <0x64>;
		battery0_profile_t2 = <0x00 0xab46 0x4e2 0x18a 0xaa96 0x8ea 0x314 0xaa09 0xa16 0x49e 0xa98d 0xa2a 0x628 0xa913 0xa32 0x7b2 0xa89b 0xa32 0x93c 0xa826 0xa32 0xac6 0xa7af 0xa33 0xc50 0xa73a 0xa38 0xdd9 0xa6c7 0xa3f 0xf63 0xa654 0xa34 0x10ed 0xa5e1 0xa32 0x1277 0xa56f 0xa38 0x1401 0xa4ff 0xa40 0x158b 0xa48c 0xa3e 0x1715 0xa41b 0xa43 0x189f 0xa3ab 0xa49 0x1a29 0xa33c 0xa4e 0x1bb3 0xa2ce 0xa53 0x1d3d 0xa260 0xa5e 0x1ec7 0xa1f4 0xa67 0x2051 0xa189 0xa71 0x21db 0xa11e 0xa7b 0x2365 0xa0b3 0xa84 0x24ef 0xa049 0xa82 0x2678 0x9fe4 0xa86 0x2802 0x9f87 0xa95 0x298c 0x9f2d 0xaac 0x2b16 0x9ed2 0xacc 0x2ca0 0x9e72 0xafd 0x2e2a 0x9e01 0xb0a 0x2fb4 0x9d80 0xafe 0x313e 0x9cf8 0xae8 0x32c8 0x9c79 0xada 0x3452 0x9c0e 0xae3 0x35dc 0x9bb1 0xae6 0x3766 0x9b5a 0xae2 0x38f0 0x9b02 0xad2 0x3a7a 0x9aa1 0xaab 0x3c04 0x9a41 0xa8e 0x3d8e 0x99df 0xa6d 0x3f18 0x997b 0xa49 0x40a1 0x9916 0xa22 0x422b 0x98b2 0x9ff 0x43b5 0x9854 0x9e2 0x453f 0x97fe 0x9cd 0x46c9 0x97b0 0x9c1 0x4853 0x9769 0x9bc 0x49dd 0x9728 0x9b9 0x4b67 0x96ea 0x9b7 0x4cf1 0x96af 0x9b8 0x4e7b 0x9678 0x9bc 0x5005 0x9642 0x9be 0x518f 0x960c 0x9bc 0x5319 0x95db 0x9c0 0x54a3 0x95ad 0x9c6 0x562d 0x957f 0x9cb 0x57b7 0x9553 0x9d5 0x5940 0x9527 0x9d6 0x5aca 0x9500 0x9dc 0x5c54 0x94da 0x9e4 0x5dde 0x94b3 0x9e9 0x5f68 0x948e 0x9f2 0x60f2 0x946a 0x9f4 0x627c 0x9447 0x9f7 0x6406 0x9425 0x9fd 0x6590 0x9405 0xa00 0x671a 0x93e5 0xa00 0x68a4 0x93c8 0xa05 0x6a2e 0x93ad 0xa0f 0x6bb8 0x9394 0xa1a 0x6d42 0x9379 0xa1a 0x6ecc 0x9363 0xa27 0x7056 0x9349 0xa30 0x71e0 0x9330 0xa36 0x7369 0x9316 0xa3a 0x74f3 0x92f6 0xa3e 0x767d 0x92d6 0xa47 0x7807 0x92b2 0xa51 0x7991 0x928b 0xa59 0x7b1b 0x9264 0xa65 0x7ca5 0x9236 0xa78 0x7e2f 0x91fe 0xa87 0x7fb9 0x91c0 0xa98 0x8143 0x9181 0xab0 0x82cd 0x9141 0xad3 0x8457 0x90f6 0xaeb 0x85e1 0x90ab 0xb03 0x876b 0x9070 0xb21 0x88f5 0x904e 0xb48 0x8a7f 0x903a 0xb8c 0x8c08 0x9024 0xbde 0x8d92 0x900c 0xc4c 0x8f1c 0x8fe8 0xca0 0x90a6 0x8fac 0xca3 0x9230 0x8f03 0xc98 0x93ba 0x8d86 0xcdc 0x9544 0x8b63 0xc1a 0x96ce 0x887c 0xad1 0x9858 0x848b 0xaaa>;
		battery0_profile_t3_num = <0x64>;
		battery0_profile_t3 = <0x00 0xaafb 0x726 0x18a 0xaa1f 0xeaa 0x314 0xa979 0x10ed 0x49e 0xa8ed 0x112a 0x628 0xa86a 0x1147 0x7b2 0xa7e8 0x114a 0x93c 0xa76b 0x114a 0xac6 0xa6f5 0x1154 0xc50 0xa682 0x1160 0xdd9 0xa60c 0x1163 0xf63 0xa597 0x1159 0x10ed 0xa524 0x115c 0x1277 0xa4b1 0x115b 0x1401 0xa43f 0x1157 0x158b 0xa3cf 0x1152 0x1715 0xa35e 0x114b 0x189f 0xa2f2 0x1152 0x1a29 0xa285 0x1155 0x1bb3 0xa217 0x1153 0x1d3d 0xa1a9 0x115e 0x1ec7 0xa13b 0x114f 0x2051 0xa0cf 0x114b 0x21db 0xa067 0x114e 0x2365 0xa003 0x1155 0x24ef 0x9fa4 0x1168 0x2678 0x9f47 0x117f 0x2802 0x9ee7 0x119a 0x298c 0x9e7e 0x11ac 0x2b16 0x9e07 0x11a4 0x2ca0 0x9d7a 0x1173 0x2e2a 0x9ce4 0x1146 0x2fb4 0x9c56 0x1123 0x313e 0x9bd6 0x110a 0x32c8 0x9b65 0x10fa 0x3452 0x9b06 0x10f5 0x35dc 0x9aaa 0x10e3 0x3766 0x9a52 0x10c8 0x38f0 0x99fc 0x10ac 0x3a7a 0x99a5 0x1099 0x3c04 0x994d 0x1081 0x3d8e 0x98f8 0x106f 0x3f18 0x98a4 0x105a 0x40a1 0x984f 0x103e 0x422b 0x97fe 0x1030 0x43b5 0x97b2 0x102a 0x453f 0x976a 0x1025 0x46c9 0x9727 0x1022 0x4853 0x96e5 0x1022 0x49dd 0x96aa 0x1027 0x4b67 0x9671 0x102f 0x4cf1 0x963a 0x1039 0x4e7b 0x9605 0x1041 0x5005 0x95d2 0x1046 0x518f 0x95a3 0x1063 0x5319 0x9573 0x106c 0x54a3 0x9545 0x1074 0x562d 0x951c 0x1086 0x57b7 0x94f3 0x1096 0x5940 0x94c9 0x10a9 0x5aca 0x94a3 0x10ba 0x5c54 0x947d 0x10cc 0x5dde 0x9457 0x10e3 0x5f68 0x9437 0x10ec 0x60f2 0x9417 0x10fd 0x627c 0x93fa 0x1119 0x6406 0x93df 0x1139 0x6590 0x93c4 0x1152 0x671a 0x93ac 0x117d 0x68a4 0x9391 0x119e 0x6a2e 0x9378 0x11c0 0x6bb8 0x9360 0x11e8 0x6d42 0x934a 0x1215 0x6ecc 0x932d 0x123c 0x7056 0x9310 0x126a 0x71e0 0x92f2 0x1297 0x7369 0x92d1 0x12be 0x74f3 0x92ad 0x12f0 0x767d 0x9286 0x131c 0x7807 0x925a 0x134d 0x7991 0x922b 0x1384 0x7b1b 0x91fa 0x13be 0x7ca5 0x91c7 0x13ff 0x7e2f 0x918c 0x1437 0x7fb9 0x914d 0x1472 0x8143 0x910b 0x14b3 0x82cd 0x90c9 0x14fb 0x8457 0x9099 0x155c 0x85e1 0x9074 0x15bf 0x876b 0x9055 0x1632 0x88f5 0x9038 0x16bf 0x8a7f 0x9013 0x175f 0x8c08 0x8fe4 0x1838 0x8d92 0x8f92 0x1931 0x8f1c 0x8ef4 0x1a2a 0x90a6 0x8dda 0x1b09 0x9230 0x8bea 0x1c20 0x93ba 0x891e 0x1e11 0x9544 0x866d 0x1f00 0x96ce 0x8449 0x1e32 0x9858 0x82ec 0x1b78>;
		battery0_profile_t4_num = <0x64>;
		battery0_profile_t4 = <0x00 0xa8d6 0xbb8 0x18a 0xa72b 0x214e 0x314 0xa610 0x282a 0x49e 0xa53e 0x28f4 0x628 0xa485 0x2909 0x7b2 0xa3da 0x294d 0x93c 0xa338 0x2952 0xac6 0xa29a 0x2938 0xc50 0xa202 0x2911 0xdd9 0xa171 0x28f4 0xf63 0xa0ef 0x2915 0x10ed 0xa072 0x28f1 0x1277 0x9fee 0x28dc 0x1401 0x9f5f 0x28c7 0x158b 0x9ebf 0x2880 0x1715 0x9e06 0x2825 0x189f 0x9d53 0x27cc 0x1a29 0x9cb2 0x278a 0x1bb3 0x9c24 0x2759 0x1d3d 0x9ba5 0x271a 0x1ec7 0x9b34 0x273e 0x2051 0x9acb 0x272a 0x21db 0x9a65 0x2721 0x2365 0x9a00 0x273c 0x24ef 0x999a 0x2716 0x2678 0x9931 0x2712 0x2802 0x98c7 0x26fa 0x298c 0x985c 0x26d6 0x2b16 0x97f3 0x26b8 0x2ca0 0x978d 0x26a1 0x2e2a 0x972c 0x267c 0x2fb4 0x96d0 0x2674 0x313e 0x967c 0x267a 0x32c8 0x9630 0x265e 0x3452 0x95ee 0x266c 0x35dc 0x95b1 0x2689 0x3766 0x9579 0x26ae 0x38f0 0x9546 0x26d4 0x3a7a 0x9519 0x26f5 0x3c04 0x94f2 0x2737 0x3d8e 0x94cc 0x277e 0x3f18 0x94aa 0x27bd 0x40a1 0x948a 0x27ec 0x422b 0x946a 0x2835 0x43b5 0x944e 0x2893 0x453f 0x9431 0x28e9 0x46c9 0x9413 0x2935 0x4853 0x93fb 0x297c 0x49dd 0x93de 0x29dd 0x4b67 0x93c1 0x2a3c 0x4cf1 0x93a3 0x2aab 0x4e7b 0x9385 0x2b2b 0x5005 0x9365 0x2ba1 0x518f 0x9341 0x2c04 0x5319 0x931e 0x2c8e 0x54a3 0x92f8 0x2d25 0x562d 0x92ce 0x2dbb 0x57b7 0x92a0 0x2e68 0x5940 0x9274 0x2f1f 0x5aca 0x9243 0x2fc7 0x5c54 0x920f 0x3078 0x5dde 0x91d9 0x314e 0x5f68 0x919e 0x3234 0x60f2 0x9166 0x3307 0x627c 0x912d 0x3400 0x6406 0x90f4 0x350a 0x6590 0x90b7 0x35d8 0x671a 0x9081 0x3661 0x68a4 0x9058 0x3650 0x6a2e 0x9034 0x3609 0x6bb8 0x9014 0x35c8 0x6d42 0x8ff9 0x3592 0x6ecc 0x8fd9 0x3552 0x7056 0x8fc0 0x351f 0x71e0 0x8fa7 0x34ee 0x7369 0x8f8a 0x34b4 0x74f3 0x8f6f 0x347e 0x767d 0x8f56 0x344d 0x7807 0x8f3b 0x3416 0x7991 0x8f1e 0x33dc 0x7b1b 0x8f01 0x33a1 0x7ca5 0x8ede 0x335c 0x7e2f 0x8ebe 0x331c 0x7fb9 0x8e9a 0x32d5 0x8143 0x8e73 0x3285 0x82cd 0x8e4a 0x3233 0x8457 0x8e20 0x31e0 0x85e1 0x8df3 0x3186 0x876b 0x8dc2 0x3125 0x88f5 0x8d8f 0x30be 0x8a7f 0x8d59 0x3052 0x8c08 0x8d24 0x2fe7 0x8d92 0x8cef 0x2f7f 0x8f1c 0x8cbb 0x2f16 0x90a6 0x8c85 0x2ea9 0x9230 0x8c4d 0x2e3a 0x93ba 0x8c17 0x2dcd 0x9544 0x8bdf 0x2d5f 0x96ce 0x8ba9 0x2cf2 0x9858 0x8b78 0x2c90>;
		battery2_profile_t0_num = <0x64>;
		battery2_profile_t0 = <0x00 0xab6b 0x47e 0x17b 0xaaec 0x7a7 0x2f6 0xaa77 0x8bc 0x470 0xaa07 0x8c8 0x5eb 0xa999 0x8be 0x766 0xa92c 0x8c3 0x8e1 0xa8b9 0x8b7 0xa5c 0xa846 0x8ab 0xbd6 0xa7d4 0x8a8 0xd51 0xa75a 0x891 0xecc 0xa6e4 0x889 0x1047 0xa66e 0x882 0x11c1 0xa5f9 0x879 0x133c 0xa583 0x875 0x14b7 0xa50e 0x870 0x1632 0xa499 0x86e 0x17ad 0xa424 0x86c 0x1927 0xa3b0 0x85c 0x1aa2 0xa33b 0x85e 0x1c1d 0xa2c7 0x85b 0x1d98 0xa255 0x854 0x1f13 0xa1e4 0x856 0x208d 0xa176 0x85e 0x2208 0xa106 0x862 0x2383 0xa095 0x864 0x24fe 0xa027 0x86d 0x2678 0x9fbd 0x86e 0x27f3 0x9f55 0x873 0x296e 0x9eed 0x87e 0x2ae9 0x9e86 0x88b 0x2c64 0x9e21 0x896 0x2dde 0x9dbb 0x89f 0x2f59 0x9d54 0x8a6 0x30d4 0x9cf2 0x8ac 0x324f 0x9c90 0x8b1 0x33ca 0x9c30 0x8bf 0x3544 0x9bd1 0x8cf 0x36bf 0x9b71 0x8d8 0x383a 0x9b07 0x8cd 0x39b5 0x9a96 0x8b2 0x3b30 0x9a1d 0x88a 0x3caa 0x999a 0x857 0x3e25 0x991d 0x81e 0x3fa0 0x98af 0x7fb 0x411b 0x984f 0x7e3 0x4295 0x97fb 0x7d1 0x4410 0x97ad 0x7cd 0x458b 0x9767 0x7c8 0x4706 0x9727 0x7c6 0x4881 0x96e9 0x7c7 0x49fb 0x96ad 0x7cb 0x4b76 0x9673 0x7d0 0x4cf1 0x963c 0x7d2 0x4e6c 0x9607 0x7d4 0x4fe7 0x95d6 0x7df 0x5161 0x95a9 0x7e4 0x52dc 0x9579 0x7e6 0x5457 0x954a 0x7e8 0x55d2 0x951f 0x7f1 0x574c 0x94f5 0x7f6 0x58c7 0x94ce 0x7fb 0x5a42 0x94a8 0x801 0x5bbd 0x9483 0x80a 0x5d38 0x945b 0x810 0x5eb2 0x9438 0x81b 0x602d 0x9415 0x825 0x61a8 0x93f0 0x82a 0x6323 0x93cc 0x82a 0x649e 0x93a7 0x823 0x6618 0x9380 0x81b 0x6793 0x9356 0x818 0x690e 0x9331 0x816 0x6a89 0x9309 0x813 0x6c04 0x92e2 0x816 0x6d7e 0x92bd 0x825 0x6ef9 0x9295 0x833 0x7074 0x926b 0x839 0x71ef 0x9241 0x842 0x7369 0x921a 0x850 0x74e4 0x91f7 0x864 0x765f 0x91cc 0x87a 0x77da 0x9198 0x88d 0x7955 0x915a 0x89c 0x7acf 0x911b 0x8b4 0x7c4a 0x90dd 0x8cb 0x7dc5 0x9095 0x8dc 0x7f40 0x9048 0x8e8 0x80bb 0x900a 0x8fa 0x8235 0x8ff4 0x91d 0x83b0 0x8fe4 0x946 0x852b 0x8fd3 0x978 0x85de 0x8fc1 0x9c4 0x8660 0x8f9a 0xa1b 0x8743 0x8f2d 0xa69 0x87f6 0x8e47 0xaa6 0x890d 0x8c9d 0xacb 0x8a24 0x8a30 0xb55 0x8aac 0x86c6 0xc42 0x8bd8 0x8263 0xbce 0x8ca0 0x7d15 0x7fa>;
		battery2_profile_t1_num = <0x64>;
		battery2_profile_t1 = <0x00 0xaba9 0x47e 0x17b 0xab25 0x7a4 0x2f6 0xaab0 0x89f 0x470 0xaa42 0x89a 0x5eb 0xa9d7 0x8a0 0x766 0xa96d 0x895 0x8e1 0xa900 0x88d 0xa5c 0xa891 0x884 0xbd6 0xa820 0x879 0xd51 0xa7aa 0x86b 0xecc 0xa733 0x865 0x1047 0xa6bc 0x862 0x11c1 0xa647 0x861 0x133c 0xa5d4 0x858 0x14b7 0xa55b 0x846 0x1632 0xa4e6 0x83a 0x17ad 0xa474 0x832 0x1927 0xa3fc 0x81c 0x1aa2 0xa388 0x80f 0x1c1d 0xa315 0x808 0x1d98 0xa2a2 0x804 0x1f13 0xa232 0x804 0x208d 0xa1c3 0x804 0x2208 0xa152 0x801 0x2383 0xa0e1 0x800 0x24fe 0xa07a 0x809 0x2678 0xa00a 0x7e7 0x27f3 0x9f9f 0x7d0 0x296e 0x9f38 0x7c5 0x2ae9 0x9ed0 0x7c0 0x2c64 0x9e6b 0x7b3 0x2dde 0x9e08 0x7b4 0x2f59 0x9da5 0x7ba 0x30d4 0x9d43 0x7ba 0x324f 0x9ce3 0x7ba 0x33ca 0x9c87 0x7ca 0x3544 0x9c2d 0x7df 0x36bf 0x9bd1 0x7ec 0x383a 0x9b78 0x7f5 0x39b5 0x9b1d 0x802 0x3b30 0x9abe 0x80c 0x3caa 0x9a57 0x80d 0x3e25 0x99d5 0x7cf 0x3fa0 0x994b 0x783 0x411b 0x98c7 0x73d 0x4295 0x9853 0x70a 0x4410 0x97fa 0x6f6 0x458b 0x97aa 0x6e7 0x4706 0x9761 0x6e0 0x4881 0x971e 0x6e1 0x49fb 0x96e2 0x6e7 0x4b76 0x96a6 0x6e7 0x4cf1 0x966d 0x6e7 0x4e6c 0x9636 0x6e9 0x4fe7 0x9601 0x6ec 0x5161 0x95d0 0x6f0 0x52dc 0x95a1 0x6f8 0x5457 0x9574 0x701 0x55d2 0x9545 0x706 0x574c 0x951b 0x706 0x58c7 0x94f2 0x70e 0x5a42 0x94cb 0x71b 0x5bbd 0x94a7 0x724 0x5d38 0x9482 0x72e 0x5eb2 0x9460 0x738 0x602d 0x943e 0x73e 0x61a8 0x941b 0x73e 0x6323 0x93fd 0x749 0x649e 0x93dc 0x751 0x6618 0x93b8 0x751 0x6793 0x938d 0x743 0x690e 0x935c 0x72b 0x6a89 0x9326 0x710 0x6c04 0x92f3 0x702 0x6d7e 0x92c9 0x706 0x6ef9 0x929e 0x706 0x7074 0x9272 0x706 0x71ef 0x9245 0x706 0x7369 0x921a 0x707 0x74e4 0x91f4 0x70b 0x765f 0x91cf 0x70c 0x77da 0x91a9 0x71c 0x7955 0x9180 0x739 0x7acf 0x9140 0x73d 0x7c4a 0x9104 0x749 0x7dc5 0x90ca 0x758 0x7f40 0x908a 0x762 0x80bb 0x9032 0x757 0x8235 0x8ff9 0x756 0x83b0 0x8fda 0x760 0x852b 0x8fcf 0x77c 0x85de 0x8fc9 0x7b5 0x8660 0x8fb7 0x7db 0x8743 0x8f97 0x813 0x87f6 0x8f46 0x84c 0x890d 0x8e88 0x867 0x8a24 0x8cd3 0x898 0x8aac 0x8a95 0x8f3 0x8bd8 0x8787 0x988 0x8ca0 0x8358 0xa6a>;
		battery2_profile_t2_num = <0x64>;
		battery2_profile_t2 = <0x00 0xaa88 0x4e2 0x17b 0xa9b5 0x1545 0x2f6 0xa905 0x1ab9 0x470 0xa86a 0x1aeb 0x5eb 0xa7d5 0x1aed 0x766 0xa748 0x1ae0 0x8e1 0xa6c1 0x1ad2 0xa5c 0xa63d 0x1ac0 0xbd6 0xa5bc 0x1aa7 0xd51 0xa53b 0x1a83 0xecc 0xa4ba 0x1a5d 0x1047 0xa43b 0x1a39 0x11c1 0xa3c2 0x1a1b 0x133c 0xa34c 0x1a17 0x14b7 0xa2d5 0x19fb 0x1632 0xa260 0x19e8 0x17ad 0xa1ec 0x19e3 0x1927 0xa177 0x19d9 0x1aa2 0xa105 0x19d0 0x1c1d 0xa097 0x1993 0x1d98 0xa02a 0x194d 0x1f13 0x9fbf 0x19a2 0x208d 0x9f5b 0x19b1 0x2208 0x9ef3 0x19a1 0x2383 0x9e86 0x197c 0x24fe 0x9e15 0x194c 0x2678 0x9d9e 0x1914 0x27f3 0x9d26 0x18df 0x296e 0x9cb2 0x18ba 0x2ae9 0x9c48 0x18ba 0x2c64 0x9be3 0x18b1 0x2dde 0x9b81 0x189f 0x2f59 0x9b22 0x189c 0x30d4 0x9ac4 0x18c0 0x324f 0x9a5d 0x18a0 0x33ca 0x99f1 0x1873 0x3544 0x9981 0x1841 0x36bf 0x9910 0x180f 0x383a 0x989d 0x17c5 0x39b5 0x9833 0x17b3 0x3b30 0x97d2 0x17ad 0x3caa 0x977c 0x1797 0x3e25 0x9731 0x1788 0x3fa0 0x96eb 0x1790 0x411b 0x96aa 0x1797 0x4295 0x966d 0x1794 0x4410 0x9633 0x1787 0x458b 0x95fa 0x1774 0x4706 0x95c3 0x1771 0x4881 0x9590 0x1782 0x49fb 0x9562 0x1798 0x4b76 0x9533 0x17a1 0x4cf1 0x9504 0x17a4 0x4e6c 0x94d6 0x17a8 0x4fe7 0x94ab 0x17ba 0x5161 0x9487 0x17dd 0x52dc 0x9467 0x1803 0x5457 0x9449 0x1827 0x55d2 0x942c 0x1842 0x574c 0x9410 0x1881 0x58c7 0x93f6 0x18da 0x5a42 0x93db 0x1931 0x5bbd 0x93bc 0x1960 0x5d38 0x93a4 0x1962 0x5eb2 0x938c 0x1992 0x602d 0x9371 0x19ce 0x61a8 0x9355 0x19e6 0x6323 0x933a 0x1a42 0x649e 0x931a 0x1a66 0x6618 0x92f9 0x1a7a 0x6793 0x92da 0x1aa2 0x690e 0x92b5 0x1ad4 0x6a89 0x928d 0x1b22 0x6c04 0x9263 0x1b6b 0x6d7e 0x9236 0x1b9a 0x6ef9 0x9205 0x1bd3 0x7074 0x91d0 0x1b99 0x71ef 0x919d 0x1b3d 0x7369 0x916c 0x1b22 0x74e4 0x912d 0x1cd2 0x765f 0x90e9 0x1d61 0x77da 0x90a5 0x1dbc 0x7955 0x9064 0x1e31 0x7acf 0x9030 0x1ec3 0x7c4a 0x9004 0x1f5d 0x7dc5 0x8fe0 0x2013 0x7f40 0x8fc1 0x20ec 0x80bb 0x8f9e 0x21ef 0x8235 0x8f5c 0x230e 0x83b0 0x8ee3 0x243e 0x852b 0x8e19 0x2583 0x85de 0x8cc6 0x26e8 0x8660 0x8ab8 0x28a8 0x8743 0x896a 0x2874 0x87f6 0x88b1 0x2702 0x890d 0x8811 0x25c3 0x8a24 0x878a 0x24b5 0x8aac 0x870d 0x23bb 0x8bd8 0x869c 0x22d8 0x8ca0 0x8637 0x220e>;
		battery2_profile_t3_num = <0x64>;
		battery2_profile_t3 = <0x00 0xaa16 0x726 0x17b 0xa95f 0x18e9 0x2f6 0xa8b0 0x1ee1 0x470 0xa806 0x1f2d 0x5eb 0xa75f 0x1f40 0x766 0xa6bb 0x1f3b 0x8e1 0xa5ff 0x1f46 0xa5c 0xa51e 0x1f94 0xbd6 0xa417 0x204a 0xd51 0xa32a 0x2195 0xecc 0xa259 0x2279 0x1047 0xa195 0x2356 0x11c1 0xa0dd 0x2445 0x133c 0xa04e 0x24c5 0x14b7 0x9fd5 0x24e5 0x1632 0x9f5c 0x24e1 0x17ad 0x9ede 0x24cc 0x1927 0x9e5e 0x24aa 0x1aa2 0x9dd7 0x2471 0x1c1d 0x9d4e 0x2437 0x1d98 0x9cc5 0x240a 0x1f13 0x9c44 0x240a 0x208d 0x9bcc 0x23d9 0x2208 0x9b58 0x23bb 0x2383 0x9ae8 0x23b3 0x24fe 0x9a7c 0x23ac 0x2678 0x9a10 0x23a5 0x27f3 0x99a5 0x239c 0x296e 0x993d 0x2382 0x2ae9 0x98db 0x2341 0x2c64 0x987b 0x2327 0x2dde 0x981f 0x230f 0x2f59 0x97c9 0x22ff 0x30d4 0x9779 0x22fa 0x324f 0x9730 0x22ec 0x33ca 0x96eb 0x22e1 0x3544 0x96a9 0x22dd 0x36bf 0x966c 0x22e7 0x383a 0x9631 0x22f6 0x39b5 0x95f8 0x22f9 0x3b30 0x95c1 0x22f9 0x3caa 0x958e 0x22fb 0x3e25 0x955f 0x2304 0x3fa0 0x9532 0x231b 0x411b 0x950a 0x2337 0x4295 0x94e7 0x2355 0x4410 0x94c3 0x2380 0x458b 0x94a4 0x239b 0x4706 0x9485 0x23d3 0x4881 0x9467 0x2427 0x49fb 0x944b 0x2463 0x4b76 0x942d 0x24ac 0x4cf1 0x9411 0x24eb 0x4e6c 0x93f5 0x251f 0x4fe7 0x93d5 0x2554 0x5161 0x93b6 0x2597 0x52dc 0x9393 0x25c6 0x5457 0x936f 0x25e7 0x55d2 0x934e 0x2614 0x574c 0x9329 0x263c 0x58c7 0x9301 0x267b 0x5a42 0x92d5 0x26c0 0x5bbd 0x92a6 0x26ea 0x5d38 0x927d 0x26e8 0x5eb2 0x924d 0x2756 0x602d 0x9218 0x27e3 0x61a8 0x91e4 0x282a 0x6323 0x91a7 0x2836 0x649e 0x9169 0x2897 0x6618 0x912b 0x2912 0x6793 0x90ed 0x2974 0x690e 0x90bc 0x29b1 0x6a89 0x908a 0x2a31 0x6c04 0x905b 0x2ad0 0x6d7e 0x9031 0x2b76 0x6ef9 0x9002 0x2c29 0x7074 0x8fc7 0x2d02 0x71ef 0x8f73 0x2dfa 0x7369 0x8efd 0x2f07 0x74e4 0x8e3c 0x2ff6 0x765f 0x8d9e 0x3036 0x77da 0x8d19 0x2fd1 0x7955 0x8ca8 0x2ef0 0x7acf 0x8c46 0x2e2c 0x7c4a 0x8be5 0x2d69 0x7dc5 0x8b88 0x2cb0 0x7f40 0x8b31 0x2c03 0x80bb 0x8ae3 0x2b67 0x8235 0x8a9a 0x2ad4 0x83b0 0x8a53 0x2a45 0x852b 0x8a0e 0x29bc 0x85de 0x89cf 0x293e 0x8660 0x8996 0x28cb 0x8743 0x895c 0x2858 0x87f6 0x8923 0x27e8 0x890d 0x88ef 0x2784 0x8a24 0x88b7 0x2710 0x8aac 0x8886 0x26b0 0x8bd8 0x885a 0x2658 0x8ca0 0x882d 0x25fa>;
		battery2_profile_t4_num = <0x64>;
		battery2_profile_t4 = <0x00 0xa7f7 0xbb8 0x17b 0xa6bf 0x18ef 0x2f6 0xa55d 0x1c0b 0x470 0xa3f8 0x1aa5 0x5eb 0xa2b4 0x19c5 0x766 0xa1ab 0x1a6e 0x8e1 0xa0d1 0x1bc1 0xa5c 0xa00d 0x1d0a 0xbd6 0x9f50 0x1de7 0xd51 0x9ea3 0x1f07 0xecc 0x9e03 0x1f9a 0x1047 0x9d71 0x1fc7 0x11c1 0x9ced 0x1fad 0x133c 0x9c75 0x1fa9 0x14b7 0x9c01 0x1fa0 0x1632 0x9b90 0x1f96 0x17ad 0x9b22 0x1f90 0x1927 0x9ab4 0x1f90 0x1aa2 0x9a49 0x1fb6 0x1c1d 0x99e2 0x1fc3 0x1d98 0x997d 0x1fb8 0x1f13 0x991b 0x1fcc 0x208d 0x98b8 0x1fda 0x2208 0x9854 0x1fe3 0x2383 0x97f0 0x1fe8 0x24fe 0x9790 0x1ff1 0x2678 0x972f 0x1fba 0x27f3 0x96d8 0x1fa5 0x296e 0x9689 0x1fab 0x2ae9 0x9640 0x1fb6 0x2c64 0x9604 0x1fd9 0x2dde 0x95d1 0x1ffe 0x2f59 0x95a2 0x2022 0x30d4 0x9573 0x2042 0x324f 0x954b 0x2076 0x33ca 0x9526 0x20b0 0x3544 0x9503 0x20e7 0x36bf 0x94e0 0x2110 0x383a 0x94bf 0x2137 0x39b5 0x94a0 0x2161 0x3b30 0x9481 0x218e 0x3caa 0x9460 0x21bf 0x3e25 0x9444 0x21ea 0x3fa0 0x9426 0x221c 0x411b 0x9409 0x2247 0x4295 0x93ec 0x226b 0x4410 0x93cd 0x22c2 0x458b 0x93b1 0x2304 0x4706 0x9392 0x2346 0x4881 0x9372 0x2388 0x49fb 0x9350 0x23ac 0x4b76 0x9330 0x23df 0x4cf1 0x930d 0x2418 0x4e6c 0x92ea 0x244e 0x4fe7 0x92c4 0x246b 0x5161 0x929f 0x248e 0x52dc 0x9281 0x24c3 0x5457 0x926a 0x2514 0x55d2 0x9258 0x2592 0x574c 0x9247 0x25fc 0x58c7 0x9237 0x263f 0x5a42 0x9228 0x26a6 0x5bbd 0x921b 0x27a8 0x5d38 0x9210 0x2843 0x5eb2 0x9204 0x28c1 0x602d 0x91f8 0x2958 0x61a8 0x91ed 0x2a44 0x6323 0x91e1 0x2b0e 0x649e 0x91da 0x2bb4 0x6618 0x91d4 0x2c69 0x6793 0x91cb 0x2d55 0x690e 0x91c1 0x2e3a 0x6a89 0x91b9 0x2f35 0x6c04 0x91b1 0x3057 0x6d7e 0x91a8 0x31b3 0x6ef9 0x9199 0x337f 0x7074 0x9193 0x35c2 0x71ef 0x918e 0x37a3 0x7369 0x9189 0x38b3 0x74e4 0x9184 0x38a8 0x765f 0x917e 0x389b 0x77da 0x9177 0x388d 0x7955 0x9170 0x3881 0x7acf 0x916c 0x3877 0x7c4a 0x9169 0x3872 0x7dc5 0x9163 0x3866 0x7f40 0x915a 0x3853 0x80bb 0x9153 0x3846 0x8235 0x914e 0x383c 0x83b0 0x9149 0x3832 0x852b 0x9144 0x3828 0x85de 0x913f 0x381f 0x8660 0x913b 0x381a 0x8743 0x9136 0x3810 0x87f6 0x9132 0x3805 0x890d 0x912d 0x3800 0x8a24 0x9128 0x37f1 0x8aac 0x9125 0x37e9 0x8bd8 0x9121 0x37e2 0x8ca0 0x911a 0x37d4>;
		linux,phandle = <0xb4>;
		phandle = <0xb4>;
	};

	mt_charger {
		compatible = "mediatek,mt-charger";
		linux,phandle = <0xb5>;
		phandle = <0xb5>;
	};

	charger {
		compatible = "mediatek,charger";
		algorithm_name = "SwitchCharging";
		battery_cv = <0x426030>;
		max_charger_voltage = <0x632ea0>;
		min_charger_voltage = <0x4630c0>;
		usb_charger_current_suspend = <0x00>;
		usb_charger_current_unconfigured = <0x11170>;
		usb_charger_current_configured = <0x7a120>;
		usb_charger_current = <0x7a120>;
		ac_charger_current = <0x1f47d0>;
		ac_charger_input_current = <0x30d400>;
		non_std_ac_charger_current = <0x7a120>;
		charging_host_charger_current = <0x16e360>;
		apple_1_0a_charger_current = <0x9eb10>;
		apple_2_1a_charger_current = <0xc3500>;
		ta_ac_charger_current = <0x2dc6c0>;
		jeita_temp_above_t4_cv_voltage = <0x40b280>;
		jeita_temp_t3_to_t4_cv_voltage = <0x40b280>;
		jeita_temp_t2_to_t3_cv_voltage = <0x423920>;
		jeita_temp_t1_to_t2_cv_voltage = <0x40b280>;
		jeita_temp_t0_to_t1_cv_voltage = <0x3da540>;
		jeita_temp_below_t0_cv_voltage = <0x3da540>;
		temp_t4_threshold = <0x32>;
		temp_t4_thres_minus_x_degree = <0x2f>;
		temp_t3_threshold = <0x2d>;
		temp_t3_thres_minus_x_degree = <0x27>;
		temp_t2_threshold = <0x0a>;
		temp_t2_thres_plus_x_degree = <0x10>;
		temp_t1_threshold = <0x00>;
		temp_t1_thres_plus_x_degree = <0x06>;
		temp_t0_threshold = <0x00>;
		temp_t0_thres_plus_x_degree = <0x00>;
		temp_neg_10_threshold = <0x00>;
		enable_min_charge_temperature;
		min_charge_temperature = <0xfffffff1>;
		min_charge_temperature_plus_x_degree = <0x06>;
		max_charge_temperature = <0x37>;
		max_charge_temperature_minus_x_degree = <0x32>;
		pe20_ichg_level_threshold = <0x3e8>;
		ta_start_battery_soc = <0x00>;
		ta_stop_battery_soc = <0x55>;
		chg1_ta_ac_charger_current = <0x16e360>;
		chg2_ta_ac_charger_current = <0x16e360>;
		cable_imp_threshold = <0x2bb>;
		vbat_cable_imp_threshold = <0xf3c>;
		bif_threshold1 = <0x40d990>;
		bif_threshold2 = <0x419ce0>;
		bif_cv_under_threshold2 = <0x43e6d0>;
		linux,phandle = <0xb6>;
		phandle = <0xb6>;
	};

	__symbols__ {
		chosen = "/chosen";
		msdc0 = "/msdc@11230000";
		msdc1 = "/msdc@11240000";
		msdc2 = "/msdc@11250000";
		msdc1_ins = "/msdc1_ins@0";
		cpu0 = "/cpus/cpu@000";
		cpu1 = "/cpus/cpu@001";
		cpu2 = "/cpus/cpu@002";
		cpu3 = "/cpus/cpu@003";
		cpu4 = "/cpus/cpu@100";
		cpu5 = "/cpus/cpu@101";
		cpu6 = "/cpus/cpu@102";
		cpu7 = "/cpus/cpu@103";
		LEGACY_MCDI = "/cpus/idle-states/legacy-mcdi";
		LEGACY_SODI = "/cpus/idle-states/legacy-sodi";
		LEGACY_SODI3 = "/cpus/idle-states/legacy-sodi3";
		LEGACY_DPIDLE = "/cpus/idle-states/legacy-dpidle";
		LEGACY_SUSPEND = "/cpus/idle-states/legacy-suspend";
		MCDI_CPU = "/cpus/idle-states/mcdi-cpu";
		MCDI_CLUSTER = "/cpus/idle-states/mcdi-cluster";
		SODI = "/cpus/idle-states/sodi";
		SODI3 = "/cpus/idle-states/sodi3";
		DPIDLE = "/cpus/idle-states/dpidle";
		SUSPEND = "/cpus/idle-states/suspend";
		memory = "/memory";
		cpu_dbgapb = "/cpu_dbgapb";
		reserved_memory = "/reserved-memory";
		gic = "/interrupt-controller@40001000";
		clk_null = "/clocks/clk_null";
		clk26m = "/clocks/clk26m";
		clk32k = "/clocks/clk32k";
		dramc_sram_debug = "/dramc_sram_debug@0011d800";
		topckgen = "/topckgen@10000000";
		infracfg_ao = "/infracfg_ao@10001000";
		scpsys = "/scpsys@10001000";
		syscfg_pctl_lt = "/syscfg_pctl_lt@11f20000";
		syscfg_pctl_lm = "/syscfg_pctl_lm@11e80000";
		syscfg_pctl_lb = "/syscfg_pctl_lb@11e70000";
		syscfg_pctl_bl = "/syscfg_pctl_bl@11e90000";
		syscfg_pctl_rb = "/syscfg_pctl_rb@11d30000";
		syscfg_pctl_rm = "/syscfg_pctl_rm@11d20000";
		syscfg_pctl_rt = "/syscfg_pctl_rt@11c50000";
		syscfg_pctl_tl = "/syscfg_pctl_tl@11f30000";
		cpuxgpt = "/cpuxgpt@10200000";
		timer = "/timer";
		gpio_usage_mapping = "/gpio";
		gpio = "/gpio@10005000";
		syscfg_pctl_a = "/syscfg_pctl_a@10005000";
		pio = "/pinctrl@10005000";
		ufshci_pins_state_va09_on = "/pinctrl@10005000/ufshci_va09on";
		ufshci_pins_state_va09_off = "/pinctrl@10005000/ufshci_va09off";
		iommu = "/pinctrl@10005000/m4u@0";
		msdc0_pins_default = "/pinctrl@10005000/msdc0@default";
		msdc0_register_setting_default = "/pinctrl@10005000/msdc0@register_default";
		msdc1_pins_default = "/pinctrl@10005000/msdc1@default";
		msdc1_pins_sdr104 = "/pinctrl@10005000/msdc1@sdr104";
		msdc1_pins_sdr50 = "/pinctrl@10005000/msdc1@sdr50";
		msdc1_pins_ddr50 = "/pinctrl@10005000/msdc1@ddr50";
		msdc1_register_setting_default = "/pinctrl@10005000/msdc1@register_default";
		msdc2_pins_default = "/pinctrl@10005000/msdc2@default";
		msdc2_register_setting_default = "/pinctrl@10005000/msdc2@register_default";
		eintc = "/eintc@1000b000";
		apmixed = "/apmixed@1000c000";
		main_pmic = "/pwrap@1000d000/pmic_irq";
		keypad = "/kp@10010000";
		mdcldma = "/mdcldma@10014000";
		apuart0 = "/apuart0@11002000";
		apuart1 = "/apuart1@11003000";
		auxadc = "/auxadc@11001000";
		i2c0 = "/i2c@11007000";
		i2c1 = "/i2c@11014000";
		i2c2 = "/i2c@11015000";
		i2c5 = "/i2c@1100f000";
		i2c3 = "/i2c@11011000";
		i2c4 = "/i2c@11017000";
		i2c6 = "/i2c@11005000";
		i2c7 = "/i2c@11008000";
		i2c8 = "/i2c@11009000";
		i2c9 = "/i2c@11016000";
		spi0 = "/spi@1100a000";
		spi1 = "/spi@11010000";
		spi2 = "/spi@11012000";
		spi3 = "/spi@11013000";
		spi4 = "/spi@11018000";
		spi5 = "/spi@11019000";
		audio = "/audio@11220000";
		audgpio = "/mt_soc_dl1_pcm@11220000";
		ufshci = "/ufshci@11270000";
		mfgcfg = "/mfgcfg@13000000";
		mmsys_config = "/mmsys_config@14000000";
		nfc = "/nfc";
		flashlight_core = "/flashlight_core";
		flashlights_mt6370 = "/flashlights_mt6370";
		irq_nfc = "/irq_nfc";
		mtkfb = "/mtkfb@0";
		als = "/als_ps@0";
		mse = "/mse";
		gyro = "/gyro";
		touch = "/touch";
		accdet = "/accdet";
		dispsys = "/dispsys@14000000";
		dsi_te = "/dsi_te";
		dsi_te_1 = "/dsi_te_1";
		mhl = "/mhl@0";
		eint_hdmi_hpd = "/eint_hdmi_hpd@0";
		mdp_rdma0 = "/mdp_rdma0@14001000";
		mdp_rdma1 = "/mdp_rdma1@14002000";
		mdp_rsz0 = "/mdp_rsz0@14003000";
		mdp_rsz1 = "/mdp_rsz1@14004000";
		mdp_wrot0 = "/mdp_wrot0@14005000";
		mdp_wdma = "/mdp_wdma@14006000";
		mdp_tdshp = "/mdp_tdshp@14007000";
		disp_ovl0 = "/disp_ovl0@14008000";
		disp_ovl0_2l = "/disp_ovl0_2l@14009000";
		disp_ovl1_2l = "/disp_ovl1_2l@1400a000";
		disp_color0 = "/disp_color0@1400e000";
		disp_aal0 = "/disp_aal0@14010000";
		disp_mutex = "/disp_mutex@14016000";
		smi_larb0 = "/smi_larb0@14017000";
		venc_gcon = "/venc_gcon@17000000";
		smi_larb3 = "/smi_larb3@17010000";
		venc = "/venc@17020000";
		imgsys = "/imgsys@15020000";
		smi_larb1 = "/smi_larb1@15021000";
		camsys = "/camsys@1a000000";
		smi_larb2 = "/smi_larb2@1a001000";
		kd_camera_hw1 = "/kd_camera_hw1@1a040000";
		kd_camera_hw2 = "/kd_camera_hw2@1a040000";
		consys = "/consys@18070000";
		irtx_pwm = "/irtx_pwm";
		sim2_hot_plug = "/sim2_hot_plug";
		sim1_hot_plug = "/sim1_hot_plug";
		goodix_fp = "/fingerprint";
		otg_iddig = "/otg_iddig";
		mt6370_pmu_eint = "/mt6370_pmu_eint";
		mt6370_pd = "/mt6370_pd_eint";
		rt9465_slave_chr = "/rt9465_slave_chr";
		mrdump_ext_rst = "/mrdump_ext_rst";
		pmic_clock_buffer_ctrl = "/pmic_clock_buffer_ctrl";
		smart_pa = "/smart_pa";
		mt6311_pmic = "/mt6311_pmic";
		odm = "/odm";
		mt_pmic_vs1_buck_reg = "/mt_pmic_regulator/buck_regulators/buck_vs1";
		mt_pmic_vmodem_buck_reg = "/mt_pmic_regulator/buck_regulators/buck_vmodem";
		mt_pmic_vcore_buck_reg = "/mt_pmic_regulator/buck_regulators/buck_vcore";
		mt_pmic_vproc_buck_reg = "/mt_pmic_regulator/buck_regulators/buck_vproc";
		mt_pmic_vs2_buck_reg = "/mt_pmic_regulator/buck_regulators/buck_vs2";
		mt_pmic_vpa_buck_reg = "/mt_pmic_regulator/buck_regulators/buck_vpa";
		mt_pmic_vsim1_ldo_reg = "/mt_pmic_regulator/ldo_regulators/ldo_vsim1";
		mt_pmic_vibr_ldo_reg = "/mt_pmic_regulator/ldo_regulators/ldo_vibr";
		mt_pmic_vrf12_ldo_reg = "/mt_pmic_regulator/ldo_regulators/ldo_vrf12";
		mt_pmic_vusb_ldo_reg = "/mt_pmic_regulator/ldo_regulators/ldo_vusb";
		mt_pmic_vcamio_ldo_reg = "/mt_pmic_regulator/ldo_regulators/ldo_vcamio";
		mt_pmic_vcama_ldo_reg = "/mt_pmic_regulator/ldo_regulators/ldo_vcama";
		mt_pmic_vcamd_ldo_reg = "/mt_pmic_regulator/ldo_regulators/ldo_vcamd";
		mt_pmic_vcn18_ldo_reg = "/mt_pmic_regulator/ldo_regulators/ldo_vcn18";
		mt_pmic_vfe28_ldo_reg = "/mt_pmic_regulator/ldo_regulators/ldo_vfe28";
		mt_pmic_vaux18_ldo_reg = "/mt_pmic_regulator/ldo_regulators/ldo_vaux18";
		mt_pmic_vmipi_ldo_reg = "/mt_pmic_regulator/ldo_regulators/ldo_vmipi";
		mt_pmic_vcn28_ldo_reg = "/mt_pmic_regulator/ldo_regulators/ldo_vcn28";
		mt_pmic_vsram_others_ldo_reg = "/mt_pmic_regulator/ldo_regulators/ldo_vsram_others";
		mt_pmic_vsram_gpu_ldo_reg = "/mt_pmic_regulator/ldo_regulators/ldo_vsram_gpu";
		mt_pmic_vsram_proc_ldo_reg = "/mt_pmic_regulator/ldo_regulators/ldo_vsram_proc";
		mt_pmic_vxo22_ldo_reg = "/mt_pmic_regulator/ldo_regulators/ldo_vxo22";
		mt_pmic_vmch_ldo_reg = "/mt_pmic_regulator/ldo_regulators/ldo_vmch";
		mt_pmic_vemc_ldo_reg = "/mt_pmic_regulator/ldo_regulators/ldo_vemc";
		mt_pmic_vio28_ldo_reg = "/mt_pmic_regulator/ldo_regulators/ldo_vio28";
		mt_pmic_va12_ldo_reg = "/mt_pmic_regulator/ldo_regulators/ldo_va12";
		mt_pmic_vio18_ldo_reg = "/mt_pmic_regulator/ldo_regulators/ldo_vio18";
		mt_pmic_vrf18_ldo_reg = "/mt_pmic_regulator/ldo_regulators/ldo_vrf18";
		mt_pmic_vcn33_bt_ldo_reg = "/mt_pmic_regulator/ldo_regulators/ldo_vcn33_bt";
		mt_pmic_vcn33_wifi_ldo_reg = "/mt_pmic_regulator/ldo_regulators/ldo_vcn33_wifi";
		mt_pmic_vbif28_ldo_reg = "/mt_pmic_regulator/ldo_regulators/ldo_vbif28";
		mt_pmic_vmc_ldo_reg = "/mt_pmic_regulator/ldo_regulators/ldo_vmc";
		mt_pmic_vdram_ldo_reg = "/mt_pmic_regulator/ldo_regulators/ldo_vdram";
		mt_pmic_vldo28_ldo_reg = "/mt_pmic_regulator/ldo_regulators/ldo_vldo28";
		mt_pmic_vaud28_ldo_reg = "/mt_pmic_regulator/ldo_regulators/ldo_vaud28";
		mt_pmic_vsim2_ldo_reg = "/mt_pmic_regulator/ldo_regulators/ldo_vsim2";
		mt6370_pmu = "/mt6370_pmu_dts";
		bat_gm30 = "/battery";
		mt_charger = "/mt_charger";
		charger = "/charger";
	};
};
